/* @@@@ File written by CANAPE_VERSION 13 0 11 @@@@ */ ASAP2_VERSION 1 51
/begin PROJECT obc ""
/begin MODULE CPP ""
/begin MOD_COMMON "" BYTE_ORDER MSB_FIRST ALIGNMENT_BYTE 1 ALIGNMENT_WORD 2 ALIGNMENT_LONG 4 ALIGNMENT_FLOAT32_IEEE 4 ALIGNMENT_FLOAT64_IEEE 8 /end MOD_COMMON
/begin IF_DATA ASAP1B_CCP
 /begin SOURCE "10ms" 4 1
  /begin QP_BLOB 0x00 LENGTH 0x14 CAN_ID_FIXED 0x0636 RASTER 0x00 FIRST_PID 0x00 /end QP_BLOB
 /end SOURCE
 /begin SOURCE "100ms" 4 10
  /begin QP_BLOB 0x01 LENGTH 0x14 CAN_ID_FIXED 0x0636 RASTER 0x01 FIRST_PID 0x14 /end QP_BLOB
 /end SOURCE
 /begin RASTER "10ms" "10ms" 0x00 4 1 /end RASTER
 /begin RASTER "100ms" "100ms" 0x01 4 10 /end RASTER
 /begin TP_BLOB 0x0201 0x0206 0x0635 0x0636 0x23 0x01 BAUDRATE 0x07A120 SAMPLE_POINT 0x4B SAMPLE_RATE 0x01 BTL_CYCLES 0x08 SJW 0x02 SYNC_EDGE SINGLE DAQ_MODE BURST CONSISTENCY ODT ADDRESS_EXTENSION DAQ /begin DEFINED_PAGES 0x01 "reference page" 0x00 0x40000000 0x5FF0 ROM /end DEFINED_PAGES
  /begin DEFINED_PAGES 0x02 "working page" 0x00 0x800000 0x0C00 RAM RAM_INIT_BY_ECU /end DEFINED_PAGES
  OPTIONAL_CMD 0x000E OPTIONAL_CMD 0x0011 OPTIONAL_CMD 0x0009 OPTIONAL_CMD 0x000C OPTIONAL_CMD 0x000D /end TP_BLOB
/end IF_DATA
/begin MOD_PAR "基于s12x的发动机管理模块" VERSION "0.5" SUPPLIER "Hualong AutoTech" CUSTOMER "Huachen Auto" CUSTOMER_NO "001" USER "Jiao Yu" PHONE_NO "01062670702" ECU "EPS001" CPU_TYPE "MPC560xP" NO_OF_INTERFACES 1 ADDR_EPK 0x0
 /begin MEMORY_SEGMENT EFLASHDATA "" DATA FLASH EXTERN 0x40000000 0x5FF0 -1 -1 -1 -1 -1 /end MEMORY_SEGMENT
 /begin MEMORY_SEGMENT ERAMDATA "" DATA RAM EXTERN 0x800000 0xC00 -1 -1 -1 -1 -1 /end MEMORY_SEGMENT
/end MOD_PAR
/begin COMPU_VTAB _enum "" TAB_VERB 9 0 "PowerOff_State" 1 "CodeInit_State" 2 "WarmInit_State" 3 "Run_State" 4 "SoftDisable_State" 5 "HardDisable_State" 6 "CtrlDisable_State" 7 "ShutDown_State" 8 "SystemTest_State" DEFAULT_VALUE "" /end COMPU_VTAB
/begin COMPU_VTAB _enum "" TAB_VERB 9 0 "PowerOff_State" 1 "CodeInit_State" 2 "WarmInit_State" 3 "Run_State" 4 "SoftDisable_State" 5 "HardDisable_State" 6 "CtrlDisable_State" 7 "ShutDown_State" 8 "SystemTest_State" DEFAULT_VALUE "" /end COMPU_VTAB
/begin COMPU_VTAB _enum "" TAB_VERB 9 0 "PowerOff_State" 1 "CodeInit_State" 2 "WarmInit_State" 3 "Run_State" 4 "SoftDisable_State" 5 "HardDisable_State" 6 "CtrlDisable_State" 7 "ShutDown_State" 8 "SystemTest_State" DEFAULT_VALUE "" /end COMPU_VTAB
/begin COMPU_VTAB _enum "" TAB_VERB 4 0 "e_TRIM_INIT" 1 "e_TRIM_NOT_COMPLETED" 2 "e_TRIM_SUCCESS" 3 "e_TRIM_FAIL" DEFAULT_VALUE "" /end COMPU_VTAB
/begin COMPU_VTAB _enum "" TAB_VERB 9 0 "PowerOff_State" 1 "CodeInit_State" 2 "WarmInit_State" 3 "Run_State" 4 "SoftDisable_State" 5 "HardDisable_State" 6 "CtrlDisable_State" 7 "ShutDown_State" 8 "SystemTest_State" DEFAULT_VALUE "" /end COMPU_VTAB
/begin COMPU_VTAB _enum "" TAB_VERB 9 0 "PowerOff_State" 1 "CodeInit_State" 2 "WarmInit_State" 3 "Run_State" 4 "SoftDisable_State" 5 "HardDisable_State" 6 "CtrlDisable_State" 7 "ShutDown_State" 8 "SystemTest_State" DEFAULT_VALUE "" /end COMPU_VTAB
/begin COMPU_VTAB _enum "" TAB_VERB 9 0 "PowerOff_State" 1 "CodeInit_State" 2 "WarmInit_State" 3 "Run_State" 4 "SoftDisable_State" 5 "HardDisable_State" 6 "CtrlDisable_State" 7 "ShutDown_State" 8 "SystemTest_State" DEFAULT_VALUE "" /end COMPU_VTAB
/begin COMPU_VTAB _enum "" TAB_VERB 9 0 "PowerOff_State" 1 "CodeInit_State" 2 "WarmInit_State" 3 "Run_State" 4 "SoftDisable_State" 5 "HardDisable_State" 6 "CtrlDisable_State" 7 "ShutDown_State" 8 "SystemTest_State" DEFAULT_VALUE "" /end COMPU_VTAB
/begin COMPU_VTAB _enum "" TAB_VERB 9 0 "PowerOff_State" 1 "CodeInit_State" 2 "WarmInit_State" 3 "Run_State" 4 "SoftDisable_State" 5 "HardDisable_State" 6 "CtrlDisable_State" 7 "ShutDown_State" 8 "SystemTest_State" DEFAULT_VALUE "" /end COMPU_VTAB
/begin COMPU_VTAB _enum "" TAB_VERB 9 0 "PowerOff_State" 1 "CodeInit_State" 2 "WarmInit_State" 3 "Run_State" 4 "SoftDisable_State" 5 "HardDisable_State" 6 "CtrlDisable_State" 7 "ShutDown_State" 8 "SystemTest_State" DEFAULT_VALUE "" /end COMPU_VTAB
/begin COMPU_VTAB_RANGE _enum "" 9 0 0 "PowerOff_State" 1 1 "CodeInit_State" 2 2 "WarmInit_State" 3 3 "Run_State" 4 4 "SoftDisable_State" 5 5 "HardDisable_State" 6 6 "CtrlDisable_State" 7 7 "ShutDown_State" 8 8 "SystemTest_State" DEFAULT_VALUE "" /end COMPU_VTAB_RANGE
/begin COMPU_VTAB _enum "" TAB_VERB 9 0 "PowerOff_State" 1 "CodeInit_State" 2 "WarmInit_State" 3 "Run_State" 4 "SoftDisable_State" 5 "HardDisable_State" 6 "CtrlDisable_State" 7 "ShutDown_State" 8 "SystemTest_State" DEFAULT_VALUE "" /end COMPU_VTAB
/begin COMPU_VTAB _enum "" TAB_VERB 9 0 "PowerOff_State" 1 "CodeInit_State" 2 "WarmInit_State" 3 "Run_State" 4 "SoftDisable_State" 5 "HardDisable_State" 6 "CtrlDisable_State" 7 "ShutDown_State" 8 "SystemTest_State" DEFAULT_VALUE "" /end COMPU_VTAB
/begin COMPU_VTAB _enum "" TAB_VERB 9 0 "PowerOff_State" 1 "CodeInit_State" 2 "WarmInit_State" 3 "Run_State" 4 "SoftDisable_State" 5 "HardDisable_State" 6 "CtrlDisable_State" 7 "ShutDown_State" 8 "SystemTest_State" DEFAULT_VALUE "" /end COMPU_VTAB
/begin COMPU_VTAB _enum "" TAB_VERB 9 0 "PowerOff_State" 1 "CodeInit_State" 2 "WarmInit_State" 3 "Run_State" 4 "SoftDisable_State" 5 "HardDisable_State" 6 "CtrlDisable_State" 7 "ShutDown_State" 8 "SystemTest_State" DEFAULT_VALUE "" /end COMPU_VTAB
/begin COMPU_VTAB _enum "" TAB_VERB 9 0 "PowerOff_State" 1 "CodeInit_State" 2 "WarmInit_State" 3 "Run_State" 4 "SoftDisable_State" 5 "HardDisable_State" 6 "CtrlDisable_State" 7 "ShutDown_State" 8 "SystemTest_State" DEFAULT_VALUE "" /end COMPU_VTAB
/begin COMPU_VTAB _enum "" TAB_VERB 9 0 "PowerOff_State" 1 "CodeInit_State" 2 "WarmInit_State" 3 "Run_State" 4 "SoftDisable_State" 5 "HardDisable_State" 6 "CtrlDisable_State" 7 "ShutDown_State" 8 "SystemTest_State" DEFAULT_VALUE "" /end COMPU_VTAB
/begin COMPU_VTAB_RANGE _enum "" 9 0 0 "PowerOff_State" 1 1 "CodeInit_State" 2 2 "WarmInit_State" 3 3 "Run_State" 4 4 "SoftDisable_State" 5 5 "HardDisable_State" 6 6 "CtrlDisable_State" 7 7 "ShutDown_State" 8 8 "SystemTest_State" DEFAULT_VALUE "" /end COMPU_VTAB_RANGE
/begin COMPU_VTAB_RANGE _enum "" 9 0 0 "PowerOff_State" 1 1 "CodeInit_State" 2 2 "WarmInit_State" 3 3 "Run_State" 4 4 "SoftDisable_State" 5 5 "HardDisable_State" 6 6 "CtrlDisable_State" 7 7 "ShutDown_State" 8 8 "SystemTest_State" DEFAULT_VALUE "" /end COMPU_VTAB_RANGE
/begin COMPU_VTAB_RANGE _enum "" 9 0 0 "PowerOff_State" 1 1 "CodeInit_State" 2 2 "WarmInit_State" 3 3 "Run_State" 4 4 "SoftDisable_State" 5 5 "HardDisable_State" 6 6 "CtrlDisable_State" 7 7 "ShutDown_State" 8 8 "SystemTest_State" DEFAULT_VALUE "" /end COMPU_VTAB_RANGE
/begin COMPU_VTAB_RANGE _enum "" 9 0 0 "PowerOff_State" 1 1 "CodeInit_State" 2 2 "WarmInit_State" 3 3 "Run_State" 4 4 "SoftDisable_State" 5 5 "HardDisable_State" 6 6 "CtrlDisable_State" 7 7 "ShutDown_State" 8 8 "SystemTest_State" DEFAULT_VALUE "" /end COMPU_VTAB_RANGE
/begin COMPU_VTAB_RANGE _enum "" 9 0 0 "PowerOff_State" 1 1 "CodeInit_State" 2 2 "WarmInit_State" 3 3 "Run_State" 4 4 "SoftDisable_State" 5 5 "HardDisable_State" 6 6 "CtrlDisable_State" 7 7 "ShutDown_State" 8 8 "SystemTest_State" DEFAULT_VALUE "" /end COMPU_VTAB_RANGE
/begin COMPU_VTAB_RANGE _enum "" 9 0 0 "PowerOff_State" 1 1 "CodeInit_State" 2 2 "WarmInit_State" 3 3 "Run_State" 4 4 "SoftDisable_State" 5 5 "HardDisable_State" 6 6 "CtrlDisable_State" 7 7 "ShutDown_State" 8 8 "SystemTest_State" DEFAULT_VALUE "" /end COMPU_VTAB_RANGE
/begin COMPU_VTAB_RANGE _enum "" 9 0 0 "PowerOff_State" 1 1 "CodeInit_State" 2 2 "WarmInit_State" 3 3 "Run_State" 4 4 "SoftDisable_State" 5 5 "HardDisable_State" 6 6 "CtrlDisable_State" 7 7 "ShutDown_State" 8 8 "SystemTest_State" DEFAULT_VALUE "" /end COMPU_VTAB_RANGE
/begin COMPU_VTAB_RANGE _enum "" 9 0 0 "PowerOff_State" 1 1 "CodeInit_State" 2 2 "WarmInit_State" 3 3 "Run_State" 4 4 "SoftDisable_State" 5 5 "HardDisable_State" 6 6 "CtrlDisable_State" 7 7 "ShutDown_State" 8 8 "SystemTest_State" DEFAULT_VALUE "" /end COMPU_VTAB_RANGE
/begin COMPU_VTAB_RANGE _enum "" 9 0 0 "PowerOff_State" 1 1 "CodeInit_State" 2 2 "WarmInit_State" 3 3 "Run_State" 4 4 "SoftDisable_State" 5 5 "HardDisable_State" 6 6 "CtrlDisable_State" 7 7 "ShutDown_State" 8 8 "SystemTest_State" DEFAULT_VALUE "" /end COMPU_VTAB_RANGE
/begin COMPU_VTAB_RANGE _enum "" 9 0 0 "PowerOff_State" 1 1 "CodeInit_State" 2 2 "WarmInit_State" 3 3 "Run_State" 4 4 "SoftDisable_State" 5 5 "HardDisable_State" 6 6 "CtrlDisable_State" 7 7 "ShutDown_State" 8 8 "SystemTest_State" DEFAULT_VALUE "" /end COMPU_VTAB_RANGE
/begin COMPU_VTAB_RANGE _enum "" 9 0 0 "PowerOff_State" 1 1 "CodeInit_State" 2 2 "WarmInit_State" 3 3 "Run_State" 4 4 "SoftDisable_State" 5 5 "HardDisable_State" 6 6 "CtrlDisable_State" 7 7 "ShutDown_State" 8 8 "SystemTest_State" DEFAULT_VALUE "" /end COMPU_VTAB_RANGE
/begin COMPU_VTAB_RANGE _enum "" 9 0 0 "PowerOff_State" 1 1 "CodeInit_State" 2 2 "WarmInit_State" 3 3 "Run_State" 4 4 "SoftDisable_State" 5 5 "HardDisable_State" 6 6 "CtrlDisable_State" 7 7 "ShutDown_State" 8 8 "SystemTest_State" DEFAULT_VALUE "" /end COMPU_VTAB_RANGE
/begin COMPU_VTAB_RANGE _enum "" 9 0 0 "PowerOff_State" 1 1 "CodeInit_State" 2 2 "WarmInit_State" 3 3 "Run_State" 4 4 "SoftDisable_State" 5 5 "HardDisable_State" 6 6 "CtrlDisable_State" 7 7 "ShutDown_State" 8 8 "SystemTest_State" DEFAULT_VALUE "" /end COMPU_VTAB_RANGE
/begin COMPU_VTAB_RANGE _enum "" 9 0 0 "PowerOff_State" 1 1 "CodeInit_State" 2 2 "WarmInit_State" 3 3 "Run_State" 4 4 "SoftDisable_State" 5 5 "HardDisable_State" 6 6 "CtrlDisable_State" 7 7 "ShutDown_State" 8 8 "SystemTest_State" DEFAULT_VALUE "" /end COMPU_VTAB_RANGE
/begin COMPU_VTAB_RANGE _enum "" 9 0 0 "PowerOff_State" 1 1 "CodeInit_State" 2 2 "WarmInit_State" 3 3 "Run_State" 4 4 "SoftDisable_State" 5 5 "HardDisable_State" 6 6 "CtrlDisable_State" 7 7 "ShutDown_State" 8 8 "SystemTest_State" DEFAULT_VALUE "" /end COMPU_VTAB_RANGE
/begin COMPU_VTAB_RANGE _enum "" 9 0 0 "PowerOff_State" 1 1 "CodeInit_State" 2 2 "WarmInit_State" 3 3 "Run_State" 4 4 "SoftDisable_State" 5 5 "HardDisable_State" 6 6 "CtrlDisable_State" 7 7 "ShutDown_State" 8 8 "SystemTest_State" DEFAULT_VALUE "" /end COMPU_VTAB_RANGE
/begin COMPU_VTAB_RANGE _enum "" 9 0 0 "PowerOff_State" 1 1 "CodeInit_State" 2 2 "WarmInit_State" 3 3 "Run_State" 4 4 "SoftDisable_State" 5 5 "HardDisable_State" 6 6 "CtrlDisable_State" 7 7 "ShutDown_State" 8 8 "SystemTest_State" DEFAULT_VALUE "" /end COMPU_VTAB_RANGE
/begin COMPU_VTAB_RANGE _enum "" 9 0 0 "PowerOff_State" 1 1 "CodeInit_State" 2 2 "WarmInit_State" 3 3 "Run_State" 4 4 "SoftDisable_State" 5 5 "HardDisable_State" 6 6 "CtrlDisable_State" 7 7 "ShutDown_State" 8 8 "SystemTest_State" DEFAULT_VALUE "" /end COMPU_VTAB_RANGE
/begin COMPU_VTAB_RANGE _enum "" 9 0 0 "PowerOff_State" 1 1 "CodeInit_State" 2 2 "WarmInit_State" 3 3 "Run_State" 4 4 "SoftDisable_State" 5 5 "HardDisable_State" 6 6 "CtrlDisable_State" 7 7 "ShutDown_State" 8 8 "SystemTest_State" DEFAULT_VALUE "" /end COMPU_VTAB_RANGE
/begin COMPU_VTAB_RANGE _enum "" 9 0 0 "PowerOff_State" 1 1 "CodeInit_State" 2 2 "WarmInit_State" 3 3 "Run_State" 4 4 "SoftDisable_State" 5 5 "HardDisable_State" 6 6 "CtrlDisable_State" 7 7 "ShutDown_State" 8 8 "SystemTest_State" DEFAULT_VALUE "" /end COMPU_VTAB_RANGE
/begin COMPU_VTAB_RANGE _enum "" 9 0 0 "PowerOff_State" 1 1 "CodeInit_State" 2 2 "WarmInit_State" 3 3 "Run_State" 4 4 "SoftDisable_State" 5 5 "HardDisable_State" 6 6 "CtrlDisable_State" 7 7 "ShutDown_State" 8 8 "SystemTest_State" DEFAULT_VALUE "" /end COMPU_VTAB_RANGE
/begin COMPU_VTAB_RANGE _enum "" 9 0 0 "PowerOff_State" 1 1 "CodeInit_State" 2 2 "WarmInit_State" 3 3 "Run_State" 4 4 "SoftDisable_State" 5 5 "HardDisable_State" 6 6 "CtrlDisable_State" 7 7 "ShutDown_State" 8 8 "SystemTest_State" DEFAULT_VALUE "" /end COMPU_VTAB_RANGE
/begin COMPU_VTAB_RANGE _enum "" 9 0 0 "PowerOff_State" 1 1 "CodeInit_State" 2 2 "WarmInit_State" 3 3 "Run_State" 4 4 "SoftDisable_State" 5 5 "HardDisable_State" 6 6 "CtrlDisable_State" 7 7 "ShutDown_State" 8 8 "SystemTest_State" DEFAULT_VALUE "" /end COMPU_VTAB_RANGE
/begin COMPU_VTAB_RANGE _enum "" 9 0 0 "PowerOff_State" 1 1 "CodeInit_State" 2 2 "WarmInit_State" 3 3 "Run_State" 4 4 "SoftDisable_State" 5 5 "HardDisable_State" 6 6 "CtrlDisable_State" 7 7 "ShutDown_State" 8 8 "SystemTest_State" DEFAULT_VALUE "" /end COMPU_VTAB_RANGE
/begin COMPU_VTAB_RANGE _enum "" 9 0 0 "PowerOff_State" 1 1 "CodeInit_State" 2 2 "WarmInit_State" 3 3 "Run_State" 4 4 "SoftDisable_State" 5 5 "HardDisable_State" 6 6 "CtrlDisable_State" 7 7 "ShutDown_State" 8 8 "SystemTest_State" DEFAULT_VALUE "" /end COMPU_VTAB_RANGE
/begin COMPU_VTAB_RANGE _enum "" 9 0 0 "PowerOff_State" 1 1 "CodeInit_State" 2 2 "WarmInit_State" 3 3 "Run_State" 4 4 "SoftDisable_State" 5 5 "HardDisable_State" 6 6 "CtrlDisable_State" 7 7 "ShutDown_State" 8 8 "SystemTest_State" DEFAULT_VALUE "" /end COMPU_VTAB_RANGE
/begin COMPU_VTAB_RANGE _enum "" 9 0 0 "PowerOff_State" 1 1 "CodeInit_State" 2 2 "WarmInit_State" 3 3 "Run_State" 4 4 "SoftDisable_State" 5 5 "HardDisable_State" 6 6 "CtrlDisable_State" 7 7 "ShutDown_State" 8 8 "SystemTest_State" DEFAULT_VALUE "" /end COMPU_VTAB_RANGE
/begin COMPU_VTAB_RANGE _enum "" 9 0 0 "PowerOff_State" 1 1 "CodeInit_State" 2 2 "WarmInit_State" 3 3 "Run_State" 4 4 "SoftDisable_State" 5 5 "HardDisable_State" 6 6 "CtrlDisable_State" 7 7 "ShutDown_State" 8 8 "SystemTest_State" DEFAULT_VALUE "" /end COMPU_VTAB_RANGE
/begin COMPU_VTAB_RANGE _enum "" 9 0 0 "PowerOff_State" 1 1 "CodeInit_State" 2 2 "WarmInit_State" 3 3 "Run_State" 4 4 "SoftDisable_State" 5 5 "HardDisable_State" 6 6 "CtrlDisable_State" 7 7 "ShutDown_State" 8 8 "SystemTest_State" DEFAULT_VALUE "" /end COMPU_VTAB_RANGE
/begin COMPU_VTAB_RANGE _enum "" 9 0 0 "PowerOff_State" 1 1 "CodeInit_State" 2 2 "WarmInit_State" 3 3 "Run_State" 4 4 "SoftDisable_State" 5 5 "HardDisable_State" 6 6 "CtrlDisable_State" 7 7 "ShutDown_State" 8 8 "SystemTest_State" DEFAULT_VALUE "" /end COMPU_VTAB_RANGE
/begin COMPU_VTAB_RANGE _enum "" 9 0 0 "PowerOff_State" 1 1 "CodeInit_State" 2 2 "WarmInit_State" 3 3 "Run_State" 4 4 "SoftDisable_State" 5 5 "HardDisable_State" 6 6 "CtrlDisable_State" 7 7 "ShutDown_State" 8 8 "SystemTest_State" DEFAULT_VALUE "" /end COMPU_VTAB_RANGE
/begin COMPU_VTAB_RANGE _enum "" 9 0 0 "PowerOff_State" 1 1 "CodeInit_State" 2 2 "WarmInit_State" 3 3 "Run_State" 4 4 "SoftDisable_State" 5 5 "HardDisable_State" 6 6 "CtrlDisable_State" 7 7 "ShutDown_State" 8 8 "SystemTest_State" DEFAULT_VALUE "" /end COMPU_VTAB_RANGE
/begin COMPU_VTAB_RANGE _enum "" 9 0 0 "PowerOff_State" 1 1 "CodeInit_State" 2 2 "WarmInit_State" 3 3 "Run_State" 4 4 "SoftDisable_State" 5 5 "HardDisable_State" 6 6 "CtrlDisable_State" 7 7 "ShutDown_State" 8 8 "SystemTest_State" DEFAULT_VALUE "" /end COMPU_VTAB_RANGE
/begin COMPU_VTAB_RANGE _enum "" 9 0 0 "PowerOff_State" 1 1 "CodeInit_State" 2 2 "WarmInit_State" 3 3 "Run_State" 4 4 "SoftDisable_State" 5 5 "HardDisable_State" 6 6 "CtrlDisable_State" 7 7 "ShutDown_State" 8 8 "SystemTest_State" DEFAULT_VALUE "" /end COMPU_VTAB_RANGE
/begin COMPU_VTAB_RANGE _enum "" 9 0 0 "PowerOff_State" 1 1 "CodeInit_State" 2 2 "WarmInit_State" 3 3 "Run_State" 4 4 "SoftDisable_State" 5 5 "HardDisable_State" 6 6 "CtrlDisable_State" 7 7 "ShutDown_State" 8 8 "SystemTest_State" DEFAULT_VALUE "" /end COMPU_VTAB_RANGE
/begin COMPU_VTAB_RANGE _enum "" 9 0 0 "PowerOff_State" 1 1 "CodeInit_State" 2 2 "WarmInit_State" 3 3 "Run_State" 4 4 "SoftDisable_State" 5 5 "HardDisable_State" 6 6 "CtrlDisable_State" 7 7 "ShutDown_State" 8 8 "SystemTest_State" DEFAULT_VALUE "" /end COMPU_VTAB_RANGE
/begin COMPU_VTAB_RANGE _enum "" 9 0 0 "PowerOff_State" 1 1 "CodeInit_State" 2 2 "WarmInit_State" 3 3 "Run_State" 4 4 "SoftDisable_State" 5 5 "HardDisable_State" 6 6 "CtrlDisable_State" 7 7 "ShutDown_State" 8 8 "SystemTest_State" DEFAULT_VALUE "" /end COMPU_VTAB_RANGE
/begin COMPU_VTAB_RANGE _enum "" 9 0 0 "PowerOff_State" 1 1 "CodeInit_State" 2 2 "WarmInit_State" 3 3 "Run_State" 4 4 "SoftDisable_State" 5 5 "HardDisable_State" 6 6 "CtrlDisable_State" 7 7 "ShutDown_State" 8 8 "SystemTest_State" DEFAULT_VALUE "" /end COMPU_VTAB_RANGE
/begin COMPU_VTAB_RANGE _enum "" 9 0 0 "PowerOff_State" 1 1 "CodeInit_State" 2 2 "WarmInit_State" 3 3 "Run_State" 4 4 "SoftDisable_State" 5 5 "HardDisable_State" 6 6 "CtrlDisable_State" 7 7 "ShutDown_State" 8 8 "SystemTest_State" DEFAULT_VALUE "" /end COMPU_VTAB_RANGE
/begin COMPU_VTAB_RANGE _enum "" 9 0 0 "PowerOff_State" 1 1 "CodeInit_State" 2 2 "WarmInit_State" 3 3 "Run_State" 4 4 "SoftDisable_State" 5 5 "HardDisable_State" 6 6 "CtrlDisable_State" 7 7 "ShutDown_State" 8 8 "SystemTest_State" DEFAULT_VALUE "" /end COMPU_VTAB_RANGE
/begin COMPU_VTAB_RANGE _enum "" 9 0 0 "PowerOff_State" 1 1 "CodeInit_State" 2 2 "WarmInit_State" 3 3 "Run_State" 4 4 "SoftDisable_State" 5 5 "HardDisable_State" 6 6 "CtrlDisable_State" 7 7 "ShutDown_State" 8 8 "SystemTest_State" DEFAULT_VALUE "" /end COMPU_VTAB_RANGE
/begin COMPU_VTAB_RANGE _enum "" 9 0 0 "PowerOff_State" 1 1 "CodeInit_State" 2 2 "WarmInit_State" 3 3 "Run_State" 4 4 "SoftDisable_State" 5 5 "HardDisable_State" 6 6 "CtrlDisable_State" 7 7 "ShutDown_State" 8 8 "SystemTest_State" DEFAULT_VALUE "" /end COMPU_VTAB_RANGE
/begin COMPU_VTAB_RANGE _enum "" 9 0 0 "PowerOff_State" 1 1 "CodeInit_State" 2 2 "WarmInit_State" 3 3 "Run_State" 4 4 "SoftDisable_State" 5 5 "HardDisable_State" 6 6 "CtrlDisable_State" 7 7 "ShutDown_State" 8 8 "SystemTest_State" DEFAULT_VALUE "" /end COMPU_VTAB_RANGE
/begin COMPU_VTAB_RANGE _enum "" 9 0 0 "PowerOff_State" 1 1 "CodeInit_State" 2 2 "WarmInit_State" 3 3 "Run_State" 4 4 "SoftDisable_State" 5 5 "HardDisable_State" 6 6 "CtrlDisable_State" 7 7 "ShutDown_State" 8 8 "SystemTest_State" DEFAULT_VALUE "" /end COMPU_VTAB_RANGE
/begin COMPU_VTAB_RANGE _enum "" 9 0 0 "PowerOff_State" 1 1 "CodeInit_State" 2 2 "WarmInit_State" 3 3 "Run_State" 4 4 "SoftDisable_State" 5 5 "HardDisable_State" 6 6 "CtrlDisable_State" 7 7 "ShutDown_State" 8 8 "SystemTest_State" DEFAULT_VALUE "" /end COMPU_VTAB_RANGE
/begin COMPU_VTAB_RANGE _enum "" 9 0 0 "PowerOff_State" 1 1 "CodeInit_State" 2 2 "WarmInit_State" 3 3 "Run_State" 4 4 "SoftDisable_State" 5 5 "HardDisable_State" 6 6 "CtrlDisable_State" 7 7 "ShutDown_State" 8 8 "SystemTest_State" DEFAULT_VALUE "" /end COMPU_VTAB_RANGE
/begin COMPU_VTAB_RANGE _enum "" 9 0 0 "PowerOff_State" 1 1 "CodeInit_State" 2 2 "WarmInit_State" 3 3 "Run_State" 4 4 "SoftDisable_State" 5 5 "HardDisable_State" 6 6 "CtrlDisable_State" 7 7 "ShutDown_State" 8 8 "SystemTest_State" DEFAULT_VALUE "" /end COMPU_VTAB_RANGE
/begin COMPU_VTAB_RANGE _enum "" 9 0 0 "PowerOff_State" 1 1 "CodeInit_State" 2 2 "WarmInit_State" 3 3 "Run_State" 4 4 "SoftDisable_State" 5 5 "HardDisable_State" 6 6 "CtrlDisable_State" 7 7 "ShutDown_State" 8 8 "SystemTest_State" DEFAULT_VALUE "" /end COMPU_VTAB_RANGE
/begin COMPU_VTAB_RANGE _enum "" 9 0 0 "PowerOff_State" 1 1 "CodeInit_State" 2 2 "WarmInit_State" 3 3 "Run_State" 4 4 "SoftDisable_State" 5 5 "HardDisable_State" 6 6 "CtrlDisable_State" 7 7 "ShutDown_State" 8 8 "SystemTest_State" DEFAULT_VALUE "" /end COMPU_VTAB_RANGE
/begin COMPU_VTAB_RANGE _enum "" 9 0 0 "PowerOff_State" 1 1 "CodeInit_State" 2 2 "WarmInit_State" 3 3 "Run_State" 4 4 "SoftDisable_State" 5 5 "HardDisable_State" 6 6 "CtrlDisable_State" 7 7 "ShutDown_State" 8 8 "SystemTest_State" DEFAULT_VALUE "" /end COMPU_VTAB_RANGE
/begin COMPU_VTAB_RANGE _enum "" 9 0 0 "PowerOff_State" 1 1 "CodeInit_State" 2 2 "WarmInit_State" 3 3 "Run_State" 4 4 "SoftDisable_State" 5 5 "HardDisable_State" 6 6 "CtrlDisable_State" 7 7 "ShutDown_State" 8 8 "SystemTest_State" DEFAULT_VALUE "" /end COMPU_VTAB_RANGE
/begin COMPU_VTAB_RANGE _enum "" 9 0 0 "PowerOff_State" 1 1 "CodeInit_State" 2 2 "WarmInit_State" 3 3 "Run_State" 4 4 "SoftDisable_State" 5 5 "HardDisable_State" 6 6 "CtrlDisable_State" 7 7 "ShutDown_State" 8 8 "SystemTest_State" DEFAULT_VALUE "" /end COMPU_VTAB_RANGE
/begin COMPU_VTAB_RANGE _enum "" 9 0 0 "PowerOff_State" 1 1 "CodeInit_State" 2 2 "WarmInit_State" 3 3 "Run_State" 4 4 "SoftDisable_State" 5 5 "HardDisable_State" 6 6 "CtrlDisable_State" 7 7 "ShutDown_State" 8 8 "SystemTest_State" DEFAULT_VALUE "" /end COMPU_VTAB_RANGE
/begin COMPU_VTAB_RANGE _enum "" 9 0 0 "PowerOff_State" 1 1 "CodeInit_State" 2 2 "WarmInit_State" 3 3 "Run_State" 4 4 "SoftDisable_State" 5 5 "HardDisable_State" 6 6 "CtrlDisable_State" 7 7 "ShutDown_State" 8 8 "SystemTest_State" DEFAULT_VALUE "" /end COMPU_VTAB_RANGE
/begin COMPU_VTAB_RANGE _enum "" 9 0 0 "PowerOff_State" 1 1 "CodeInit_State" 2 2 "WarmInit_State" 3 3 "Run_State" 4 4 "SoftDisable_State" 5 5 "HardDisable_State" 6 6 "CtrlDisable_State" 7 7 "ShutDown_State" 8 8 "SystemTest_State" DEFAULT_VALUE "" /end COMPU_VTAB_RANGE
/begin COMPU_VTAB_RANGE _enum "" 9 0 0 "PowerOff_State" 1 1 "CodeInit_State" 2 2 "WarmInit_State" 3 3 "Run_State" 4 4 "SoftDisable_State" 5 5 "HardDisable_State" 6 6 "CtrlDisable_State" 7 7 "ShutDown_State" 8 8 "SystemTest_State" DEFAULT_VALUE "" /end COMPU_VTAB_RANGE
/begin COMPU_VTAB_RANGE _enum "" 9 0 0 "PowerOff_State" 1 1 "CodeInit_State" 2 2 "WarmInit_State" 3 3 "Run_State" 4 4 "SoftDisable_State" 5 5 "HardDisable_State" 6 6 "CtrlDisable_State" 7 7 "ShutDown_State" 8 8 "SystemTest_State" DEFAULT_VALUE "" /end COMPU_VTAB_RANGE
/begin COMPU_VTAB_RANGE _enum "" 9 0 0 "PowerOff_State" 1 1 "CodeInit_State" 2 2 "WarmInit_State" 3 3 "Run_State" 4 4 "SoftDisable_State" 5 5 "HardDisable_State" 6 6 "CtrlDisable_State" 7 7 "ShutDown_State" 8 8 "SystemTest_State" DEFAULT_VALUE "" /end COMPU_VTAB_RANGE
/begin COMPU_VTAB_RANGE _enum "" 9 0 0 "PowerOff_State" 1 1 "CodeInit_State" 2 2 "WarmInit_State" 3 3 "Run_State" 4 4 "SoftDisable_State" 5 5 "HardDisable_State" 6 6 "CtrlDisable_State" 7 7 "ShutDown_State" 8 8 "SystemTest_State" DEFAULT_VALUE "" /end COMPU_VTAB_RANGE
/begin COMPU_VTAB_RANGE _enum "" 9 0 0 "PowerOff_State" 1 1 "CodeInit_State" 2 2 "WarmInit_State" 3 3 "Run_State" 4 4 "SoftDisable_State" 5 5 "HardDisable_State" 6 6 "CtrlDisable_State" 7 7 "ShutDown_State" 8 8 "SystemTest_State" DEFAULT_VALUE "" /end COMPU_VTAB_RANGE
/begin COMPU_VTAB_RANGE _enum "" 9 0 0 "PowerOff_State" 1 1 "CodeInit_State" 2 2 "WarmInit_State" 3 3 "Run_State" 4 4 "SoftDisable_State" 5 5 "HardDisable_State" 6 6 "CtrlDisable_State" 7 7 "ShutDown_State" 8 8 "SystemTest_State" DEFAULT_VALUE "" /end COMPU_VTAB_RANGE
/begin COMPU_VTAB_RANGE _enum "" 9 0 0 "PowerOff_State" 1 1 "CodeInit_State" 2 2 "WarmInit_State" 3 3 "Run_State" 4 4 "SoftDisable_State" 5 5 "HardDisable_State" 6 6 "CtrlDisable_State" 7 7 "ShutDown_State" 8 8 "SystemTest_State" DEFAULT_VALUE "" /end COMPU_VTAB_RANGE
/begin COMPU_VTAB boolean "" TAB_VERB 2 0 "false" 1 "true" DEFAULT_VALUE "" /end COMPU_VTAB
/begin COMPU_VTAB DBC_CC_State "" TAB_VERB 11 0 "空" 1 "A 未连接" 2 "B 断开" 3 "C 连接10A" 4 "C' 半连接10A" 5 "D 连接16A" 6 "D' 半连接16A" 7 "E 连接32A" 8 "E' 半连接32A" 9 "F 连接63A" 10 "F' 半连接63A" DEFAULT_VALUE "NONE" /end COMPU_VTAB
/begin COMPU_VTAB DBC_CP_State "" TAB_VERB 8 0 "normal" 1 "frequency low" 2 "frequency HIGH" 3 "DUTY LOW" 4 "DUTY HIGH" 5 "VOLT LOW" 6 "VOLT HIGH" 7 "null" DEFAULT_VALUE "NONE" /end COMPU_VTAB
/begin COMPU_VTAB En "" TAB_VERB 2 0 "Disable" 1 "Enable" DEFAULT_VALUE "" /end COMPU_VTAB
/begin COMPU_TAB Enable "" TAB_NOINTP 2 0 0 1 1 DEFAULT_VALUE "1" /end COMPU_TAB
/begin COMPU_VTAB OBC_STATE "" TAB_VERB 9 0 "STATE_INIT" 1 "STATE_STANDBY" 2 "STATE_PRECHARGE1" 3 "STATE_PFC_RUN" 4 "STATE_PRECHARGE2" 5 "STATE_OPETRATION" 6 "STATE_AFTER_RUN" 7 "STATE_SLEEP" 8 "STATE_FAILURE" DEFAULT_VALUE "" /end COMPU_VTAB
/begin COMPU_VTAB obcState "" TAB_VERB 10 0 "STATE_INIT" 1 "STATE_STANDBY" 2 "STATE_PRECHARGE1" 3 "STATE_PFC_RUN" 4 "STATE_PRECHARGE2" 5 "STATE_OPETRATION" 6 "STATE_AFTER_RUN" 7 "STATE_SLEEP" 8 "STATE_FAILURE" 9 "STATE_PREFAILURE" DEFAULT_VALUE "NONE" /end COMPU_VTAB
/begin COMPU_VTAB relayCtrl "继电器控制状态" TAB_VERB 2 0 "open" 1 "close" DEFAULT_VALUE "" /end COMPU_VTAB
/begin COMPU_METHOD _bool "enumeration table" TAB_VERB "%.15" "" COMPU_TAB_REF boolean /end COMPU_METHOD
/begin COMPU_METHOD _enum "enumeration table" TAB_VERB "" "" COMPU_TAB_REF _enum /end COMPU_METHOD
/begin COMPU_METHOD _enum "enumeration table" TAB_VERB "" "" COMPU_TAB_REF _enum /end COMPU_METHOD
/begin COMPU_METHOD _enum "enumeration table" TAB_VERB "" "" COMPU_TAB_REF _enum /end COMPU_METHOD
/begin COMPU_METHOD _enum "enumeration table" TAB_VERB "" "" COMPU_TAB_REF _enum /end COMPU_METHOD
/begin COMPU_METHOD _enum "enumeration table" TAB_VERB "" "" COMPU_TAB_REF _enum /end COMPU_METHOD
/begin COMPU_METHOD _enum "enumeration table" TAB_VERB "" "" COMPU_TAB_REF _enum /end COMPU_METHOD
/begin COMPU_METHOD _enum_Copy1 "enumeration table" TAB_VERB "" "" COMPU_TAB_REF _enum /end COMPU_METHOD
/begin COMPU_METHOD _enum_Copy10 "enumeration table" TAB_VERB "" "" COMPU_TAB_REF _enum /end COMPU_METHOD
/begin COMPU_METHOD _enum_Copy11 "enumeration table" TAB_VERB "" "" COMPU_TAB_REF _enum /end COMPU_METHOD
/begin COMPU_METHOD _enum_Copy12 "enumeration table" TAB_VERB "" "" COMPU_TAB_REF _enum /end COMPU_METHOD
/begin COMPU_METHOD _enum_Copy13 "enumeration table" TAB_VERB "" "" COMPU_TAB_REF _enum /end COMPU_METHOD
/begin COMPU_METHOD _enum_Copy14 "enumeration table" TAB_VERB "" "" COMPU_TAB_REF _enum /end COMPU_METHOD
/begin COMPU_METHOD _enum_Copy15 "enumeration table" TAB_VERB "" "" COMPU_TAB_REF _enum /end COMPU_METHOD
/begin COMPU_METHOD _enum_Copy16 "enumeration table" TAB_VERB "" "" COMPU_TAB_REF _enum /end COMPU_METHOD
/begin COMPU_METHOD _enum_Copy17 "enumeration table" TAB_VERB "" "" COMPU_TAB_REF _enum /end COMPU_METHOD
/begin COMPU_METHOD _enum_Copy18 "enumeration table" TAB_VERB "" "" COMPU_TAB_REF _enum /end COMPU_METHOD
/begin COMPU_METHOD _enum_Copy19 "enumeration table" TAB_VERB "" "" COMPU_TAB_REF _enum /end COMPU_METHOD
/begin COMPU_METHOD _enum_Copy2 "enumeration table" TAB_VERB "" "" COMPU_TAB_REF _enum /end COMPU_METHOD
/begin COMPU_METHOD _enum_Copy20 "enumeration table" TAB_VERB "" "" COMPU_TAB_REF _enum /end COMPU_METHOD
/begin COMPU_METHOD _enum_Copy21 "enumeration table" TAB_VERB "" "" COMPU_TAB_REF _enum /end COMPU_METHOD
/begin COMPU_METHOD _enum_Copy22 "enumeration table" TAB_VERB "" "" COMPU_TAB_REF _enum /end COMPU_METHOD
/begin COMPU_METHOD _enum_Copy23 "enumeration table" TAB_VERB "" "" COMPU_TAB_REF _enum /end COMPU_METHOD
/begin COMPU_METHOD _enum_Copy24 "enumeration table" TAB_VERB "" "" COMPU_TAB_REF _enum /end COMPU_METHOD
/begin COMPU_METHOD _enum_Copy25 "enumeration table" TAB_VERB "" "" COMPU_TAB_REF _enum /end COMPU_METHOD
/begin COMPU_METHOD _enum_Copy26 "enumeration table" TAB_VERB "" "" COMPU_TAB_REF _enum /end COMPU_METHOD
/begin COMPU_METHOD _enum_Copy27 "enumeration table" TAB_VERB "" "" COMPU_TAB_REF _enum /end COMPU_METHOD
/begin COMPU_METHOD _enum_Copy28 "enumeration table" TAB_VERB "" "" COMPU_TAB_REF _enum /end COMPU_METHOD
/begin COMPU_METHOD _enum_Copy29 "enumeration table" TAB_VERB "" "" COMPU_TAB_REF _enum /end COMPU_METHOD
/begin COMPU_METHOD _enum_Copy3 "enumeration table" TAB_VERB "" "" COMPU_TAB_REF _enum /end COMPU_METHOD
/begin COMPU_METHOD _enum_Copy30 "enumeration table" TAB_VERB "" "" COMPU_TAB_REF _enum /end COMPU_METHOD
/begin COMPU_METHOD _enum_Copy31 "enumeration table" TAB_VERB "" "" COMPU_TAB_REF _enum /end COMPU_METHOD
/begin COMPU_METHOD _enum_Copy32 "enumeration table" TAB_VERB "" "" COMPU_TAB_REF _enum /end COMPU_METHOD
/begin COMPU_METHOD _enum_Copy33 "enumeration table" TAB_VERB "" "" COMPU_TAB_REF _enum /end COMPU_METHOD
/begin COMPU_METHOD _enum_Copy34 "enumeration table" TAB_VERB "" "" COMPU_TAB_REF _enum /end COMPU_METHOD
/begin COMPU_METHOD _enum_Copy35 "enumeration table" TAB_VERB "" "" COMPU_TAB_REF _enum /end COMPU_METHOD
/begin COMPU_METHOD _enum_Copy36 "enumeration table" TAB_VERB "" "" COMPU_TAB_REF _enum /end COMPU_METHOD
/begin COMPU_METHOD _enum_Copy37 "enumeration table" TAB_VERB "" "" COMPU_TAB_REF _enum /end COMPU_METHOD
/begin COMPU_METHOD _enum_Copy38 "enumeration table" TAB_VERB "" "" COMPU_TAB_REF _enum /end COMPU_METHOD
/begin COMPU_METHOD _enum_Copy39 "enumeration table" TAB_VERB "" "" COMPU_TAB_REF _enum /end COMPU_METHOD
/begin COMPU_METHOD _enum_Copy4 "enumeration table" TAB_VERB "" "" COMPU_TAB_REF _enum /end COMPU_METHOD
/begin COMPU_METHOD _enum_Copy40 "enumeration table" TAB_VERB "" "" COMPU_TAB_REF _enum /end COMPU_METHOD
/begin COMPU_METHOD _enum_Copy41 "enumeration table" TAB_VERB "" "" COMPU_TAB_REF _enum /end COMPU_METHOD
/begin COMPU_METHOD _enum_Copy42 "enumeration table" TAB_VERB "" "" COMPU_TAB_REF _enum /end COMPU_METHOD
/begin COMPU_METHOD _enum_Copy43 "enumeration table" TAB_VERB "" "" COMPU_TAB_REF _enum /end COMPU_METHOD
/begin COMPU_METHOD _enum_Copy44 "enumeration table" TAB_VERB "" "" COMPU_TAB_REF _enum /end COMPU_METHOD
/begin COMPU_METHOD _enum_Copy45 "enumeration table" TAB_VERB "" "" COMPU_TAB_REF _enum /end COMPU_METHOD
/begin COMPU_METHOD _enum_Copy46 "enumeration table" TAB_VERB "" "" COMPU_TAB_REF _enum /end COMPU_METHOD
/begin COMPU_METHOD _enum_Copy47 "enumeration table" TAB_VERB "" "" COMPU_TAB_REF _enum /end COMPU_METHOD
/begin COMPU_METHOD _enum_Copy48 "enumeration table" TAB_VERB "" "" COMPU_TAB_REF _enum /end COMPU_METHOD
/begin COMPU_METHOD _enum_Copy49 "enumeration table" TAB_VERB "" "" COMPU_TAB_REF _enum /end COMPU_METHOD
/begin COMPU_METHOD _enum_Copy5 "enumeration table" TAB_VERB "" "" COMPU_TAB_REF _enum /end COMPU_METHOD
/begin COMPU_METHOD _enum_Copy50 "enumeration table" TAB_VERB "" "" COMPU_TAB_REF _enum /end COMPU_METHOD
/begin COMPU_METHOD _enum_Copy51 "enumeration table" TAB_VERB "" "" COMPU_TAB_REF _enum /end COMPU_METHOD
/begin COMPU_METHOD _enum_Copy52 "enumeration table" TAB_VERB "" "" COMPU_TAB_REF _enum /end COMPU_METHOD
/begin COMPU_METHOD _enum_Copy53 "enumeration table" TAB_VERB "" "" COMPU_TAB_REF _enum /end COMPU_METHOD
/begin COMPU_METHOD _enum_Copy54 "enumeration table" TAB_VERB "" "" COMPU_TAB_REF _enum /end COMPU_METHOD
/begin COMPU_METHOD _enum_Copy55 "enumeration table" TAB_VERB "" "" COMPU_TAB_REF _enum /end COMPU_METHOD
/begin COMPU_METHOD _enum_Copy56 "enumeration table" TAB_VERB "" "" COMPU_TAB_REF _enum /end COMPU_METHOD
/begin COMPU_METHOD _enum_Copy57 "enumeration table" TAB_VERB "" "" COMPU_TAB_REF _enum /end COMPU_METHOD
/begin COMPU_METHOD _enum_Copy58 "enumeration table" TAB_VERB "" "" COMPU_TAB_REF _enum /end COMPU_METHOD
/begin COMPU_METHOD _enum_Copy59 "enumeration table" TAB_VERB "" "" COMPU_TAB_REF _enum /end COMPU_METHOD
/begin COMPU_METHOD _enum_Copy6 "enumeration table" TAB_VERB "" "" COMPU_TAB_REF _enum /end COMPU_METHOD
/begin COMPU_METHOD _enum_Copy60 "enumeration table" TAB_VERB "" "" COMPU_TAB_REF _enum /end COMPU_METHOD
/begin COMPU_METHOD _enum_Copy61 "enumeration table" TAB_VERB "" "" COMPU_TAB_REF _enum /end COMPU_METHOD
/begin COMPU_METHOD _enum_Copy62 "enumeration table" TAB_VERB "" "" COMPU_TAB_REF _enum /end COMPU_METHOD
/begin COMPU_METHOD _enum_Copy63 "enumeration table" TAB_VERB "" "" COMPU_TAB_REF _enum /end COMPU_METHOD
/begin COMPU_METHOD _enum_Copy64 "enumeration table" TAB_VERB "" "" COMPU_TAB_REF _enum /end COMPU_METHOD
/begin COMPU_METHOD _enum_Copy65 "enumeration table" TAB_VERB "" "" COMPU_TAB_REF _enum /end COMPU_METHOD
/begin COMPU_METHOD _enum_Copy66 "enumeration table" TAB_VERB "" "" COMPU_TAB_REF _enum /end COMPU_METHOD
/begin COMPU_METHOD _enum_Copy67 "enumeration table" TAB_VERB "" "" COMPU_TAB_REF _enum /end COMPU_METHOD
/begin COMPU_METHOD _enum_Copy68 "enumeration table" TAB_VERB "" "" COMPU_TAB_REF _enum /end COMPU_METHOD
/begin COMPU_METHOD _enum_Copy69 "enumeration table" TAB_VERB "" "" COMPU_TAB_REF _enum /end COMPU_METHOD
/begin COMPU_METHOD _enum_Copy7 "enumeration table" TAB_VERB "" "" COMPU_TAB_REF _enum /end COMPU_METHOD
/begin COMPU_METHOD _enum_Copy70 "enumeration table" TAB_VERB "" "" COMPU_TAB_REF _enum /end COMPU_METHOD
/begin COMPU_METHOD _enum_Copy71 "enumeration table" TAB_VERB "" "" COMPU_TAB_REF _enum /end COMPU_METHOD
/begin COMPU_METHOD _enum_Copy72 "enumeration table" TAB_VERB "" "" COMPU_TAB_REF _enum /end COMPU_METHOD
/begin COMPU_METHOD _enum_Copy73 "enumeration table" TAB_VERB "" "" COMPU_TAB_REF _enum /end COMPU_METHOD
/begin COMPU_METHOD _enum_Copy8 "enumeration table" TAB_VERB "" "" COMPU_TAB_REF _enum /end COMPU_METHOD
/begin COMPU_METHOD _enum_Copy9 "enumeration table" TAB_VERB "" "" COMPU_TAB_REF _enum /end COMPU_METHOD
/begin COMPU_METHOD _relayCtrl "enumeration table" TAB_VERB "%.15" "" COMPU_TAB_REF relayCtrl /end COMPU_METHOD
/begin COMPU_METHOD AC_Current_CONVE "" RAT_FUNC "%3.1" "A" COEFFS 0 13.5167999956 511.999999832 0 0 1 /end COMPU_METHOD
/begin COMPU_METHOD AC_Volt_CONVE "" RAT_FUNC "%3.1" "V" COEFFS 0 1.024 512 0 0 1 /end COMPU_METHOD
/begin COMPU_METHOD AD_RelayCoil1_CONV "" RAT_FUNC "%3.1" "V" COEFFS 0 204.8 -0 0 0 1 /end COMPU_METHOD
/begin COMPU_METHOD Amp_p07 "" RAT_FUNC "%3.1" "Amp" COEFFS 0 128 -0 0 0 1 /end COMPU_METHOD
/begin COMPU_METHOD BMSTag.actVoltage.CONVERSION "@@@@RuleName created by CANape" RAT_FUNC "%3.1" "V" COEFFS 0 1 0 0 0 1 /end COMPU_METHOD
/begin COMPU_METHOD CC_Volt_CONVE "" RAT_FUNC "%3.1" "V" COEFFS 0 200 -0 0 0 1 /end COMPU_METHOD
/begin COMPU_METHOD CP_CurrentLimt.CONVERSION "@@@@RuleName created by CANape" RAT_FUNC "%3.1" "" COEFFS 0 1 0 0 0 1 /end COMPU_METHOD
/begin COMPU_METHOD CP_CurrentLimt1.CONVERSION "@@@@RuleName created by CANape" RAT_FUNC "%3.1" "" COEFFS 0 1 0 0 0 1 /end COMPU_METHOD
/begin COMPU_METHOD cp_pwm_width_percent.CONVERSION "@@@@RuleName created by CANape" RAT_FUNC "%12.4" "万分之" COEFFS 0 1 0 0 0 1 /end COMPU_METHOD
/begin COMPU_METHOD cp_pwm_width_percent_filter.CONVERSION "@@@@RuleName created by CANape" RAT_FUNC "%12.4" "万分之" COEFFS 0 1 0 0 0 1 /end COMPU_METHOD
/begin COMPU_METHOD CP_VOLT_CONVE "" RAT_FUNC "%3.1" "V" COEFFS 0 73.7539926724 -0 0 0 1 /end COMPU_METHOD
/begin COMPU_METHOD cpPwmWidthPFilterOffset.CONVERSION "@@@@RuleName created by CANape" RAT_FUNC "%12.4" "万分之" COEFFS 0 1 0 0 0 1 /end COMPU_METHOD
/begin COMPU_METHOD DBC_CC_State "" TAB_VERB "%3.1" "" COMPU_TAB_REF DBC_CC_State /end COMPU_METHOD
/begin COMPU_METHOD DBC_CP_State "" TAB_VERB "%3.1" "" COMPU_TAB_REF DBC_CP_State /end COMPU_METHOD
/begin COMPU_METHOD DBC_I_CONV "" RAT_FUNC "%3.2" "A" COEFFS 0 16 -0 0 0 1 /end COMPU_METHOD
/begin COMPU_METHOD DBC_TIME_CONV "" RAT_FUNC "%3.2" "MIN" COEFFS 0 1 0 0 0 1 /end COMPU_METHOD
/begin COMPU_METHOD DBC_V_CONV "" RAT_FUNC "%3.2" "Volt" COEFFS 0 2 -0 0 0 1 /end COMPU_METHOD
/begin COMPU_METHOD DcDc_Current "" RAT_FUNC "%3.3" "Amp" COEFFS 0 49.1519999597 122.879999917 0 0 1 /end COMPU_METHOD
/begin COMPU_METHOD DcDcVout "" RAT_FUNC "%3.2" "Volt" COEFFS 0 2.15276421112 -0 0 0 1 /end COMPU_METHOD
/begin COMPU_METHOD DCM_FaultCode_La.CONVERSION "@@@@RuleName created by CANape" RAT_FUNC "%3.1" "" COEFFS 0 1 0 0 0 1 /end COMPU_METHOD
/begin COMPU_METHOD deadTimeConv "" RAT_FUNC "%.15" "ns" COEFFS 0 0.12 -0 0 0 1 /end COMPU_METHOD
/begin COMPU_METHOD DegC_p01 "" RAT_FUNC "%3.1" "DegC" COEFFS 0 2 -0 0 0 1 /end COMPU_METHOD
/begin COMPU_METHOD DegC_p06 "" RAT_FUNC "%3.1" "DegC" COEFFS 0 64 -0 0 0 1 /end COMPU_METHOD
/begin COMPU_METHOD DegpSec "" RAT_FUNC "%3.1" "DegpSec" COEFFS 0 1 0 0 0 1 /end COMPU_METHOD
/begin COMPU_METHOD Degree_Uls_s16p15 "" RAT_FUNC "%3.1" "Degree" COEFFS 0 182.0444444 -0 0 0 1 /end COMPU_METHOD
/begin COMPU_METHOD derating_TEM.CONVERSION "@@@@RuleName created by CANape" RAT_FUNC "%12.4" "℃" COEFFS 0 1 0 0 0 1 /end COMPU_METHOD
/begin COMPU_METHOD dev1000 "" RAT_FUNC "%3.1" "A" COEFFS 0 1000 -0 0 0 1 /end COMPU_METHOD
/begin COMPU_METHOD Driver13V_CONVE "" RAT_FUNC "%3.1" "V" COEFFS 0 19.0243227679 -0 0 0 1 /end COMPU_METHOD
/begin COMPU_METHOD factorOne "" RAT_FUNC "%12.4" "" COEFFS 0 1 0 0 0 1 /end COMPU_METHOD
/begin COMPU_METHOD faultCodeTag.bit.CONVERSION "@@@@RuleName created by CANape" RAT_FUNC "%3.1" "" COEFFS 0 1 0 0 0 1 /end COMPU_METHOD
/begin COMPU_METHOD FRAC16 "" RAT_FUNC "%3.8" "" COEFFS 0 32768 -0 0 0 1 /end COMPU_METHOD
/begin COMPU_METHOD FRAC32 "" RAT_FUNC "%3.8" "" COEFFS 0 2147483648 -0 0 0 1 /end COMPU_METHOD
/begin COMPU_METHOD Kph_p01 "" RAT_FUNC "%3.1" "Kmp" COEFFS 0 2 -0 0 0 1 /end COMPU_METHOD
/begin COMPU_METHOD L3_Dcdc_IoutFilter_Tau_Ct_u16.CONVERSION "@@@@RuleName created by CANape" RAT_FUNC "%3.1" "" COEFFS 0 1 0 0 0 1 /end COMPU_METHOD
/begin COMPU_METHOD L3_I_AD_CP_Filter_Tau_Ct_u16.CONVERSION "@@@@RuleName created by CANape" RAT_FUNC "%3.1" "" COEFFS 0 1 0 0 0 1 /end COMPU_METHOD
/begin COMPU_METHOD l5_CurrentLimtTimer.CONVERSION "@@@@RuleName created by CANape" RAT_FUNC "%3.1" "" COEFFS 0 1 0 0 0 1 /end COMPU_METHOD
/begin COMPU_METHOD L5_currentPowerLimt.CONVERSION "@@@@RuleName created by CANape" RAT_FUNC "%3.1" "w" COEFFS 0 1 0 0 0 1 /end COMPU_METHOD
/begin COMPU_METHOD L5_InputPowerLimt.CONVERSION "@@@@RuleName created by CANape" RAT_FUNC "%3.1" "w" COEFFS 0 1 0 0 0 1 /end COMPU_METHOD
/begin COMPU_METHOD l5_limtOutputVoltage.CONVERSION "@@@@RuleName created by CANape" RAT_FUNC "%3.1" "" COEFFS 0 1 0 0 0 1 /end COMPU_METHOD
/begin COMPU_METHOD l5_limtRampCnt.CONVERSION "@@@@RuleName created by CANape" RAT_FUNC "%3.1" "" COEFFS 0 1 0 0 0 1 /end COMPU_METHOD
/begin COMPU_METHOD L5_outPowerLimt.CONVERSION "@@@@RuleName created by CANape" RAT_FUNC "%3.1" "w" COEFFS 0 1 0 0 0 1 /end COMPU_METHOD
/begin COMPU_METHOD l5_powerLimtTimer.CONVERSION "@@@@RuleName created by CANape" RAT_FUNC "%3.1" "" COEFFS 0 1 0 0 0 1 /end COMPU_METHOD
/begin COMPU_METHOD MtrNm_p11 "" RAT_FUNC "%3.2" "Nm" COEFFS 0 2048 -0 0 0 1 /end COMPU_METHOD
/begin COMPU_METHOD OBCPOWERTag.ACInputPowLimt.CONVERSION "@@@@RuleName created by CANape" RAT_FUNC "%12.4" "w" COEFFS 0 1 0 0 0 1 /end COMPU_METHOD
/begin COMPU_METHOD obcState "" TAB_VERB "%3.1" "" COMPU_TAB_REF obcState /end COMPU_METHOD
/begin COMPU_METHOD OBCTag.chrFB_TEM.CONVERSION "@@@@RuleName created by CANape" RAT_FUNC "%12.4" "℃" COEFFS 0 1 0 0 0 1 /end COMPU_METHOD
/begin COMPU_METHOD OBCTag.chrPCB_TEM.CONVERSION "@@@@RuleName created by CANape" RAT_FUNC "%3.1" "℃" COEFFS 0 1 0 0 0 1 /end COMPU_METHOD
/begin COMPU_METHOD OBCTag.ChrTemp.CONVERSION "@@@@RuleName created by CANape" RAT_FUNC "%3.1" "" COEFFS 0 1 0 0 0 1 /end COMPU_METHOD
/begin COMPU_METHOD PFC_Volt_CONVE "" RAT_FUNC "%3.1" "V" COEFFS 0 1.58105599951 -0 0 0 1 /end COMPU_METHOD
/begin COMPU_METHOD PFCVout "" RAT_FUNC "%3.2" "Volt" COEFFS 0 1.69983999899 -0 0 0 1 /end COMPU_METHOD
/begin COMPU_METHOD pici_Current "" RAT_FUNC "%3.2" "Volt" COEFFS 0 22.5280000231 -0 0 0 1 /end COMPU_METHOD
/begin COMPU_METHOD Rad_p10 "" RAT_FUNC "%3.2" "rad" COEFFS 0 1024 -0 0 0 1 /end COMPU_METHOD
/begin COMPU_METHOD RadpSec_p02 "" RAT_FUNC "%3.1" "" COEFFS 0 4 -0 0 0 1 /end COMPU_METHOD
/begin COMPU_METHOD RadpSec_p03 "" RAT_FUNC "%3.1" "" COEFFS 0 8 -0 0 0 1 /end COMPU_METHOD
/begin COMPU_METHOD RadpSec_p04 "" RAT_FUNC "%3.2" "RadpSec" COEFFS 0 16 -0 0 0 1 /end COMPU_METHOD
/begin COMPU_METHOD RadpSec_p05 "" RAT_FUNC "%3.1" "RadpSec" COEFFS 0 32 -0 0 0 1 /end COMPU_METHOD
/begin COMPU_METHOD rpm "" RAT_FUNC "%1.1" "rpm" COEFFS 0 1 0 0 0 1 /end COMPU_METHOD
/begin COMPU_METHOD Uint "" RAT_FUNC "%3.1" "" COEFFS 0 1 0 0 0 1 /end COMPU_METHOD
/begin COMPU_METHOD Uls_p04 "" RAT_FUNC "%3.1" "Uls" COEFFS 0 16 -0 0 0 1 /end COMPU_METHOD
/begin COMPU_METHOD Uls_p08 "" RAT_FUNC "%3.1" "Uls" COEFFS 0 256 -0 0 0 1 /end COMPU_METHOD
/begin COMPU_METHOD Uls_p10 "" RAT_FUNC "%3.1" "Uls" COEFFS 0 1024 -0 0 0 1 /end COMPU_METHOD
/begin COMPU_METHOD Uls_p11 "" RAT_FUNC "%4.4" "Uls" COEFFS 0 2048 -0 0 0 1 /end COMPU_METHOD
/begin COMPU_METHOD Uls_p12 "" RAT_FUNC "%5.5" "Uls" COEFFS 0 4096 -0 0 0 1 /end COMPU_METHOD
/begin COMPU_METHOD Uls_p14 "" RAT_FUNC "%3.3" "Uls" COEFFS 0 16384 -0 0 0 1 /end COMPU_METHOD
/begin COMPU_METHOD Uls_p15 "" RAT_FUNC "%3.3" "Uls" COEFFS 0 32767.99999 -0 0 0 1 /end COMPU_METHOD
/begin COMPU_METHOD Uls_p16 "" RAT_FUNC "%3.1" "Uls" COEFFS 0 65536 -0 0 0 1 /end COMPU_METHOD
/begin COMPU_METHOD Uls_p19 "" RAT_FUNC "%3.1" "Uls" COEFFS 0 524288 -0 0 0 1 /end COMPU_METHOD
/begin COMPU_METHOD Uls_p20 "" RAT_FUNC "%8.8" "Uls" COEFFS 0 1048576 -0 0 0 1 /end COMPU_METHOD
/begin COMPU_METHOD uls_p26 "" RAT_FUNC "%3.1" "" COEFFS 0 67108864 -0 0 0 1 /end COMPU_METHOD
/begin COMPU_METHOD Volt12_CONVE "" RAT_FUNC "%3.1" "V" COEFFS 0 45.7124885604 -0 0 0 1 /end COMPU_METHOD
/begin COMPU_METHOD Volt13_CONVE "" RAT_FUNC "%3.1" "V" COEFFS 0 19.0243227679 -0 0 0 1 /end COMPU_METHOD
/begin COMPU_METHOD Volt_p06 "" RAT_FUNC "%3.1" "Volt" COEFFS 0 64 -0 0 0 1 /end COMPU_METHOD
/begin COMPU_METHOD Volt_p07 "" RAT_FUNC "%3.1" "Volt" COEFFS 0 128 -0 0 0 1 /end COMPU_METHOD
/begin COMPU_METHOD Volt_p08 "" RAT_FUNC "%3.1" "Volt" COEFFS 0 256 -0 0 0 1 /end COMPU_METHOD
/begin COMPU_METHOD Volt_p10 "" RAT_FUNC "%3.3" "volt" COEFFS 0 1024 -0 0 0 1 /end COMPU_METHOD
/begin MEASUREMENT BMSTag.ACChrRlySt "" UBYTE _relayCtrl 0 0 0 255 ECU_ADDRESS 0x400025EA /end MEASUREMENT
/begin MEASUREMENT BMSTag.CCState "" UBYTE DBC_CC_State 0 0 0 255 ECU_ADDRESS 0x400025E8 FORMAT "%.15" /end MEASUREMENT
/begin MEASUREMENT BMSTag.ChrCurrentSp "" UWORD DBC_I_CONV 0 0 0 65535 ECU_ADDRESS 0x400025EE FORMAT "%.15" /end MEASUREMENT
/begin MEASUREMENT BMSTag.ChrTimeRemain "" UWORD DBC_TIME_CONV 0 0 0 65535 ECU_ADDRESS 0x400025EC FORMAT "%.15" /end MEASUREMENT
/begin MEASUREMENT BMSTag.ChrVoltSp "" UWORD DBC_V_CONV 0 0 0 65535 ECU_ADDRESS 0x400025F0 FORMAT "%.15" /end MEASUREMENT
/begin MEASUREMENT BMSTag.EnCharger "" UBYTE _bool 0 0 0 255 ECU_ADDRESS 0x400025E9 /end MEASUREMENT
/begin MEASUREMENT BMSTag.actVoltage "" UWORD BMSTag.actVoltage.CONVERSION 0 0 0 65535 ECU_ADDRESS 0x400025F2 FORMAT "%.15" /end MEASUREMENT
/begin MEASUREMENT BMS_CHARGE_OVER "" UBYTE _bool 0 0 0 255 ECU_ADDRESS 0x40001A39 /end MEASUREMENT
/begin MEASUREMENT CMDEnchargeStateDiagStart "" UBYTE _bool 0 0 0 255 ECU_ADDRESS 0x40001A6A /end MEASUREMENT
/begin MEASUREMENT CP_CurrentLimt "" UWORD CP_CurrentLimt.CONVERSION 0 0 0 65535 ECU_ADDRESS 0x400019FC FORMAT "%.15" /end MEASUREMENT
/begin MEASUREMENT CP_CurrentLimt1 "" UWORD CP_CurrentLimt1.CONVERSION 0 0 0 65535 ECU_ADDRESS 0x400019FA FORMAT "%.15" /end MEASUREMENT
/begin CHARACTERISTIC DCM_FaultCode_La "" CURVE 0x400059D8 ECTEK_Value_u8 0 DCM_FaultCode_La.CONVERSION 0 255 READ_ONLY
 /begin AXIS_DESCR FIX_AXIS NO_INPUT_QUANTITY NO_COMPU_METHOD 256 0 255 READ_ONLY FORMAT "%.15" FIX_AXIS_PAR_DIST 0 1 256 /end AXIS_DESCR
 FORMAT "%.15" /end CHARACTERISTIC
/begin CHARACTERISTIC DTC_DIAGE_CLEAR "" VALUE 0x40001D25 __UBYTE_S 0 _bool 0 255 /end CHARACTERISTIC
/begin MEASUREMENT DTC_DIAGE_RESART "" UBYTE _bool 0 0 0 255 ECU_ADDRESS 0x40001D24 /end MEASUREMENT
/begin MEASUREMENT DTC_DIAGE_START "" UBYTE _bool 0 0 0 255 ECU_ADDRESS 0x40001D23 /end MEASUREMENT
/begin MEASUREMENT HW_I_GLB_EN "" UBYTE _bool 0 0 0 255 ECU_ADDRESS 0x40001A47 /end MEASUREMENT
/begin MEASUREMENT HW_O_GLB_RSET "" UBYTE _bool 0 0 0 255 ECU_ADDRESS 0x40001A42 /end MEASUREMENT
/begin MEASUREMENT HW_O_MCU_FAT "" UBYTE _bool 0 0 0 255 ECU_ADDRESS 0x40001A41 /end MEASUREMENT
/begin MEASUREMENT HW_O_PFC_EN "" UBYTE _bool 0 0 0 255 ECU_ADDRESS 0x40001A40 /end MEASUREMENT
/begin MEASUREMENT HW_O_PG "" UBYTE _bool 0 0 0 255 ECU_ADDRESS 0x40001A45 /end MEASUREMENT
/begin MEASUREMENT HW_O_S_RlyCTL1 "" UBYTE _bool 0 0 0 255 ECU_ADDRESS 0x40001A43 /end MEASUREMENT
/begin MEASUREMENT HW_PG_SENSE "" UBYTE _bool 0 0 0 255 ECU_ADDRESS 0x40001A44 /end MEASUREMENT
/begin MEASUREMENT HW_S2_CTR "" UBYTE _bool 0 0 0 255 ECU_ADDRESS 0x40001A46 /end MEASUREMENT
/begin MEASUREMENT K_I_GLB_EN "" UBYTE factorOne 0 0 0 255 ECU_ADDRESS 0x4000181C FORMAT "%.15" /end MEASUREMENT
/begin MEASUREMENT L3_AD0_AC_Volt_fast_Ct_u16 "" UWORD AC_Volt_CONVE 0 0 0 0 ECU_ADDRESS 0x40001942 /end MEASUREMENT
/begin MEASUREMENT L3_AD0_AC_Volt_fast_max_Ct_u16 "" UWORD AC_Volt_CONVE 0 0 0 63487.0234375 ECU_ADDRESS 0x40001940 /end MEASUREMENT
/begin MEASUREMENT L3_CP_Duty_ms_u16p12 "" UWORD factorOne 0 0 0 65535 READ_WRITE ECU_ADDRESS 0x40001AB2 FORMAT "%.15" /end MEASUREMENT
/begin MEASUREMENT L3_CP_Per_ms_u16p12 "" UWORD factorOne 0 0 0 65535 ECU_ADDRESS 0x40001AB4 FORMAT "%.15" /end MEASUREMENT
/begin MEASUREMENT L3_Dcdc_IoutFilter_Ct_u16 "" UWORD DcDc_Current 0 0 0 65535 ECU_ADDRESS 0x4000194A FORMAT "%.15" /end MEASUREMENT
/begin CHARACTERISTIC L3_Dcdc_IoutFilter_Tau_Ct_u16 "" VALUE 0x40001850 __UWORD_S 0 L3_Dcdc_IoutFilter_Tau_Ct_u16.CONVERSION 0 65535 FORMAT "%.15" /end CHARACTERISTIC
/begin MEASUREMENT L3_Dcdc_Iout_Ct_u16 "" UWORD DcDc_Current 0 0 0 20 ECU_ADDRESS 0x4000194C /end MEASUREMENT
/begin MEASUREMENT L3_Dcdc_Vout_Ct_u16 "" UWORD DcDcVout 0 0 0 800 ECU_ADDRESS 0x4000194E /end MEASUREMENT
/begin MEASUREMENT L3_HW_DCDC_OCP_u08 "" UBYTE _bool 0 0 0 255 ECU_ADDRESS 0x400019B8 /end MEASUREMENT
/begin MEASUREMENT L3_HW_DCDC_OVP_u08 "" UBYTE _bool 0 0 0 255 ECU_ADDRESS 0x400019B9 /end MEASUREMENT
/begin MEASUREMENT L3_I_AD_12V_CMM "" UWORD Volt12_CONVE 0 0 0 65535 ECU_ADDRESS 0x40001938 FORMAT "%.15" /end MEASUREMENT
/begin MEASUREMENT L3_I_AD_CC "" UWORD CC_Volt_CONVE 0 0 0 65535 ECU_ADDRESS 0x4000192A FORMAT "%.15" /end MEASUREMENT
/begin MEASUREMENT L3_I_AD_CP_Filter_Ct_u16 "" UWORD CP_VOLT_CONVE 0 0 0 65535 ECU_ADDRESS 0x40001948 FORMAT "%.15" /end MEASUREMENT
/begin CHARACTERISTIC L3_I_AD_CP_Filter_Tau_Ct_u16 "" VALUE 0x40001852 __UWORD_S 0 L3_I_AD_CP_Filter_Tau_Ct_u16.CONVERSION 0 65535 FORMAT "%.15" /end CHARACTERISTIC
/begin MEASUREMENT L3_I_AD_CP_max_buff_Ct_u16 "" UWORD CP_VOLT_CONVE 0 0 0 65535 ECU_ADDRESS 0x40001932 /end MEASUREMENT
/begin MEASUREMENT L3_I_AD_Curr_Input "" UWORD AC_Current_CONVE 0 0 0 65535 ECU_ADDRESS 0x4000193C /end MEASUREMENT
/begin MEASUREMENT L3_I_AD_Driver13V "" UWORD Driver13V_CONVE 0 0 0 65535 ECU_ADDRESS 0x4000193A FORMAT "%.15" /end MEASUREMENT
/begin MEASUREMENT L3_I_AD_FB_TEM "" UWORD factorOne 0 0 0 65535 ECU_ADDRESS 0x4000192C FORMAT "%.15" /end MEASUREMENT
/begin MEASUREMENT L3_I_AD_PCB_TEM "" UWORD factorOne 0 0 0 65535 ECU_ADDRESS 0x4000192E FORMAT "%.15" /end MEASUREMENT
/begin MEASUREMENT L3_I_AD_PFC_slow_Ct_u16 "" UWORD PFC_Volt_CONVE 0 0 0 32516.771467 ECU_ADDRESS 0x4000193E /end MEASUREMENT
/begin MEASUREMENT L3_I_AD_RelayCoil1 "" UWORD AD_RelayCoil1_CONV 0 0 0 65535 ECU_ADDRESS 0x40001930 FORMAT "%.15" /end MEASUREMENT
/begin MEASUREMENT L3_PriCurHigh_Ct_u16 "" UWORD pici_Current 0 0 0 1878.64060953 ECU_ADDRESS 0x40001946 /end MEASUREMENT
/begin MEASUREMENT L3_PriCurLow_Ct_u16 "" UWORD pici_Current 0 0 0 1878.64060953 ECU_ADDRESS 0x40001944 /end MEASUREMENT
/begin MEASUREMENT L3_last_OBC_Y_Ct_u16 "" UWORD factorOne 0 0 0 65535 ECU_ADDRESS 0x40001876 FORMAT "%.15" /end MEASUREMENT
/begin MEASUREMENT L3_loopChangeSetCt_u16 "" UWORD factorOne 0 0 0 65535 ECU_ADDRESS 0x400017F8 FORMAT "%.15" /end MEASUREMENT
/begin MEASUREMENT L5_AC_Volt_fast_maxBuffCPS "" UWORD AC_Volt_CONVE 0 0 0 65535 ECU_ADDRESS 0x40001A4C FORMAT "%.15" /end MEASUREMENT
/begin MEASUREMENT L5_AC_Volt_fast_max_buff "" UWORD AC_Volt_CONVE 0 0 0 63487.0234375 ECU_ADDRESS 0x40001A4E /end MEASUREMENT
/begin MEASUREMENT L5_AC_current_max_buff "" UWORD AC_Current_CONVE 0 0 0 65535 ECU_ADDRESS 0x40001A4A /end MEASUREMENT
/begin MEASUREMENT L5_CC_CurrentPhy_1000dLimt "" UWORD dev1000 0 0 0 65535 ECU_ADDRESS 0x400018E2 FORMAT "%.15" /end MEASUREMENT
/begin MEASUREMENT L5_CP_CurrentPhy_1000dLimt "" UWORD dev1000 0 0 0 65535 ECU_ADDRESS 0x400018E0 FORMAT "%.15" /end MEASUREMENT
/begin MEASUREMENT L5_InputPowerLimt "" UWORD L5_InputPowerLimt.CONVERSION 0 0 0 65535 ECU_ADDRESS 0x400018E6 FORMAT "%.15" /end MEASUREMENT
/begin CHARACTERISTIC L5_OBC_cmd "" VALUE 0x40001A34 __UBYTE_S 0 _bool 0 255 /end CHARACTERISTIC
/begin MEASUREMENT L5_OBC_model1_enable "" UBYTE _bool 0 0 0 255 ECU_ADDRESS 0x40001A35 /end MEASUREMENT
/begin CHARACTERISTIC L5_OBC_powerOnTest "" VALUE 0x400018AA __UBYTE_S 0 _bool 0 255 /end CHARACTERISTIC
/begin CHARACTERISTIC L5_PowerLimtEnable "" VALUE 0x400018E4 __UWORD_S 0 _bool 0 65535 /end CHARACTERISTIC
/begin MEASUREMENT L5_actInputCurrentE "" UWORD dev1000 0 0 0 65535 ECU_ADDRESS 0x40001A54 FORMAT "%.15" /end MEASUREMENT
/begin MEASUREMENT L5_currentPowerLimt "" UWORD L5_currentPowerLimt.CONVERSION 0 0 0 65535 ECU_ADDRESS 0x400018E8 FORMAT "%.15" /end MEASUREMENT
/begin MEASUREMENT L5_outPowerLimt "" UWORD L5_outPowerLimt.CONVERSION 0 0 0 65535 ECU_ADDRESS 0x400018EA FORMAT "%.15" /end MEASUREMENT
/begin MEASUREMENT OBCPOWERTag.ACInputPowLimt "" UWORD OBCPOWERTag.ACInputPowLimt.CONVERSION 0 0 0 65535 ECU_ADDRESS 0x400025B0 FORMAT "%.15" /end MEASUREMENT
/begin MEASUREMENT OBCPOWERTag.ACPowMaxCurrentLimt "" UWORD dev1000 0 0 0 65535 ECU_ADDRESS 0x400025B2 FORMAT "%3.3" /end MEASUREMENT
/begin MEASUREMENT OBCPOWERTag.ACPowSetVoltCurrentLimt "" UWORD DcDc_Current 0 0 0 65535 ECU_ADDRESS 0x400025B4 /end MEASUREMENT
/begin MEASUREMENT OBCPOWERTag.CANCmdSETCurrent "" UWORD DcDc_Current 0 0 0 65535 ECU_ADDRESS 0x400025BE /end MEASUREMENT
/begin MEASUREMENT OBCPOWERTag.CANCmdSETVolt "" UWORD DcDcVout 0 0 0 65535 ECU_ADDRESS 0x400025BC /end MEASUREMENT
/begin MEASUREMENT OBCPOWERTag.CCStateCurrentLimt "" UWORD DcDc_Current 0 0 0 65535 ECU_ADDRESS 0x400025B8 /end MEASUREMENT
/begin MEASUREMENT OBCPOWERTag.CPStateCurrentLimt "" UWORD DcDc_Current 0 0 0 65535 ECU_ADDRESS 0x400025BA /end MEASUREMENT
/begin MEASUREMENT OBCPOWERTag.MinCurrent "" UWORD DcDc_Current 0 0 0 65535 ECU_ADDRESS 0x400025C2 /end MEASUREMENT
/begin MEASUREMENT OBCPOWERTag.TEMPStateCurrentLimt "" UWORD DcDc_Current 0 0 0 65535 ECU_ADDRESS 0x400025B6 /end MEASUREMENT
/begin MEASUREMENT OBCTag.ChrOpMode "" UBYTE obcState 0 0 0 255 ECU_ADDRESS 0x400025CF FORMAT "%.15" /end MEASUREMENT
/begin MEASUREMENT OBCTag.ChrTemp "" UBYTE OBCTag.ChrTemp.CONVERSION 0 0 0 255 ECU_ADDRESS 0x400025CE FORMAT "%.15" /end MEASUREMENT
/begin MEASUREMENT OBCTag.FaultID "" UBYTE factorOne 0 0 0 255 ECU_ADDRESS 0x400025CD FORMAT "%.15" /end MEASUREMENT
/begin MEASUREMENT OBCTag.PowerLimit "" UBYTE _bool 0 0 0 255 ECU_ADDRESS 0x400025C5 /end MEASUREMENT
/begin MEASUREMENT OBCTag.ReqCloseRly "" UBYTE _bool 0 0 0 255 ECU_ADDRESS 0x400025C6 /end MEASUREMENT
/begin MEASUREMENT OBCTag.actChrCurrent "" UWORD DcDc_Current 0 0 0 911.77176352 ECU_ADDRESS 0x400025D2 /end MEASUREMENT
/begin MEASUREMENT OBCTag.actChrVolt "" UWORD DcDcVout 0 0 0 30046.4898802 ECU_ADDRESS 0x400025D0 /end MEASUREMENT
/begin MEASUREMENT OBCTag.bErrorCOM "" UBYTE _bool 0 0 0 255 ECU_ADDRESS 0x400025CC /end MEASUREMENT
/begin MEASUREMENT OBCTag.bFaultAC "" UBYTE _bool 0 0 0 255 ECU_ADDRESS 0x400025C9 /end MEASUREMENT
/begin MEASUREMENT OBCTag.bFaultCable "" UBYTE _bool 0 0 0 255 ECU_ADDRESS 0x400025C4 /end MEASUREMENT
/begin MEASUREMENT OBCTag.bFaultDC "" UBYTE _bool 0 0 0 255 ECU_ADDRESS 0x400025C8 /end MEASUREMENT
/begin MEASUREMENT OBCTag.bFaultHW "" UBYTE _bool 0 0 0 255 ECU_ADDRESS 0x400025CA /end MEASUREMENT
/begin MEASUREMENT OBCTag.bFilterCPDutyState "" UBYTE DBC_CP_State 0 0 0 255 ECU_ADDRESS 0x400025DD FORMAT "%.15" /end MEASUREMENT
/begin MEASUREMENT OBCTag.bFilterCPFrqState "" UBYTE DBC_CP_State 0 0 0 255 ECU_ADDRESS 0x400025DE FORMAT "%.15" /end MEASUREMENT
/begin MEASUREMENT OBCTag.bFilterCPState "" UBYTE DBC_CP_State 0 0 0 255 ECU_ADDRESS 0x400025DB FORMAT "%.15" /end MEASUREMENT
/begin MEASUREMENT OBCTag.bFilterCPVoltState "" UBYTE DBC_CP_State 0 0 0 255 ECU_ADDRESS 0x400025DC FORMAT "%.15" /end MEASUREMENT
/begin MEASUREMENT OBCTag.bOverTempCool "" UBYTE _bool 0 0 0 255 ECU_ADDRESS 0x400025CB /end MEASUREMENT
/begin MEASUREMENT OBCTag.bWakeUp "" UBYTE _bool 0 0 0 255 ECU_ADDRESS 0x400025C7 /end MEASUREMENT
/begin MEASUREMENT OBCTag.chrFB_TEM "" SWORD OBCTag.chrFB_TEM.CONVERSION 0 0 -32768 32767 ECU_ADDRESS 0x400025D4 FORMAT "%.15" /end MEASUREMENT
/begin MEASUREMENT OBCTag.chrPCB_TEM "" SWORD OBCTag.chrPCB_TEM.CONVERSION 0 0 -32768 32767 ECU_ADDRESS 0x400025D6 FORMAT "%.15" /end MEASUREMENT
/begin MEASUREMENT OBC_U.IoErr "" SWORD DcDc_Current 0 0 -20 20 ECU_ADDRESS 0x40001A22 /end MEASUREMENT
/begin MEASUREMENT OBC_U.PfcCurErr "" SWORD factorOne 0 0 -32768 32767 ECU_ADDRESS 0x40001A24 FORMAT "%.15" /end MEASUREMENT
/begin MEASUREMENT OBC_U.VoErr "" SWORD DcDcVout 0 0 -500 500 ECU_ADDRESS 0x40001A20 /end MEASUREMENT
/begin MEASUREMENT OBC_Y.Ct "" UWORD factorOne 0 0 0 65535 ECU_ADDRESS 0x40002598 FORMAT "%.15" /end MEASUREMENT
/begin MEASUREMENT OBC_Y.Ct1 "" SWORD factorOne 0 0 -32768 32767 ECU_ADDRESS 0x4000259C FORMAT "%.15" /end MEASUREMENT
/begin MEASUREMENT OBC_Y.CurrentLoopCt "" UWORD factorOne 0 0 0 65535 ECU_ADDRESS 0x400025A0 FORMAT "%.15" /end MEASUREMENT
/begin MEASUREMENT OBC_Y.VLOOPbIT "" UBYTE _bool 0 0 0 255 ECU_ADDRESS 0x4000259A /end MEASUREMENT
/begin MEASUREMENT OBC_Y.VloopCt "" UWORD factorOne 0 0 0 65535 ECU_ADDRESS 0x4000259E FORMAT "%.15" /end MEASUREMENT
/begin MEASUREMENT cpPwmWidthPFilterOffset "" ULONG cpPwmWidthPFilterOffset.CONVERSION 0 0 0 4294967295 ECU_ADDRESS 0x40001AC0 FORMAT "%.15" /end MEASUREMENT
/begin MEASUREMENT cp_pwm_width_percent "" ULONG cp_pwm_width_percent.CONVERSION 0 0 0 65535 ECU_ADDRESS 0x40001A90 FORMAT "%.15" /end MEASUREMENT
/begin MEASUREMENT cp_pwm_width_percent_filter "" ULONG cp_pwm_width_percent_filter.CONVERSION 0 0 0 65535 ECU_ADDRESS 0x40001AB8 FORMAT "%.15" /end MEASUREMENT
/begin CHARACTERISTIC derating_TEM "" VALUE 0x40001A5A __SWORD_S 0 derating_TEM.CONVERSION -32768 32767 FORMAT "%.15" /end CHARACTERISTIC
/begin MEASUREMENT enable_DCM_DTC "" UBYTE _bool 0 0 0 255 ECU_ADDRESS 0x40001D22 /end MEASUREMENT
/begin MEASUREMENT faultCodeTag.bit "" UBYTE faultCodeTag.bit.CONVERSION 0 0 0 255 ECU_ADDRESS 0x40001A50 FORMAT "%.15" /end MEASUREMENT
/begin MEASUREMENT faultCodeTag.bit.bCANBUSOFF "" UBYTE _bool 0 0 0 1 BIT_MASK 0x80 ECU_ADDRESS 0x40001A53 /end MEASUREMENT
/begin MEASUREMENT faultCodeTag.bit.bCANMissing "" UBYTE _bool 0 0 0 1 BIT_MASK 0x40 ECU_ADDRESS 0x40001A53 /end MEASUREMENT
/begin MEASUREMENT faultCodeTag.bit.bDriver13VFault "" UBYTE _bool 0 0 0 1 BIT_MASK 0x40 ECU_ADDRESS 0x40001A51 /end MEASUREMENT
/begin MEASUREMENT faultCodeTag.bit.bFaultCP "" UBYTE _bool 0 0 0 1 BIT_MASK 0x40 ECU_ADDRESS 0x40001A52 /end MEASUREMENT
/begin MEASUREMENT faultCodeTag.bit.bHWDCDC_OCP "" UBYTE _bool 0 0 0 1 BIT_MASK 0x2 ECU_ADDRESS 0x40001A50 /end MEASUREMENT
/begin MEASUREMENT faultCodeTag.bit.bINPUT_Relay "" UBYTE _bool 0 0 0 1 BIT_MASK 0x20 ECU_ADDRESS 0x40001A52 /end MEASUREMENT
/begin MEASUREMENT faultCodeTag.bit.bLV12VFault "" UBYTE _bool 0 0 0 1 BIT_MASK 0x20 ECU_ADDRESS 0x40001A51 /end MEASUREMENT
/begin MEASUREMENT faultCodeTag.bit.bOverACoutI "" UBYTE _bool 0 0 0 1 BIT_MASK 0x2 ECU_ADDRESS 0x40001A52 /end MEASUREMENT
/begin MEASUREMENT faultCodeTag.bit.bOverDCUoutI "" UBYTE _bool 0 0 0 1 BIT_MASK 0x40 ECU_ADDRESS 0x40001A50 /end MEASUREMENT
/begin MEASUREMENT faultCodeTag.bit.bOverDCUoutVolt "" UBYTE _bool 0 0 0 1 BIT_MASK 0x8 ECU_ADDRESS 0x40001A50 /end MEASUREMENT
/begin MEASUREMENT faultCodeTag.bit.bOverPFCUoutI "" UBYTE _bool 0 0 0 1 BIT_MASK 0x1 ECU_ADDRESS 0x40001A51 /end MEASUREMENT
/begin MEASUREMENT faultCodeTag.bit.bOverPFCUoutVolt "" UBYTE _bool 0 0 0 1 BIT_MASK 0x4 ECU_ADDRESS 0x40001A51 /end MEASUREMENT
/begin MEASUREMENT faultCodeTag.bit.bOverTempCool "" UBYTE _bool 0 0 0 1 BIT_MASK 0x1 ECU_ADDRESS 0x40001A50 /end MEASUREMENT
/begin MEASUREMENT faultCodeTag.bit.bOverUinVolt "" UBYTE _bool 0 0 0 1 BIT_MASK 0x20 ECU_ADDRESS 0x40001A50 /end MEASUREMENT
/begin MEASUREMENT faultCodeTag.bit.bPFCBoostFail "" UBYTE _bool 0 0 0 1 BIT_MASK 0x4 ECU_ADDRESS 0x40001A52 /end MEASUREMENT
/begin MEASUREMENT faultCodeTag.bit.bPG_SENS "" UBYTE _bool 0 0 0 1 BIT_MASK 0x8 ECU_ADDRESS 0x40001A52 /end MEASUREMENT
/begin MEASUREMENT faultCodeTag.bit.bStartShortCircuit "" UBYTE _bool 0 0 0 1 BIT_MASK 0x20 ECU_ADDRESS 0x40001A53 /end MEASUREMENT
/begin MEASUREMENT faultCodeTag.bit.bTempWarinOutOff "" UBYTE _bool 0 0 0 1 BIT_MASK 0x80 ECU_ADDRESS 0x40001A52 /end MEASUREMENT
/begin MEASUREMENT faultCodeTag.bit.bUinVoltOpen "" UBYTE _bool 0 0 0 1 BIT_MASK 0x1 ECU_ADDRESS 0x40001A52 /end MEASUREMENT
/begin MEASUREMENT faultCodeTag.bit.bUnderDCUoutVolt "" UBYTE _bool 0 0 0 1 BIT_MASK 0x4 ECU_ADDRESS 0x40001A50 /end MEASUREMENT
/begin MEASUREMENT faultCodeTag.bit.bUnderPFCUoutVolt "" UBYTE _bool 0 0 0 1 BIT_MASK 0x2 ECU_ADDRESS 0x40001A51 /end MEASUREMENT
/begin MEASUREMENT faultCodeTag.bit.bUnderUinVolt "" UBYTE _bool 0 0 0 1 BIT_MASK 0x10 ECU_ADDRESS 0x40001A50 /end MEASUREMENT
/begin MEASUREMENT faultCodeTag.bit.bloadDump "" UBYTE _bool 0 0 0 1 BIT_MASK 0x80 ECU_ADDRESS 0x40001A51 /end MEASUREMENT
/begin MEASUREMENT faultCodeTag.bit.boutputCurrentSenError "" UBYTE _bool 0 0 0 1 BIT_MASK 0x10 ECU_ADDRESS 0x40001A52 /end MEASUREMENT
/begin CHARACTERISTIC k_CurKi_Uls_s16p15 "" VALUE 0x40001888 __SWORD_S 0 factorOne -32768 32767 FORMAT "%.15" /end CHARACTERISTIC
/begin CHARACTERISTIC k_CurKp_Uls_s16p12 "" VALUE 0x4000188A __SWORD_S 0 factorOne -32768 32767 FORMAT "%.15" /end CHARACTERISTIC
/begin CHARACTERISTIC k_DcDcLoopType_u08 "" VALUE 0x4000188C __UBYTE_S 0 factorOne 0 255 FORMAT "%.15" /end CHARACTERISTIC
/begin CHARACTERISTIC k_DcDcTaskPer_u08 "" VALUE 0x40001869 __UBYTE_S 0 factorOne 0 255 FORMAT "%.15" /end CHARACTERISTIC
/begin MEASUREMENT k_Dcdc_Iref_Ct_u16 "" UWORD DcDc_Current 0 0 0 911.771763521 READ_WRITE ECU_ADDRESS 0x4000185E FORMAT "%.15" /end MEASUREMENT
/begin MEASUREMENT k_Dcdc_Vref_Ct_u16 "" UWORD DcDcVout 0 0 0 30046.4898802 READ_WRITE ECU_ADDRESS 0x4000185C FORMAT "%.15" /end MEASUREMENT
/begin CHARACTERISTIC k_PhaseAdvance_Ct_u16 "" VALUE 0x40001858 __UWORD_S 0 factorOne 0 65535 FORMAT "%.15" /end CHARACTERISTIC
/begin CHARACTERISTIC k_PianCiComp_Ct_s16 "" VALUE 0x400019A8 __SWORD_S 0 factorOne -100 100 FORMAT "%.15" /end CHARACTERISTIC
/begin CHARACTERISTIC k_PwmSelect_u08 "" VALUE 0x40001868 __UBYTE_S 0 factorOne 0 255 FORMAT "%.15" /end CHARACTERISTIC
/begin CHARACTERISTIC k_VoltKi_Uls_s16p15 "" VALUE 0x4000188E __SWORD_S 0 factorOne -32768 32767 FORMAT "%.15" /end CHARACTERISTIC
/begin CHARACTERISTIC k_VoltKp_Uls_s16p12 "" VALUE 0x40001890 __SWORD_S 0 factorOne -32768 32767 FORMAT "%.15" /end CHARACTERISTIC
/begin CHARACTERISTIC k_deadTime "" VALUE 0x4000186A __UWORD_S 0 deadTimeConv 0 546125 /end CHARACTERISTIC
/begin MEASUREMENT k_hardware_version_decimal "" UBYTE factorOne 0 0 0 255 ECU_ADDRESS 0x400018F1 FORMAT "%.15" /end MEASUREMENT
/begin MEASUREMENT k_hardware_version_integer "" UBYTE factorOne 0 0 0 255 ECU_ADDRESS 0x400018F0 FORMAT "%.15" /end MEASUREMENT
/begin MEASUREMENT k_software_data_version "" UBYTE factorOne 0 0 0 255 ECU_ADDRESS 0x400018F4 FORMAT "%.15" /end MEASUREMENT
/begin MEASUREMENT k_software_version_decimal "" UBYTE factorOne 0 0 0 255 ECU_ADDRESS 0x400018F3 FORMAT "%.15" /end MEASUREMENT
/begin MEASUREMENT k_software_version_integer "" UBYTE factorOne 0 0 0 255 ECU_ADDRESS 0x400018F2 FORMAT "%.15" /end MEASUREMENT
/begin CHARACTERISTIC l5_CurrentLimtTimer "" VALUE 0x400018A2 __UBYTE_S 0 l5_CurrentLimtTimer.CONVERSION 0 255 FORMAT "%.15" /end CHARACTERISTIC
/begin MEASUREMENT l5_limtOutputVoltage "" UWORD l5_limtOutputVoltage.CONVERSION 0 0 0 65535 ECU_ADDRESS 0x40001A56 FORMAT "%.15" /end MEASUREMENT
/begin CHARACTERISTIC l5_limtRampCnt "" VALUE 0x400018A4 __UBYTE_S 0 l5_limtRampCnt.CONVERSION 0 255 FORMAT "%.15" /end CHARACTERISTIC
/begin CHARACTERISTIC l5_powerLimtTimer "" VALUE 0x400018A3 __UBYTE_S 0 l5_powerLimtTimer.CONVERSION 0 255 FORMAT "%.15" /end CHARACTERISTIC
/begin MEASUREMENT mStateCntrTag.PFC_RUNCntr "" UWORD factorOne 0 0 0 65535 ECU_ADDRESS 0x400025FE FORMAT "%.15" /end MEASUREMENT
/begin MEASUREMENT mVARCntrTag.ACVoltCntr "" UWORD factorOne 0 0 0 65535 ECU_ADDRESS 0x40002610 FORMAT "%.15" /end MEASUREMENT
/begin MEASUREMENT mVARCntrTag.acVolt_pfcVol_errCntr "" UWORD factorOne 0 0 0 65535 ECU_ADDRESS 0x40002612 FORMAT "%.15" /end MEASUREMENT
/begin MEASUREMENT stSysFSMCtrl.ucCurrentState "" UBYTE obcState 0 0 0 255 ECU_ADDRESS 0x40001A2B FORMAT "%.15" /end MEASUREMENT
/begin MEASUREMENT stSysFSMCtrl.ucLastState "" UBYTE obcState 0 0 0 255 ECU_ADDRESS 0x40001A2A FORMAT "%.15" /end MEASUREMENT
/begin MEASUREMENT startOver "" UBYTE factorOne 0 0 0 255 ECU_ADDRESS 0x400019AA FORMAT "%.15" /end MEASUREMENT
/begin GROUP COM "Comment" ROOT
 /begin REF_MEASUREMENT BMSTag.ACChrRlySt BMSTag.CCState BMSTag.ChrCurrentSp BMSTag.ChrTimeRemain BMSTag.ChrVoltSp BMSTag.EnCharger BMSTag.actVoltage /end REF_MEASUREMENT
/end GROUP
/begin GROUP CurrentLoop "Comment" ROOT
 /begin REF_CHARACTERISTIC L3_Dcdc_IoutFilter_Tau_Ct_u16 k_CurKi_Uls_s16p15 k_CurKp_Uls_s16p12 /end REF_CHARACTERISTIC
 /begin REF_MEASUREMENT L3_Dcdc_IoutFilter_Ct_u16 k_Dcdc_Iref_Ct_u16 /end REF_MEASUREMENT
/end GROUP
/begin GROUP DCDC "Comment" ROOT
 /begin REF_CHARACTERISTIC k_DcDcLoopType_u08 k_DcDcTaskPer_u08 k_PhaseAdvance_Ct_u16 k_PianCiComp_Ct_s16 k_PwmSelect_u08 k_deadTime /end REF_CHARACTERISTIC
 /begin REF_MEASUREMENT L3_Dcdc_Iout_Ct_u16 L3_Dcdc_Vout_Ct_u16 L3_PriCurHigh_Ct_u16 L3_PriCurLow_Ct_u16 L3_last_OBC_Y_Ct_u16 L3_loopChangeSetCt_u16 OBC_U.IoErr OBC_U.PfcCurErr OBC_U.VoErr OBC_Y.Ct OBC_Y.Ct1 OBC_Y.CurrentLoopCt OBC_Y.VloopCt startOver /end REF_MEASUREMENT
/end GROUP
/begin GROUP diag "Comment" ROOT
 /begin REF_CHARACTERISTIC L3_I_AD_CP_Filter_Tau_Ct_u16 L5_OBC_cmd L5_OBC_powerOnTest derating_TEM /end REF_CHARACTERISTIC
 /begin REF_MEASUREMENT CP_CurrentLimt CP_CurrentLimt1 K_I_GLB_EN L3_AD0_AC_Volt_fast_Ct_u16 L3_CP_Duty_ms_u16p12 L3_CP_Per_ms_u16p12 L3_HW_DCDC_OCP_u08 L3_HW_DCDC_OVP_u08 L3_I_AD_CC L3_I_AD_CP_Filter_Ct_u16 L3_I_AD_CP_max_buff_Ct_u16 L3_I_AD_Curr_Input L3_I_AD_Driver13V L3_I_AD_FB_TEM L3_I_AD_PCB_TEM L3_I_AD_PFC_slow_Ct_u16 L5_AC_Volt_fast_maxBuffCPS OBCPOWERTag.ACInputPowLimt OBCPOWERTag.CANCmdSETCurrent OBCPOWERTag.CANCmdSETVolt OBCPOWERTag.CCStateCurrentLimt OBCPOWERTag.CPStateCurrentLimt OBCPOWERTag.MinCurrent OBCPOWERTag.TEMPStateCurrentLimt OBCTag.ChrOpMode OBCTag.ChrTemp OBCTag.FaultID OBCTag.PowerLimit OBCTag.ReqCloseRly OBCTag.actChrCurrent OBCTag.actChrVolt OBCTag.bErrorCOM OBCTag.bFaultAC OBCTag.bFaultCable OBCTag.bFaultDC OBCTag.bFaultHW OBCTag.bFilterCPDutyState OBCTag.bFilterCPFrqState OBCTag.bFilterCPState OBCTag.bFilterCPVoltState OBCTag.bOverTempCool OBCTag.bWakeUp OBCTag.chrFB_TEM OBCTag.chrPCB_TEM OBC_Y.VLOOPbIT cpPwmWidthPFilterOffset cp_pwm_width_percent cp_pwm_width_percent_filter faultCodeTag.bit faultCodeTag.bit.bCANBUSOFF faultCodeTag.bit.bCANMissing faultCodeTag.bit.bDriver13VFault faultCodeTag.bit.bFaultCP faultCodeTag.bit.bHWDCDC_OCP faultCodeTag.bit.bINPUT_Relay faultCodeTag.bit.bLV12VFault faultCodeTag.bit.bOverACoutI faultCodeTag.bit.bOverDCUoutI faultCodeTag.bit.bOverDCUoutVolt faultCodeTag.bit.bOverPFCUoutI faultCodeTag.bit.bOverPFCUoutVolt faultCodeTag.bit.bOverTempCool faultCodeTag.bit.bOverUinVolt faultCodeTag.bit.bPFCBoostFail faultCodeTag.bit.bPG_SENS faultCodeTag.bit.bStartShortCircuit faultCodeTag.bit.bTempWarinOutOff faultCodeTag.bit.bUinVoltOpen faultCodeTag.bit.bUnderDCUoutVolt faultCodeTag.bit.bUnderPFCUoutVolt faultCodeTag.bit.bUnderUinVolt faultCodeTag.bit.bloadDump faultCodeTag.bit.boutputCurrentSenError k_hardware_version_decimal k_hardware_version_integer k_software_data_version k_software_version_decimal k_software_version_integer mStateCntrTag.PFC_RUNCntr /end REF_MEASUREMENT
/end GROUP
/begin GROUP DTC "Comment" ROOT /begin REF_CHARACTERISTIC DCM_FaultCode_La DTC_DIAGE_CLEAR /end REF_CHARACTERISTIC
 /begin REF_MEASUREMENT DTC_DIAGE_RESART DTC_DIAGE_START L3_I_AD_12V_CMM L3_I_AD_Driver13V L3_I_AD_RelayCoil1 enable_DCM_DTC /end REF_MEASUREMENT
/end GROUP
/begin GROUP HW_IO "Comment" ROOT
 /begin REF_MEASUREMENT HW_I_GLB_EN HW_O_GLB_RSET HW_O_MCU_FAT HW_O_PFC_EN HW_O_PG HW_O_S_RlyCTL1 HW_PG_SENSE HW_S2_CTR /end REF_MEASUREMENT
/end GROUP
/begin GROUP POWERLIMT "Comment" ROOT
 /begin REF_CHARACTERISTIC L5_PowerLimtEnable l5_CurrentLimtTimer l5_limtRampCnt l5_powerLimtTimer /end REF_CHARACTERISTIC
 /begin REF_MEASUREMENT L3_AD0_AC_Volt_fast_max_Ct_u16 L5_AC_Volt_fast_max_buff L5_AC_current_max_buff L5_CC_CurrentPhy_1000dLimt L5_CP_CurrentPhy_1000dLimt L5_InputPowerLimt L5_actInputCurrentE L5_currentPowerLimt L5_outPowerLimt OBCPOWERTag.ACPowMaxCurrentLimt OBCPOWERTag.ACPowSetVoltCurrentLimt l5_limtOutputVoltage /end REF_MEASUREMENT
/end GROUP
/begin GROUP Relay "Comment" ROOT /end GROUP
/begin GROUP stateflow "Comment" ROOT
 /begin REF_MEASUREMENT BMS_CHARGE_OVER CMDEnchargeStateDiagStart L5_OBC_model1_enable mVARCntrTag.ACVoltCntr mVARCntrTag.acVolt_pfcVol_errCntr stSysFSMCtrl.ucCurrentState stSysFSMCtrl.ucLastState /end REF_MEASUREMENT
/end GROUP
/begin GROUP VoltLoop "Comment" ROOT /begin REF_CHARACTERISTIC k_VoltKi_Uls_s16p15 k_VoltKp_Uls_s16p12 /end REF_CHARACTERISTIC /begin REF_MEASUREMENT k_Dcdc_Vref_Ct_u16 /end REF_MEASUREMENT /end GROUP
/begin RECORD_LAYOUT ECTEK_AscII16 FNC_VALUES 1 UBYTE COLUMN_DIR DIRECT FIX_NO_AXIS_PTS_X 16 ALIGNMENT_BYTE 1 ALIGNMENT_WORD 2 ALIGNMENT_LONG 4 ALIGNMENT_FLOAT32_IEEE 4 ALIGNMENT_FLOAT64_IEEE 8 /end RECORD_LAYOUT
/begin RECORD_LAYOUT ECTEK_Curve_s16u16 FNC_VALUES 3 SWORD COLUMN_DIR DIRECT AXIS_PTS_X 2 UWORD INDEX_INCR DIRECT NO_AXIS_PTS_X 1 UWORD ALIGNMENT_BYTE 1 ALIGNMENT_WORD 2 ALIGNMENT_LONG 4 ALIGNMENT_FLOAT32_IEEE 4 ALIGNMENT_FLOAT64_IEEE 8 /end RECORD_LAYOUT
/begin RECORD_LAYOUT ECTEK_Curve_s16u32 FNC_VALUES 3 SWORD ROW_DIR DIRECT AXIS_PTS_X 2 ULONG INDEX_INCR DIRECT NO_AXIS_PTS_X 1 UWORD ALIGNMENT_BYTE 1 ALIGNMENT_WORD 2 ALIGNMENT_LONG 4 ALIGNMENT_FLOAT32_IEEE 4 ALIGNMENT_FLOAT64_IEEE 8 /end RECORD_LAYOUT
/begin RECORD_LAYOUT ECTEK_Curve_u16s16 FNC_VALUES 3 SWORD COLUMN_DIR DIRECT AXIS_PTS_X 2 UWORD INDEX_INCR DIRECT NO_AXIS_PTS_X 1 UWORD ALIGNMENT_BYTE 1 ALIGNMENT_WORD 2 ALIGNMENT_LONG 4 ALIGNMENT_FLOAT32_IEEE 4 ALIGNMENT_FLOAT64_IEEE 8 /end RECORD_LAYOUT
/begin RECORD_LAYOUT ECTEK_Curve_u16u16 FNC_VALUES 3 UWORD ROW_DIR DIRECT AXIS_PTS_X 2 UWORD INDEX_INCR DIRECT NO_AXIS_PTS_X 1 UWORD ALIGNMENT_BYTE 1 ALIGNMENT_WORD 2 ALIGNMENT_LONG 4 ALIGNMENT_FLOAT32_IEEE 4 ALIGNMENT_FLOAT64_IEEE 8 /end RECORD_LAYOUT
/begin RECORD_LAYOUT ECTEK_Curve_u16u32 FNC_VALUES 3 UWORD ROW_DIR DIRECT AXIS_PTS_X 2 ULONG INDEX_INCR DIRECT NO_AXIS_PTS_X 1 UWORD ALIGNMENT_BYTE 1 ALIGNMENT_WORD 2 ALIGNMENT_LONG 4 ALIGNMENT_FLOAT32_IEEE 4 ALIGNMENT_FLOAT64_IEEE 8 /end RECORD_LAYOUT
/begin RECORD_LAYOUT ECTEK_Map_s16s16s16 FNC_VALUES 5 SWORD COLUMN_DIR DIRECT AXIS_PTS_X 3 SWORD INDEX_INCR DIRECT AXIS_PTS_Y 4 SWORD INDEX_INCR DIRECT NO_AXIS_PTS_X 1 UWORD NO_AXIS_PTS_Y 2 UWORD ALIGNMENT_BYTE 1 ALIGNMENT_WORD 2 ALIGNMENT_LONG 4 ALIGNMENT_FLOAT32_IEEE 4 ALIGNMENT_FLOAT64_IEEE 8 /end RECORD_LAYOUT
/begin RECORD_LAYOUT ECTEK_Map_s16u16u16 FNC_VALUES 5 SWORD COLUMN_DIR DIRECT AXIS_PTS_X 3 UWORD INDEX_INCR DIRECT AXIS_PTS_Y 4 UWORD INDEX_INCR DIRECT NO_AXIS_PTS_X 1 UWORD NO_AXIS_PTS_Y 2 UWORD ALIGNMENT_BYTE 1 ALIGNMENT_WORD 2 ALIGNMENT_LONG 4 ALIGNMENT_FLOAT32_IEEE 4 ALIGNMENT_FLOAT64_IEEE 8 /end RECORD_LAYOUT
/begin RECORD_LAYOUT ECTEK_Map_u16u16s16 FNC_VALUES 5 UWORD COLUMN_DIR DIRECT AXIS_PTS_X 3 UWORD INDEX_INCR DIRECT AXIS_PTS_Y 4 SWORD INDEX_INCR DIRECT NO_AXIS_PTS_X 1 UWORD NO_AXIS_PTS_Y 2 UWORD ALIGNMENT_BYTE 1 ALIGNMENT_WORD 2 ALIGNMENT_LONG 4 ALIGNMENT_FLOAT32_IEEE 4 ALIGNMENT_FLOAT64_IEEE 8 /end RECORD_LAYOUT
/begin RECORD_LAYOUT ECTEK_Map_u16u16u16 FNC_VALUES 5 UWORD COLUMN_DIR DIRECT AXIS_PTS_X 3 UWORD INDEX_INCR DIRECT AXIS_PTS_Y 4 UWORD INDEX_INCR DIRECT NO_AXIS_PTS_X 1 UWORD NO_AXIS_PTS_Y 2 UWORD ALIGNMENT_BYTE 1 ALIGNMENT_WORD 2 ALIGNMENT_LONG 4 ALIGNMENT_FLOAT32_IEEE 4 ALIGNMENT_FLOAT64_IEEE 8 /end RECORD_LAYOUT
/begin RECORD_LAYOUT ECTEK_Value_s16 FNC_VALUES 1 SWORD ROW_DIR DIRECT ALIGNMENT_WORD 2 ALIGNMENT_LONG 4 ALIGNMENT_FLOAT32_IEEE 4 ALIGNMENT_FLOAT64_IEEE 8 /end RECORD_LAYOUT
/begin RECORD_LAYOUT ECTEK_Value_s32 FNC_VALUES 1 SLONG ROW_DIR DIRECT ALIGNMENT_WORD 2 ALIGNMENT_LONG 4 ALIGNMENT_FLOAT32_IEEE 4 ALIGNMENT_FLOAT64_IEEE 8 /end RECORD_LAYOUT
/begin RECORD_LAYOUT ECTEK_Value_s8 FNC_VALUES 1 SBYTE COLUMN_DIR DIRECT ALIGNMENT_BYTE 1 ALIGNMENT_WORD 2 ALIGNMENT_LONG 4 ALIGNMENT_FLOAT32_IEEE 4 ALIGNMENT_FLOAT64_IEEE 8 /end RECORD_LAYOUT
/begin RECORD_LAYOUT ECTEK_Value_u16 FNC_VALUES 1 UWORD COLUMN_DIR DIRECT ALIGNMENT_BYTE 1 ALIGNMENT_WORD 2 ALIGNMENT_LONG 4 ALIGNMENT_FLOAT32_IEEE 4 ALIGNMENT_FLOAT64_IEEE 8 /end RECORD_LAYOUT
/begin RECORD_LAYOUT ECTEK_Value_u32 FNC_VALUES 1 ULONG ROW_DIR DIRECT ALIGNMENT_WORD 2 ALIGNMENT_LONG 4 ALIGNMENT_FLOAT32_IEEE 4 ALIGNMENT_FLOAT64_IEEE 8 /end RECORD_LAYOUT
/begin RECORD_LAYOUT ECTEK_Value_u8 FNC_VALUES 1 UBYTE ROW_DIR DIRECT ALIGNMENT_WORD 2 ALIGNMENT_LONG 4 ALIGNMENT_FLOAT32_IEEE 4 ALIGNMENT_FLOAT64_IEEE 8 /end RECORD_LAYOUT
/begin RECORD_LAYOUT ECTEK_ValueBlock12_u8 FNC_VALUES 1 UBYTE COLUMN_DIR DIRECT FIX_NO_AXIS_PTS_X 12 ALIGNMENT_BYTE 1 ALIGNMENT_WORD 1 ALIGNMENT_LONG 1 ALIGNMENT_FLOAT32_IEEE 1 ALIGNMENT_FLOAT64_IEEE 1 /end RECORD_LAYOUT
/begin RECORD_LAYOUT STANDARD_CURVE_U16S32 FNC_VALUES 3 SLONG COLUMN_DIR DIRECT AXIS_PTS_X 2 UWORD INDEX_INCR DIRECT NO_AXIS_PTS_X 1 UWORD ALIGNMENT_BYTE 1 ALIGNMENT_WORD 2 ALIGNMENT_LONG 4 ALIGNMENT_FLOAT32_IEEE 4 ALIGNMENT_FLOAT64_IEEE 8 /end RECORD_LAYOUT
/begin RECORD_LAYOUT STANDARD_GROUP_S16 ALIGNMENT_BYTE 1 ALIGNMENT_WORD 2 ALIGNMENT_LONG 4 ALIGNMENT_FLOAT32_IEEE 4 ALIGNMENT_FLOAT64_IEEE 8 /end RECORD_LAYOUT
/begin RECORD_LAYOUT ValA_Wu16 FNC_VALUES 1 UBYTE COLUMN_DIR DIRECT ALIGNMENT_BYTE 1 ALIGNMENT_WORD 2 ALIGNMENT_LONG 4 ALIGNMENT_FLOAT32_IEEE 4 ALIGNMENT_FLOAT64_IEEE 8 /end RECORD_LAYOUT
/begin RECORD_LAYOUT __UBYTE_Z FNC_VALUES 1 UBYTE ROW_DIR DIRECT /end RECORD_LAYOUT
/begin RECORD_LAYOUT __UWORD_Z FNC_VALUES 1 UWORD ROW_DIR DIRECT /end RECORD_LAYOUT
/begin RECORD_LAYOUT __ULONG_Z FNC_VALUES 1 ULONG ROW_DIR DIRECT /end RECORD_LAYOUT
/begin RECORD_LAYOUT __SBYTE_Z FNC_VALUES 1 SBYTE ROW_DIR DIRECT /end RECORD_LAYOUT
/begin RECORD_LAYOUT __SWORD_Z FNC_VALUES 1 SWORD ROW_DIR DIRECT /end RECORD_LAYOUT
/begin RECORD_LAYOUT __SLONG_Z FNC_VALUES 1 SLONG ROW_DIR DIRECT /end RECORD_LAYOUT
/begin RECORD_LAYOUT __FLOAT32_IEEE_Z FNC_VALUES 1 FLOAT32_IEEE ROW_DIR DIRECT /end RECORD_LAYOUT
/begin RECORD_LAYOUT __FLOAT64_IEEE_Z FNC_VALUES 1 FLOAT64_IEEE ROW_DIR DIRECT /end RECORD_LAYOUT
/begin RECORD_LAYOUT __UBYTE_S FNC_VALUES 1 UBYTE COLUMN_DIR DIRECT /end RECORD_LAYOUT
/begin RECORD_LAYOUT __UWORD_S FNC_VALUES 1 UWORD COLUMN_DIR DIRECT /end RECORD_LAYOUT
/begin RECORD_LAYOUT __ULONG_S FNC_VALUES 1 ULONG COLUMN_DIR DIRECT /end RECORD_LAYOUT
/begin RECORD_LAYOUT __SBYTE_S FNC_VALUES 1 SBYTE COLUMN_DIR DIRECT /end RECORD_LAYOUT
/begin RECORD_LAYOUT __SWORD_S FNC_VALUES 1 SWORD COLUMN_DIR DIRECT /end RECORD_LAYOUT
/begin RECORD_LAYOUT __SLONG_S FNC_VALUES 1 SLONG COLUMN_DIR DIRECT /end RECORD_LAYOUT
/begin RECORD_LAYOUT __FLOAT32_IEEE_S FNC_VALUES 1 FLOAT32_IEEE COLUMN_DIR DIRECT /end RECORD_LAYOUT
/begin RECORD_LAYOUT __FLOAT64_IEEE_S FNC_VALUES 1 FLOAT64_IEEE COLUMN_DIR DIRECT /end RECORD_LAYOUT
/begin RECORD_LAYOUT SSV__UBYTE_S AXIS_PTS_X 1 UBYTE INDEX_INCR DIRECT /end RECORD_LAYOUT
/begin RECORD_LAYOUT SSV__UWORD_S AXIS_PTS_X 1 UWORD INDEX_INCR DIRECT /end RECORD_LAYOUT
/begin RECORD_LAYOUT SSV__ULONG_S AXIS_PTS_X 1 ULONG INDEX_INCR DIRECT /end RECORD_LAYOUT
/begin RECORD_LAYOUT SSV__SBYTE_S AXIS_PTS_X 1 SBYTE INDEX_INCR DIRECT /end RECORD_LAYOUT
/begin RECORD_LAYOUT SSV__SWORD_S AXIS_PTS_X 1 SWORD INDEX_INCR DIRECT /end RECORD_LAYOUT
/begin RECORD_LAYOUT SSV__SLONG_S AXIS_PTS_X 1 SLONG INDEX_INCR DIRECT /end RECORD_LAYOUT
/begin RECORD_LAYOUT SSV__FLOAT32_IEEE_S AXIS_PTS_X 1 FLOAT32_IEEE INDEX_INCR DIRECT /end RECORD_LAYOUT
/begin RECORD_LAYOUT SSV__FLOAT64_IEEE_S AXIS_PTS_X 1 FLOAT64_IEEE INDEX_INCR DIRECT /end RECORD_LAYOUT
/end MODULE
/end PROJECT
