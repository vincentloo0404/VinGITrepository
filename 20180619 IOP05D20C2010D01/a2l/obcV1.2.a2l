/* @@@@ File written by CANAPE_VERSION 13 0 11 @@@@ */ ASAP2_VERSION 1 51
/begin PROJECT obc ""
/begin MODULE CPP ""
/begin MOD_COMMON "" BYTE_ORDER MSB_FIRST ALIGNMENT_BYTE 1 ALIGNMENT_WORD 2 ALIGNMENT_LONG 4 ALIGNMENT_FLOAT32_IEEE 4 ALIGNMENT_FLOAT64_IEEE 8 /end MOD_COMMON
/begin IF_DATA ASAP1B_CCP
 /begin SOURCE "10ms" 4 1
  /begin QP_BLOB 0x00 LENGTH 0x14 CAN_ID_FIXED 0x0636 RASTER 0x00 FIRST_PID 0x00 /end QP_BLOB
 /end SOURCE
 /begin SOURCE "100ms" 4 10
  /begin QP_BLOB 0x01 LENGTH 0x14 CAN_ID_FIXED 0x0636 RASTER 0x01 FIRST_PID 0x14 /end QP_BLOB
 /end SOURCE
 /begin RASTER "10ms" "10ms" 0x00 4 1 /end RASTER
 /begin RASTER "100ms" "100ms" 0x01 4 10 /end RASTER
 /begin TP_BLOB 0x0201 0x0206 0x0635 0x0636 0x23 0x01 BAUDRATE 0x07A120 SAMPLE_POINT 0x4B SAMPLE_RATE 0x01 BTL_CYCLES 0x08 SJW 0x02 SYNC_EDGE SINGLE DAQ_MODE BURST CONSISTENCY ODT ADDRESS_EXTENSION DAQ /begin DEFINED_PAGES 0x01 "reference page" 0x00 0x40000000 0x5FF0 ROM /end DEFINED_PAGES
  /begin DEFINED_PAGES 0x02 "working page" 0x00 0x800000 0x0C00 RAM RAM_INIT_BY_ECU /end DEFINED_PAGES
  OPTIONAL_CMD 0x000E OPTIONAL_CMD 0x0011 OPTIONAL_CMD 0x0009 OPTIONAL_CMD 0x000C OPTIONAL_CMD 0x000D /end TP_BLOB
/end IF_DATA
/begin MOD_PAR "基于s12x的发动机管理模块" VERSION "0.5" SUPPLIER "Hualong AutoTech" CUSTOMER "Huachen Auto" CUSTOMER_NO "001" USER "Jiao Yu" PHONE_NO "01062670702" ECU "EPS001" CPU_TYPE "MPC560xP" NO_OF_INTERFACES 1 ADDR_EPK 0x0
 /begin MEMORY_SEGMENT EFLASHDATA "" DATA FLASH EXTERN 0x40000000 0x5FF0 -1 -1 -1 -1 -1 /end MEMORY_SEGMENT
 /begin MEMORY_SEGMENT ERAMDATA "" DATA RAM EXTERN 0x800000 0xC00 -1 -1 -1 -1 -1 /end MEMORY_SEGMENT
/end MOD_PAR
/begin COMPU_VTAB_RANGE _enum "" 9 0 0 "PowerOff_State" 1 1 "CodeInit_State" 2 2 "WarmInit_State" 3 3 "Run_State" 4 4 "SoftDisable_State" 5 5 "HardDisable_State" 6 6 "CtrlDisable_State" 7 7 "ShutDown_State" 8 8 "SystemTest_State" DEFAULT_VALUE "" /end COMPU_VTAB_RANGE
/begin COMPU_VTAB _enum "" TAB_VERB 9 0 "PowerOff_State" 1 "CodeInit_State" 2 "WarmInit_State" 3 "Run_State" 4 "SoftDisable_State" 5 "HardDisable_State" 6 "CtrlDisable_State" 7 "ShutDown_State" 8 "SystemTest_State" DEFAULT_VALUE "" /end COMPU_VTAB
/begin COMPU_VTAB _enum "" TAB_VERB 9 0 "PowerOff_State" 1 "CodeInit_State" 2 "WarmInit_State" 3 "Run_State" 4 "SoftDisable_State" 5 "HardDisable_State" 6 "CtrlDisable_State" 7 "ShutDown_State" 8 "SystemTest_State" DEFAULT_VALUE "" /end COMPU_VTAB
/begin COMPU_VTAB _enum "" TAB_VERB 9 0 "PowerOff_State" 1 "CodeInit_State" 2 "WarmInit_State" 3 "Run_State" 4 "SoftDisable_State" 5 "HardDisable_State" 6 "CtrlDisable_State" 7 "ShutDown_State" 8 "SystemTest_State" DEFAULT_VALUE "" /end COMPU_VTAB
/begin COMPU_VTAB _enum "" TAB_VERB 4 0 "e_TRIM_INIT" 1 "e_TRIM_NOT_COMPLETED" 2 "e_TRIM_SUCCESS" 3 "e_TRIM_FAIL" DEFAULT_VALUE "" /end COMPU_VTAB
/begin COMPU_VTAB _enum "" TAB_VERB 9 0 "PowerOff_State" 1 "CodeInit_State" 2 "WarmInit_State" 3 "Run_State" 4 "SoftDisable_State" 5 "HardDisable_State" 6 "CtrlDisable_State" 7 "ShutDown_State" 8 "SystemTest_State" DEFAULT_VALUE "" /end COMPU_VTAB
/begin COMPU_VTAB _enum "" TAB_VERB 9 0 "PowerOff_State" 1 "CodeInit_State" 2 "WarmInit_State" 3 "Run_State" 4 "SoftDisable_State" 5 "HardDisable_State" 6 "CtrlDisable_State" 7 "ShutDown_State" 8 "SystemTest_State" DEFAULT_VALUE "" /end COMPU_VTAB
/begin COMPU_VTAB _enum "" TAB_VERB 9 0 "PowerOff_State" 1 "CodeInit_State" 2 "WarmInit_State" 3 "Run_State" 4 "SoftDisable_State" 5 "HardDisable_State" 6 "CtrlDisable_State" 7 "ShutDown_State" 8 "SystemTest_State" DEFAULT_VALUE "" /end COMPU_VTAB
/begin COMPU_VTAB _enum "" TAB_VERB 9 0 "PowerOff_State" 1 "CodeInit_State" 2 "WarmInit_State" 3 "Run_State" 4 "SoftDisable_State" 5 "HardDisable_State" 6 "CtrlDisable_State" 7 "ShutDown_State" 8 "SystemTest_State" DEFAULT_VALUE "" /end COMPU_VTAB
/begin COMPU_VTAB_RANGE _enum "" 9 0 0 "PowerOff_State" 1 1 "CodeInit_State" 2 2 "WarmInit_State" 3 3 "Run_State" 4 4 "SoftDisable_State" 5 5 "HardDisable_State" 6 6 "CtrlDisable_State" 7 7 "ShutDown_State" 8 8 "SystemTest_State" DEFAULT_VALUE "" /end COMPU_VTAB_RANGE
/begin COMPU_VTAB _enum "" TAB_VERB 9 0 "PowerOff_State" 1 "CodeInit_State" 2 "WarmInit_State" 3 "Run_State" 4 "SoftDisable_State" 5 "HardDisable_State" 6 "CtrlDisable_State" 7 "ShutDown_State" 8 "SystemTest_State" DEFAULT_VALUE "" /end COMPU_VTAB
/begin COMPU_VTAB _enum "" TAB_VERB 9 0 "PowerOff_State" 1 "CodeInit_State" 2 "WarmInit_State" 3 "Run_State" 4 "SoftDisable_State" 5 "HardDisable_State" 6 "CtrlDisable_State" 7 "ShutDown_State" 8 "SystemTest_State" DEFAULT_VALUE "" /end COMPU_VTAB
/begin COMPU_VTAB _enum "" TAB_VERB 9 0 "PowerOff_State" 1 "CodeInit_State" 2 "WarmInit_State" 3 "Run_State" 4 "SoftDisable_State" 5 "HardDisable_State" 6 "CtrlDisable_State" 7 "ShutDown_State" 8 "SystemTest_State" DEFAULT_VALUE "" /end COMPU_VTAB
/begin COMPU_VTAB _enum "" TAB_VERB 9 0 "PowerOff_State" 1 "CodeInit_State" 2 "WarmInit_State" 3 "Run_State" 4 "SoftDisable_State" 5 "HardDisable_State" 6 "CtrlDisable_State" 7 "ShutDown_State" 8 "SystemTest_State" DEFAULT_VALUE "" /end COMPU_VTAB
/begin COMPU_VTAB _enum "" TAB_VERB 9 0 "PowerOff_State" 1 "CodeInit_State" 2 "WarmInit_State" 3 "Run_State" 4 "SoftDisable_State" 5 "HardDisable_State" 6 "CtrlDisable_State" 7 "ShutDown_State" 8 "SystemTest_State" DEFAULT_VALUE "" /end COMPU_VTAB
/begin COMPU_VTAB _enum "" TAB_VERB 9 0 "PowerOff_State" 1 "CodeInit_State" 2 "WarmInit_State" 3 "Run_State" 4 "SoftDisable_State" 5 "HardDisable_State" 6 "CtrlDisable_State" 7 "ShutDown_State" 8 "SystemTest_State" DEFAULT_VALUE "" /end COMPU_VTAB
/begin COMPU_VTAB _enum "" TAB_VERB 9 0 "PowerOff_State" 1 "CodeInit_State" 2 "WarmInit_State" 3 "Run_State" 4 "SoftDisable_State" 5 "HardDisable_State" 6 "CtrlDisable_State" 7 "ShutDown_State" 8 "SystemTest_State" DEFAULT_VALUE "" /end COMPU_VTAB
/begin COMPU_VTAB_RANGE _enum "" 9 0 0 "PowerOff_State" 1 1 "CodeInit_State" 2 2 "WarmInit_State" 3 3 "Run_State" 4 4 "SoftDisable_State" 5 5 "HardDisable_State" 6 6 "CtrlDisable_State" 7 7 "ShutDown_State" 8 8 "SystemTest_State" DEFAULT_VALUE "" /end COMPU_VTAB_RANGE
/begin COMPU_VTAB_RANGE _enum "" 9 0 0 "PowerOff_State" 1 1 "CodeInit_State" 2 2 "WarmInit_State" 3 3 "Run_State" 4 4 "SoftDisable_State" 5 5 "HardDisable_State" 6 6 "CtrlDisable_State" 7 7 "ShutDown_State" 8 8 "SystemTest_State" DEFAULT_VALUE "" /end COMPU_VTAB_RANGE
/begin COMPU_VTAB_RANGE _enum "" 9 0 0 "PowerOff_State" 1 1 "CodeInit_State" 2 2 "WarmInit_State" 3 3 "Run_State" 4 4 "SoftDisable_State" 5 5 "HardDisable_State" 6 6 "CtrlDisable_State" 7 7 "ShutDown_State" 8 8 "SystemTest_State" DEFAULT_VALUE "" /end COMPU_VTAB_RANGE
/begin COMPU_VTAB_RANGE _enum "" 9 0 0 "PowerOff_State" 1 1 "CodeInit_State" 2 2 "WarmInit_State" 3 3 "Run_State" 4 4 "SoftDisable_State" 5 5 "HardDisable_State" 6 6 "CtrlDisable_State" 7 7 "ShutDown_State" 8 8 "SystemTest_State" DEFAULT_VALUE "" /end COMPU_VTAB_RANGE
/begin COMPU_VTAB_RANGE _enum "" 9 0 0 "PowerOff_State" 1 1 "CodeInit_State" 2 2 "WarmInit_State" 3 3 "Run_State" 4 4 "SoftDisable_State" 5 5 "HardDisable_State" 6 6 "CtrlDisable_State" 7 7 "ShutDown_State" 8 8 "SystemTest_State" DEFAULT_VALUE "" /end COMPU_VTAB_RANGE
/begin COMPU_VTAB_RANGE _enum "" 9 0 0 "PowerOff_State" 1 1 "CodeInit_State" 2 2 "WarmInit_State" 3 3 "Run_State" 4 4 "SoftDisable_State" 5 5 "HardDisable_State" 6 6 "CtrlDisable_State" 7 7 "ShutDown_State" 8 8 "SystemTest_State" DEFAULT_VALUE "" /end COMPU_VTAB_RANGE
/begin COMPU_VTAB_RANGE _enum "" 9 0 0 "PowerOff_State" 1 1 "CodeInit_State" 2 2 "WarmInit_State" 3 3 "Run_State" 4 4 "SoftDisable_State" 5 5 "HardDisable_State" 6 6 "CtrlDisable_State" 7 7 "ShutDown_State" 8 8 "SystemTest_State" DEFAULT_VALUE "" /end COMPU_VTAB_RANGE
/begin COMPU_VTAB_RANGE _enum "" 9 0 0 "PowerOff_State" 1 1 "CodeInit_State" 2 2 "WarmInit_State" 3 3 "Run_State" 4 4 "SoftDisable_State" 5 5 "HardDisable_State" 6 6 "CtrlDisable_State" 7 7 "ShutDown_State" 8 8 "SystemTest_State" DEFAULT_VALUE "" /end COMPU_VTAB_RANGE
/begin COMPU_VTAB_RANGE _enum "" 9 0 0 "PowerOff_State" 1 1 "CodeInit_State" 2 2 "WarmInit_State" 3 3 "Run_State" 4 4 "SoftDisable_State" 5 5 "HardDisable_State" 6 6 "CtrlDisable_State" 7 7 "ShutDown_State" 8 8 "SystemTest_State" DEFAULT_VALUE "" /end COMPU_VTAB_RANGE
/begin COMPU_VTAB_RANGE _enum "" 9 0 0 "PowerOff_State" 1 1 "CodeInit_State" 2 2 "WarmInit_State" 3 3 "Run_State" 4 4 "SoftDisable_State" 5 5 "HardDisable_State" 6 6 "CtrlDisable_State" 7 7 "ShutDown_State" 8 8 "SystemTest_State" DEFAULT_VALUE "" /end COMPU_VTAB_RANGE
/begin COMPU_VTAB_RANGE _enum "" 9 0 0 "PowerOff_State" 1 1 "CodeInit_State" 2 2 "WarmInit_State" 3 3 "Run_State" 4 4 "SoftDisable_State" 5 5 "HardDisable_State" 6 6 "CtrlDisable_State" 7 7 "ShutDown_State" 8 8 "SystemTest_State" DEFAULT_VALUE "" /end COMPU_VTAB_RANGE
/begin COMPU_VTAB_RANGE _enum "" 9 0 0 "PowerOff_State" 1 1 "CodeInit_State" 2 2 "WarmInit_State" 3 3 "Run_State" 4 4 "SoftDisable_State" 5 5 "HardDisable_State" 6 6 "CtrlDisable_State" 7 7 "ShutDown_State" 8 8 "SystemTest_State" DEFAULT_VALUE "" /end COMPU_VTAB_RANGE
/begin COMPU_VTAB_RANGE _enum "" 9 0 0 "PowerOff_State" 1 1 "CodeInit_State" 2 2 "WarmInit_State" 3 3 "Run_State" 4 4 "SoftDisable_State" 5 5 "HardDisable_State" 6 6 "CtrlDisable_State" 7 7 "ShutDown_State" 8 8 "SystemTest_State" DEFAULT_VALUE "" /end COMPU_VTAB_RANGE
/begin COMPU_VTAB_RANGE _enum "" 9 0 0 "PowerOff_State" 1 1 "CodeInit_State" 2 2 "WarmInit_State" 3 3 "Run_State" 4 4 "SoftDisable_State" 5 5 "HardDisable_State" 6 6 "CtrlDisable_State" 7 7 "ShutDown_State" 8 8 "SystemTest_State" DEFAULT_VALUE "" /end COMPU_VTAB_RANGE
/begin COMPU_VTAB_RANGE _enum "" 9 0 0 "PowerOff_State" 1 1 "CodeInit_State" 2 2 "WarmInit_State" 3 3 "Run_State" 4 4 "SoftDisable_State" 5 5 "HardDisable_State" 6 6 "CtrlDisable_State" 7 7 "ShutDown_State" 8 8 "SystemTest_State" DEFAULT_VALUE "" /end COMPU_VTAB_RANGE
/begin COMPU_VTAB_RANGE _enum "" 9 0 0 "PowerOff_State" 1 1 "CodeInit_State" 2 2 "WarmInit_State" 3 3 "Run_State" 4 4 "SoftDisable_State" 5 5 "HardDisable_State" 6 6 "CtrlDisable_State" 7 7 "ShutDown_State" 8 8 "SystemTest_State" DEFAULT_VALUE "" /end COMPU_VTAB_RANGE
/begin COMPU_VTAB_RANGE _enum "" 9 0 0 "PowerOff_State" 1 1 "CodeInit_State" 2 2 "WarmInit_State" 3 3 "Run_State" 4 4 "SoftDisable_State" 5 5 "HardDisable_State" 6 6 "CtrlDisable_State" 7 7 "ShutDown_State" 8 8 "SystemTest_State" DEFAULT_VALUE "" /end COMPU_VTAB_RANGE
/begin COMPU_VTAB_RANGE _enum "" 9 0 0 "PowerOff_State" 1 1 "CodeInit_State" 2 2 "WarmInit_State" 3 3 "Run_State" 4 4 "SoftDisable_State" 5 5 "HardDisable_State" 6 6 "CtrlDisable_State" 7 7 "ShutDown_State" 8 8 "SystemTest_State" DEFAULT_VALUE "" /end COMPU_VTAB_RANGE
/begin COMPU_VTAB_RANGE _enum "" 9 0 0 "PowerOff_State" 1 1 "CodeInit_State" 2 2 "WarmInit_State" 3 3 "Run_State" 4 4 "SoftDisable_State" 5 5 "HardDisable_State" 6 6 "CtrlDisable_State" 7 7 "ShutDown_State" 8 8 "SystemTest_State" DEFAULT_VALUE "" /end COMPU_VTAB_RANGE
/begin COMPU_VTAB_RANGE _enum "" 9 0 0 "PowerOff_State" 1 1 "CodeInit_State" 2 2 "WarmInit_State" 3 3 "Run_State" 4 4 "SoftDisable_State" 5 5 "HardDisable_State" 6 6 "CtrlDisable_State" 7 7 "ShutDown_State" 8 8 "SystemTest_State" DEFAULT_VALUE "" /end COMPU_VTAB_RANGE
/begin COMPU_VTAB_RANGE _enum "" 9 0 0 "PowerOff_State" 1 1 "CodeInit_State" 2 2 "WarmInit_State" 3 3 "Run_State" 4 4 "SoftDisable_State" 5 5 "HardDisable_State" 6 6 "CtrlDisable_State" 7 7 "ShutDown_State" 8 8 "SystemTest_State" DEFAULT_VALUE "" /end COMPU_VTAB_RANGE
/begin COMPU_VTAB_RANGE _enum "" 9 0 0 "PowerOff_State" 1 1 "CodeInit_State" 2 2 "WarmInit_State" 3 3 "Run_State" 4 4 "SoftDisable_State" 5 5 "HardDisable_State" 6 6 "CtrlDisable_State" 7 7 "ShutDown_State" 8 8 "SystemTest_State" DEFAULT_VALUE "" /end COMPU_VTAB_RANGE
/begin COMPU_VTAB_RANGE _enum "" 9 0 0 "PowerOff_State" 1 1 "CodeInit_State" 2 2 "WarmInit_State" 3 3 "Run_State" 4 4 "SoftDisable_State" 5 5 "HardDisable_State" 6 6 "CtrlDisable_State" 7 7 "ShutDown_State" 8 8 "SystemTest_State" DEFAULT_VALUE "" /end COMPU_VTAB_RANGE
/begin COMPU_VTAB_RANGE _enum "" 9 0 0 "PowerOff_State" 1 1 "CodeInit_State" 2 2 "WarmInit_State" 3 3 "Run_State" 4 4 "SoftDisable_State" 5 5 "HardDisable_State" 6 6 "CtrlDisable_State" 7 7 "ShutDown_State" 8 8 "SystemTest_State" DEFAULT_VALUE "" /end COMPU_VTAB_RANGE
/begin COMPU_VTAB_RANGE _enum "" 9 0 0 "PowerOff_State" 1 1 "CodeInit_State" 2 2 "WarmInit_State" 3 3 "Run_State" 4 4 "SoftDisable_State" 5 5 "HardDisable_State" 6 6 "CtrlDisable_State" 7 7 "ShutDown_State" 8 8 "SystemTest_State" DEFAULT_VALUE "" /end COMPU_VTAB_RANGE
/begin COMPU_VTAB_RANGE _enum "" 9 0 0 "PowerOff_State" 1 1 "CodeInit_State" 2 2 "WarmInit_State" 3 3 "Run_State" 4 4 "SoftDisable_State" 5 5 "HardDisable_State" 6 6 "CtrlDisable_State" 7 7 "ShutDown_State" 8 8 "SystemTest_State" DEFAULT_VALUE "" /end COMPU_VTAB_RANGE
/begin COMPU_VTAB_RANGE _enum "" 9 0 0 "PowerOff_State" 1 1 "CodeInit_State" 2 2 "WarmInit_State" 3 3 "Run_State" 4 4 "SoftDisable_State" 5 5 "HardDisable_State" 6 6 "CtrlDisable_State" 7 7 "ShutDown_State" 8 8 "SystemTest_State" DEFAULT_VALUE "" /end COMPU_VTAB_RANGE
/begin COMPU_VTAB_RANGE _enum "" 9 0 0 "PowerOff_State" 1 1 "CodeInit_State" 2 2 "WarmInit_State" 3 3 "Run_State" 4 4 "SoftDisable_State" 5 5 "HardDisable_State" 6 6 "CtrlDisable_State" 7 7 "ShutDown_State" 8 8 "SystemTest_State" DEFAULT_VALUE "" /end COMPU_VTAB_RANGE
/begin COMPU_VTAB_RANGE _enum "" 9 0 0 "PowerOff_State" 1 1 "CodeInit_State" 2 2 "WarmInit_State" 3 3 "Run_State" 4 4 "SoftDisable_State" 5 5 "HardDisable_State" 6 6 "CtrlDisable_State" 7 7 "ShutDown_State" 8 8 "SystemTest_State" DEFAULT_VALUE "" /end COMPU_VTAB_RANGE
/begin COMPU_VTAB_RANGE _enum "" 9 0 0 "PowerOff_State" 1 1 "CodeInit_State" 2 2 "WarmInit_State" 3 3 "Run_State" 4 4 "SoftDisable_State" 5 5 "HardDisable_State" 6 6 "CtrlDisable_State" 7 7 "ShutDown_State" 8 8 "SystemTest_State" DEFAULT_VALUE "" /end COMPU_VTAB_RANGE
/begin COMPU_VTAB_RANGE _enum "" 9 0 0 "PowerOff_State" 1 1 "CodeInit_State" 2 2 "WarmInit_State" 3 3 "Run_State" 4 4 "SoftDisable_State" 5 5 "HardDisable_State" 6 6 "CtrlDisable_State" 7 7 "ShutDown_State" 8 8 "SystemTest_State" DEFAULT_VALUE "" /end COMPU_VTAB_RANGE
/begin COMPU_VTAB_RANGE _enum "" 9 0 0 "PowerOff_State" 1 1 "CodeInit_State" 2 2 "WarmInit_State" 3 3 "Run_State" 4 4 "SoftDisable_State" 5 5 "HardDisable_State" 6 6 "CtrlDisable_State" 7 7 "ShutDown_State" 8 8 "SystemTest_State" DEFAULT_VALUE "" /end COMPU_VTAB_RANGE
/begin COMPU_VTAB_RANGE _enum "" 9 0 0 "PowerOff_State" 1 1 "CodeInit_State" 2 2 "WarmInit_State" 3 3 "Run_State" 4 4 "SoftDisable_State" 5 5 "HardDisable_State" 6 6 "CtrlDisable_State" 7 7 "ShutDown_State" 8 8 "SystemTest_State" DEFAULT_VALUE "" /end COMPU_VTAB_RANGE
/begin COMPU_VTAB_RANGE _enum "" 9 0 0 "PowerOff_State" 1 1 "CodeInit_State" 2 2 "WarmInit_State" 3 3 "Run_State" 4 4 "SoftDisable_State" 5 5 "HardDisable_State" 6 6 "CtrlDisable_State" 7 7 "ShutDown_State" 8 8 "SystemTest_State" DEFAULT_VALUE "" /end COMPU_VTAB_RANGE
/begin COMPU_VTAB_RANGE _enum "" 9 0 0 "PowerOff_State" 1 1 "CodeInit_State" 2 2 "WarmInit_State" 3 3 "Run_State" 4 4 "SoftDisable_State" 5 5 "HardDisable_State" 6 6 "CtrlDisable_State" 7 7 "ShutDown_State" 8 8 "SystemTest_State" DEFAULT_VALUE "" /end COMPU_VTAB_RANGE
/begin COMPU_VTAB_RANGE _enum "" 9 0 0 "PowerOff_State" 1 1 "CodeInit_State" 2 2 "WarmInit_State" 3 3 "Run_State" 4 4 "SoftDisable_State" 5 5 "HardDisable_State" 6 6 "CtrlDisable_State" 7 7 "ShutDown_State" 8 8 "SystemTest_State" DEFAULT_VALUE "" /end COMPU_VTAB_RANGE
/begin COMPU_VTAB_RANGE _enum "" 9 0 0 "PowerOff_State" 1 1 "CodeInit_State" 2 2 "WarmInit_State" 3 3 "Run_State" 4 4 "SoftDisable_State" 5 5 "HardDisable_State" 6 6 "CtrlDisable_State" 7 7 "ShutDown_State" 8 8 "SystemTest_State" DEFAULT_VALUE "" /end COMPU_VTAB_RANGE
/begin COMPU_VTAB_RANGE _enum "" 9 0 0 "PowerOff_State" 1 1 "CodeInit_State" 2 2 "WarmInit_State" 3 3 "Run_State" 4 4 "SoftDisable_State" 5 5 "HardDisable_State" 6 6 "CtrlDisable_State" 7 7 "ShutDown_State" 8 8 "SystemTest_State" DEFAULT_VALUE "" /end COMPU_VTAB_RANGE
/begin COMPU_VTAB_RANGE _enum "" 9 0 0 "PowerOff_State" 1 1 "CodeInit_State" 2 2 "WarmInit_State" 3 3 "Run_State" 4 4 "SoftDisable_State" 5 5 "HardDisable_State" 6 6 "CtrlDisable_State" 7 7 "ShutDown_State" 8 8 "SystemTest_State" DEFAULT_VALUE "" /end COMPU_VTAB_RANGE
/begin COMPU_VTAB_RANGE _enum "" 9 0 0 "PowerOff_State" 1 1 "CodeInit_State" 2 2 "WarmInit_State" 3 3 "Run_State" 4 4 "SoftDisable_State" 5 5 "HardDisable_State" 6 6 "CtrlDisable_State" 7 7 "ShutDown_State" 8 8 "SystemTest_State" DEFAULT_VALUE "" /end COMPU_VTAB_RANGE
/begin COMPU_VTAB_RANGE _enum "" 9 0 0 "PowerOff_State" 1 1 "CodeInit_State" 2 2 "WarmInit_State" 3 3 "Run_State" 4 4 "SoftDisable_State" 5 5 "HardDisable_State" 6 6 "CtrlDisable_State" 7 7 "ShutDown_State" 8 8 "SystemTest_State" DEFAULT_VALUE "" /end COMPU_VTAB_RANGE
/begin COMPU_VTAB_RANGE _enum "" 9 0 0 "PowerOff_State" 1 1 "CodeInit_State" 2 2 "WarmInit_State" 3 3 "Run_State" 4 4 "SoftDisable_State" 5 5 "HardDisable_State" 6 6 "CtrlDisable_State" 7 7 "ShutDown_State" 8 8 "SystemTest_State" DEFAULT_VALUE "" /end COMPU_VTAB_RANGE
/begin COMPU_VTAB _enum "" TAB_VERB 9 0 "PowerOff_State" 1 "CodeInit_State" 2 "WarmInit_State" 3 "Run_State" 4 "SoftDisable_State" 5 "HardDisable_State" 6 "CtrlDisable_State" 7 "ShutDown_State" 8 "SystemTest_State" DEFAULT_VALUE "" /end COMPU_VTAB
/begin COMPU_VTAB_RANGE _enum "" 9 0 0 "PowerOff_State" 1 1 "CodeInit_State" 2 2 "WarmInit_State" 3 3 "Run_State" 4 4 "SoftDisable_State" 5 5 "HardDisable_State" 6 6 "CtrlDisable_State" 7 7 "ShutDown_State" 8 8 "SystemTest_State" DEFAULT_VALUE "" /end COMPU_VTAB_RANGE
/begin COMPU_VTAB_RANGE _enum "" 9 0 0 "PowerOff_State" 1 1 "CodeInit_State" 2 2 "WarmInit_State" 3 3 "Run_State" 4 4 "SoftDisable_State" 5 5 "HardDisable_State" 6 6 "CtrlDisable_State" 7 7 "ShutDown_State" 8 8 "SystemTest_State" DEFAULT_VALUE "" /end COMPU_VTAB_RANGE
/begin COMPU_VTAB_RANGE _enum "" 9 0 0 "PowerOff_State" 1 1 "CodeInit_State" 2 2 "WarmInit_State" 3 3 "Run_State" 4 4 "SoftDisable_State" 5 5 "HardDisable_State" 6 6 "CtrlDisable_State" 7 7 "ShutDown_State" 8 8 "SystemTest_State" DEFAULT_VALUE "" /end COMPU_VTAB_RANGE
/begin COMPU_VTAB_RANGE _enum "" 9 0 0 "PowerOff_State" 1 1 "CodeInit_State" 2 2 "WarmInit_State" 3 3 "Run_State" 4 4 "SoftDisable_State" 5 5 "HardDisable_State" 6 6 "CtrlDisable_State" 7 7 "ShutDown_State" 8 8 "SystemTest_State" DEFAULT_VALUE "" /end COMPU_VTAB_RANGE
/begin COMPU_VTAB_RANGE _enum "" 9 0 0 "PowerOff_State" 1 1 "CodeInit_State" 2 2 "WarmInit_State" 3 3 "Run_State" 4 4 "SoftDisable_State" 5 5 "HardDisable_State" 6 6 "CtrlDisable_State" 7 7 "ShutDown_State" 8 8 "SystemTest_State" DEFAULT_VALUE "" /end COMPU_VTAB_RANGE
/begin COMPU_VTAB_RANGE _enum "" 9 0 0 "PowerOff_State" 1 1 "CodeInit_State" 2 2 "WarmInit_State" 3 3 "Run_State" 4 4 "SoftDisable_State" 5 5 "HardDisable_State" 6 6 "CtrlDisable_State" 7 7 "ShutDown_State" 8 8 "SystemTest_State" DEFAULT_VALUE "" /end COMPU_VTAB_RANGE
/begin COMPU_VTAB_RANGE _enum "" 9 0 0 "PowerOff_State" 1 1 "CodeInit_State" 2 2 "WarmInit_State" 3 3 "Run_State" 4 4 "SoftDisable_State" 5 5 "HardDisable_State" 6 6 "CtrlDisable_State" 7 7 "ShutDown_State" 8 8 "SystemTest_State" DEFAULT_VALUE "" /end COMPU_VTAB_RANGE
/begin COMPU_VTAB_RANGE _enum "" 9 0 0 "PowerOff_State" 1 1 "CodeInit_State" 2 2 "WarmInit_State" 3 3 "Run_State" 4 4 "SoftDisable_State" 5 5 "HardDisable_State" 6 6 "CtrlDisable_State" 7 7 "ShutDown_State" 8 8 "SystemTest_State" DEFAULT_VALUE "" /end COMPU_VTAB_RANGE
/begin COMPU_VTAB_RANGE _enum "" 9 0 0 "PowerOff_State" 1 1 "CodeInit_State" 2 2 "WarmInit_State" 3 3 "Run_State" 4 4 "SoftDisable_State" 5 5 "HardDisable_State" 6 6 "CtrlDisable_State" 7 7 "ShutDown_State" 8 8 "SystemTest_State" DEFAULT_VALUE "" /end COMPU_VTAB_RANGE
/begin COMPU_VTAB_RANGE _enum "" 9 0 0 "PowerOff_State" 1 1 "CodeInit_State" 2 2 "WarmInit_State" 3 3 "Run_State" 4 4 "SoftDisable_State" 5 5 "HardDisable_State" 6 6 "CtrlDisable_State" 7 7 "ShutDown_State" 8 8 "SystemTest_State" DEFAULT_VALUE "" /end COMPU_VTAB_RANGE
/begin COMPU_VTAB_RANGE _enum "" 9 0 0 "PowerOff_State" 1 1 "CodeInit_State" 2 2 "WarmInit_State" 3 3 "Run_State" 4 4 "SoftDisable_State" 5 5 "HardDisable_State" 6 6 "CtrlDisable_State" 7 7 "ShutDown_State" 8 8 "SystemTest_State" DEFAULT_VALUE "" /end COMPU_VTAB_RANGE
/begin COMPU_VTAB_RANGE _enum "" 9 0 0 "PowerOff_State" 1 1 "CodeInit_State" 2 2 "WarmInit_State" 3 3 "Run_State" 4 4 "SoftDisable_State" 5 5 "HardDisable_State" 6 6 "CtrlDisable_State" 7 7 "ShutDown_State" 8 8 "SystemTest_State" DEFAULT_VALUE "" /end COMPU_VTAB_RANGE
/begin COMPU_VTAB_RANGE _enum "" 9 0 0 "PowerOff_State" 1 1 "CodeInit_State" 2 2 "WarmInit_State" 3 3 "Run_State" 4 4 "SoftDisable_State" 5 5 "HardDisable_State" 6 6 "CtrlDisable_State" 7 7 "ShutDown_State" 8 8 "SystemTest_State" DEFAULT_VALUE "" /end COMPU_VTAB_RANGE
/begin COMPU_VTAB En "" TAB_VERB 2 0 "Disable" 1 "Enable" DEFAULT_VALUE "" /end COMPU_VTAB
/begin COMPU_TAB Enable "" TAB_NOINTP 2 0 0 1 1 DEFAULT_VALUE "1" /end COMPU_TAB
/begin COMPU_VTAB New "" TAB_VERB 9 0 "STATE_INIT" 1 "STATE_STANDBY" 2 "STATE_PRECHARGE1" 3 "STATE_PFC_RUN" 4 "STATE_PRECHARGE2" 5 "STATE_OPETRATION" 6 "STATE_AFTER_RUN" 7 "STATE_SLEEP" 8 "STATE_FAILURE" DEFAULT_VALUE "" /end COMPU_VTAB
/begin COMPU_VTAB OBC_STATE "" TAB_VERB 9 0 "STATE_INIT" 1 "STATE_STANDBY" 2 "STATE_PRECHARGE1" 3 "STATE_PFC_RUN" 4 "STATE_PRECHARGE2" 5 "STATE_OPETRATION" 6 "STATE_AFTER_RUN" 7 "STATE_SLEEP" 8 "STATE_FAILURE" DEFAULT_VALUE "" /end COMPU_VTAB
/begin COMPU_VTAB obcState "" TAB_VERB 10 0 "STATE_INIT" 2 "STATE_STANDBY" 3 "STATE_PRECHARGE1" 4 "STATE_PFC_RUN" 5 "STATE_PRECHARGE2" 6 "STATE_OPETRATION" 10 "STATE_AFTER_RUN" 11 "STATE_PREFAILURE" 12 "STATE_FAILURE" 13 "STATE_SLEEP" DEFAULT_VALUE "" /end COMPU_VTAB
/begin COMPU_VTAB relayCtrl "继电器控制状态" TAB_VERB 2 0 "open" 1 "close" DEFAULT_VALUE "" /end COMPU_VTAB
/begin COMPU_VTAB STATE "" TAB_VERB 9 0 "STATE_INIT" 1 "STATE_STANDBY" 2 "STATE_PRECHARGE1" 3 "STATE_PFC_RUN" 4 "STATE_PRECHARGE2" 5 "STATE_OPETRATION" 6 "STATE_AFTER_RUN" 7 "STATE_SLEEP" 8 "STATE_FAILURE" DEFAULT_VALUE "" /end COMPU_VTAB
/begin COMPU_METHOD _enum "enumeration table" TAB_VERB "" "" COMPU_TAB_REF _enum /end COMPU_METHOD
/begin COMPU_METHOD _enum "enumeration table" TAB_VERB "" "" COMPU_TAB_REF _enum /end COMPU_METHOD
/begin COMPU_METHOD _enum "enumeration table" TAB_VERB "" "" COMPU_TAB_REF _enum /end COMPU_METHOD
/begin COMPU_METHOD _enum "enumeration table" TAB_VERB "" "" COMPU_TAB_REF _enum /end COMPU_METHOD
/begin COMPU_METHOD _enum "enumeration table" TAB_VERB "" "" COMPU_TAB_REF _enum /end COMPU_METHOD
/begin COMPU_METHOD _enum "enumeration table" TAB_VERB "" "" COMPU_TAB_REF _enum /end COMPU_METHOD
/begin COMPU_METHOD _enum "enumeration table" TAB_VERB "" "" COMPU_TAB_REF _enum /end COMPU_METHOD
/begin COMPU_METHOD _enum "enumeration table" TAB_VERB "" "" COMPU_TAB_REF _enum /end COMPU_METHOD
/begin COMPU_METHOD _enum "enumeration table" TAB_VERB "" "" COMPU_TAB_REF _enum /end COMPU_METHOD
/begin COMPU_METHOD _enum "enumeration table" TAB_VERB "" "" COMPU_TAB_REF _enum /end COMPU_METHOD
/begin COMPU_METHOD _enum "enumeration table" TAB_VERB "" "" COMPU_TAB_REF _enum /end COMPU_METHOD
/begin COMPU_METHOD _enum "enumeration table" TAB_VERB "" "" COMPU_TAB_REF _enum /end COMPU_METHOD
/begin COMPU_METHOD _enum "enumeration table" TAB_VERB "" "" COMPU_TAB_REF _enum /end COMPU_METHOD
/begin COMPU_METHOD _enum "enumeration table" TAB_VERB "" "" COMPU_TAB_REF _enum /end COMPU_METHOD
/begin COMPU_METHOD _enum "enumeration table" TAB_VERB "" "" COMPU_TAB_REF _enum /end COMPU_METHOD
/begin COMPU_METHOD _enum "enumeration table" TAB_VERB "" "" COMPU_TAB_REF _enum /end COMPU_METHOD
/begin COMPU_METHOD _enum "enumeration table" TAB_VERB "" "" COMPU_TAB_REF _enum /end COMPU_METHOD
/begin COMPU_METHOD _enum "enumeration table" TAB_VERB "" "" COMPU_TAB_REF _enum /end COMPU_METHOD
/begin COMPU_METHOD _enum "enumeration table" TAB_VERB "" "" COMPU_TAB_REF _enum /end COMPU_METHOD
/begin COMPU_METHOD _enum "enumeration table" TAB_VERB "" "" COMPU_TAB_REF _enum /end COMPU_METHOD
/begin COMPU_METHOD _enum "enumeration table" TAB_VERB "" "" COMPU_TAB_REF _enum /end COMPU_METHOD
/begin COMPU_METHOD _enum "enumeration table" TAB_VERB "" "" COMPU_TAB_REF _enum /end COMPU_METHOD
/begin COMPU_METHOD _enum "enumeration table" TAB_VERB "" "" COMPU_TAB_REF _enum /end COMPU_METHOD
/begin COMPU_METHOD _enum "enumeration table" TAB_VERB "" "" COMPU_TAB_REF _enum /end COMPU_METHOD
/begin COMPU_METHOD _enum "enumeration table" TAB_VERB "" "" COMPU_TAB_REF _enum /end COMPU_METHOD
/begin COMPU_METHOD _enum "enumeration table" TAB_VERB "" "" COMPU_TAB_REF _enum /end COMPU_METHOD
/begin COMPU_METHOD _enum "enumeration table" TAB_VERB "" "" COMPU_TAB_REF _enum /end COMPU_METHOD
/begin COMPU_METHOD _enum "enumeration table" TAB_VERB "" "" COMPU_TAB_REF _enum /end COMPU_METHOD
/begin COMPU_METHOD _enum "enumeration table" TAB_VERB "" "" COMPU_TAB_REF _enum /end COMPU_METHOD
/begin COMPU_METHOD _enum "enumeration table" TAB_VERB "" "" COMPU_TAB_REF _enum /end COMPU_METHOD
/begin COMPU_METHOD _enum "enumeration table" TAB_VERB "" "" COMPU_TAB_REF _enum /end COMPU_METHOD
/begin COMPU_METHOD _enum "enumeration table" TAB_VERB "" "" COMPU_TAB_REF _enum /end COMPU_METHOD
/begin COMPU_METHOD _enum "enumeration table" TAB_VERB "" "" COMPU_TAB_REF _enum /end COMPU_METHOD
/begin COMPU_METHOD _enum "enumeration table" TAB_VERB "" "" COMPU_TAB_REF _enum /end COMPU_METHOD
/begin COMPU_METHOD _enum "enumeration table" TAB_VERB "" "" COMPU_TAB_REF _enum /end COMPU_METHOD
/begin COMPU_METHOD _enum "enumeration table" TAB_VERB "" "" COMPU_TAB_REF _enum /end COMPU_METHOD
/begin COMPU_METHOD _enum "enumeration table" TAB_VERB "" "" COMPU_TAB_REF _enum /end COMPU_METHOD
/begin COMPU_METHOD _enum "enumeration table" TAB_VERB "" "" COMPU_TAB_REF _enum /end COMPU_METHOD
/begin COMPU_METHOD _enum "enumeration table" TAB_VERB "" "" COMPU_TAB_REF _enum /end COMPU_METHOD
/begin COMPU_METHOD _enum "enumeration table" TAB_VERB "" "" COMPU_TAB_REF _enum /end COMPU_METHOD
/begin COMPU_METHOD _enum "enumeration table" TAB_VERB "" "" COMPU_TAB_REF _enum /end COMPU_METHOD
/begin COMPU_METHOD _enum "enumeration table" TAB_VERB "" "" COMPU_TAB_REF _enum /end COMPU_METHOD
/begin COMPU_METHOD _enum "enumeration table" TAB_VERB "" "" COMPU_TAB_REF _enum /end COMPU_METHOD
/begin COMPU_METHOD _enum "enumeration table" TAB_VERB "" "" COMPU_TAB_REF _enum /end COMPU_METHOD
/begin COMPU_METHOD _enum "enumeration table" TAB_VERB "" "" COMPU_TAB_REF _enum /end COMPU_METHOD
/begin COMPU_METHOD _enum "enumeration table" TAB_VERB "" "" COMPU_TAB_REF _enum /end COMPU_METHOD
/begin COMPU_METHOD _enum "enumeration table" TAB_VERB "" "" COMPU_TAB_REF _enum /end COMPU_METHOD
/begin COMPU_METHOD _enum "enumeration table" TAB_VERB "" "" COMPU_TAB_REF _enum /end COMPU_METHOD
/begin COMPU_METHOD _enum "enumeration table" TAB_VERB "" "" COMPU_TAB_REF _enum /end COMPU_METHOD
/begin COMPU_METHOD _enum "enumeration table" TAB_VERB "" "" COMPU_TAB_REF _enum /end COMPU_METHOD
/begin COMPU_METHOD _enum "enumeration table" TAB_VERB "" "" COMPU_TAB_REF _enum /end COMPU_METHOD
/begin COMPU_METHOD _enum "enumeration table" TAB_VERB "" "" COMPU_TAB_REF _enum /end COMPU_METHOD
/begin COMPU_METHOD _enum "enumeration table" TAB_VERB "" "" COMPU_TAB_REF _enum /end COMPU_METHOD
/begin COMPU_METHOD _enum "enumeration table" TAB_VERB "" "" COMPU_TAB_REF _enum /end COMPU_METHOD
/begin COMPU_METHOD _enum "enumeration table" TAB_VERB "" "" COMPU_TAB_REF _enum /end COMPU_METHOD
/begin COMPU_METHOD _enum "enumeration table" TAB_VERB "" "" COMPU_TAB_REF _enum /end COMPU_METHOD
/begin COMPU_METHOD _enum "enumeration table" TAB_VERB "" "" COMPU_TAB_REF _enum /end COMPU_METHOD
/begin COMPU_METHOD _enum "enumeration table" TAB_VERB "" "" COMPU_TAB_REF _enum /end COMPU_METHOD
/begin COMPU_METHOD _enum "enumeration table" TAB_VERB "" "" COMPU_TAB_REF _enum /end COMPU_METHOD
/begin COMPU_METHOD _enum "enumeration table" TAB_VERB "" "" COMPU_TAB_REF _enum /end COMPU_METHOD
/begin COMPU_METHOD _enum "enumeration table" TAB_VERB "" "" COMPU_TAB_REF _enum /end COMPU_METHOD
/begin COMPU_METHOD _enum "enumeration table" TAB_VERB "" "" COMPU_TAB_REF _enum /end COMPU_METHOD
/begin COMPU_METHOD _enum "enumeration table" TAB_VERB "" "" COMPU_TAB_REF _enum /end COMPU_METHOD
/begin COMPU_METHOD _enum "enumeration table" TAB_VERB "" "" COMPU_TAB_REF _enum /end COMPU_METHOD
/begin COMPU_METHOD _enum "enumeration table" TAB_VERB "" "" COMPU_TAB_REF _enum /end COMPU_METHOD
/begin COMPU_METHOD _enum "enumeration table" TAB_VERB "" "" COMPU_TAB_REF _enum /end COMPU_METHOD
/begin COMPU_METHOD _enum "enumeration table" TAB_VERB "" "" COMPU_TAB_REF _enum /end COMPU_METHOD
/begin COMPU_METHOD _enum "enumeration table" TAB_VERB "" "" COMPU_TAB_REF _enum /end COMPU_METHOD
/begin COMPU_METHOD _enum "enumeration table" TAB_VERB "" "" COMPU_TAB_REF _enum /end COMPU_METHOD
/begin COMPU_METHOD _enum "enumeration table" TAB_VERB "" "" COMPU_TAB_REF _enum /end COMPU_METHOD
/begin COMPU_METHOD _enum "enumeration table" TAB_VERB "" "" COMPU_TAB_REF _enum /end COMPU_METHOD
/begin COMPU_METHOD _enum "enumeration table" TAB_VERB "" "" COMPU_TAB_REF _enum /end COMPU_METHOD
/begin COMPU_METHOD _enum "enumeration table" TAB_VERB "" "" COMPU_TAB_REF _enum /end COMPU_METHOD
/begin COMPU_METHOD _relayCtrl "enumeration table" TAB_VERB "%.15" "" COMPU_TAB_REF relayCtrl /end COMPU_METHOD
/begin COMPU_METHOD AC_Volt_CONVE "" RAT_FUNC "%3.1" "V" COEFFS 0 1.024 524.288 0 0 1 /end COMPU_METHOD
/begin COMPU_METHOD Amp_p07 "" RAT_FUNC "%3.1" "Amp" COEFFS 0 128 -0 0 0 1 /end COMPU_METHOD
/begin COMPU_METHOD DcDc_Current "" RAT_FUNC "%3.3" "Amp" COEFFS 0 71.67999999 179.2 0 0 1 /end COMPU_METHOD
/begin COMPU_METHOD DcDc_Current_Ref "" RAT_FUNC "%.15" "Amp" COEFFS 0 71.6799999899 179.2 0 0 1 /end COMPU_METHOD
/begin COMPU_METHOD DcDcVout "" RAT_FUNC "%3.2" "Volt" COEFFS 0 2.18111999975 -0 0 0 1 /end COMPU_METHOD
/begin COMPU_METHOD DcDcVout_Ref "" RAT_FUNC "%.15" "Volt" COEFFS 0 2.18111999975 -0 0 0 1 /end COMPU_METHOD
/begin COMPU_METHOD deadTimeConv "" RAT_FUNC "%.15" "ns" COEFFS 0 0.12 -0 0 0 1 /end COMPU_METHOD
/begin COMPU_METHOD DegC_p01 "" RAT_FUNC "%3.1" "DegC" COEFFS 0 2 -0 0 0 1 /end COMPU_METHOD
/begin COMPU_METHOD DegC_p06 "" RAT_FUNC "%3.1" "DegC" COEFFS 0 64 -0 0 0 1 /end COMPU_METHOD
/begin COMPU_METHOD DegpSec "" RAT_FUNC "%3.1" "DegpSec" COEFFS 0 1 0 0 0 1 /end COMPU_METHOD
/begin COMPU_METHOD Degree_Uls_s16p15 "" RAT_FUNC "%3.1" "Degree" COEFFS 0 182.0444444 -0 0 0 1 /end COMPU_METHOD
/begin COMPU_METHOD factorOne "" RAT_FUNC "%12.4" "" COEFFS 0 1 0 0 0 1 /end COMPU_METHOD
/begin COMPU_METHOD FRAC16 "" RAT_FUNC "%3.8" "" COEFFS 0 32768 -0 0 0 1 /end COMPU_METHOD
/begin COMPU_METHOD FRAC32 "" RAT_FUNC "%3.8" "" COEFFS 0 2147483648 -0 0 0 1 /end COMPU_METHOD
/begin COMPU_METHOD Kph_p01 "" RAT_FUNC "%3.1" "Kmp" COEFFS 0 2 -0 0 0 1 /end COMPU_METHOD
/begin COMPU_METHOD MtrNm_p11 "" RAT_FUNC "%3.2" "Nm" COEFFS 0 2048 -0 0 0 1 /end COMPU_METHOD
/begin COMPU_METHOD New "" TAB_VERB "%3.1" "" COMPU_TAB_REF OBC_STATE /end COMPU_METHOD
/begin COMPU_METHOD obcState "" TAB_VERB "%3.1" "" COMPU_TAB_REF obcState /end COMPU_METHOD
/begin COMPU_METHOD PFC_Volt_CONVE "" RAT_FUNC "%3.1" "V" COEFFS 0 2.01542149 -0 0 0 1 /end COMPU_METHOD
/begin COMPU_METHOD PFCVout "" RAT_FUNC "%3.2" "Volt" COEFFS 0 1.69983999899 -0 0 0 1 /end COMPU_METHOD
/begin COMPU_METHOD pici_Current "" RAT_FUNC "%3.2" "Volt" COEFFS 0 34.88426667 -0 0 0 1 /end COMPU_METHOD
/begin COMPU_METHOD Rad_p10 "" RAT_FUNC "%3.2" "rad" COEFFS 0 1024 -0 0 0 1 /end COMPU_METHOD
/begin COMPU_METHOD RadpSec_p02 "" RAT_FUNC "%3.1" "" COEFFS 0 4 -0 0 0 1 /end COMPU_METHOD
/begin COMPU_METHOD RadpSec_p03 "" RAT_FUNC "%3.1" "" COEFFS 0 8 -0 0 0 1 /end COMPU_METHOD
/begin COMPU_METHOD RadpSec_p04 "" RAT_FUNC "%3.2" "RadpSec" COEFFS 0 16 -0 0 0 1 /end COMPU_METHOD
/begin COMPU_METHOD RadpSec_p05 "" RAT_FUNC "%3.1" "RadpSec" COEFFS 0 32 -0 0 0 1 /end COMPU_METHOD
/begin COMPU_METHOD rpm "" RAT_FUNC "%1.1" "rpm" COEFFS 0 1 0 0 0 1 /end COMPU_METHOD
/begin COMPU_METHOD Uint "" RAT_FUNC "%3.1" "" COEFFS 0 1 0 0 0 1 /end COMPU_METHOD
/begin COMPU_METHOD Uls_p04 "" RAT_FUNC "%3.1" "Uls" COEFFS 0 16 -0 0 0 1 /end COMPU_METHOD
/begin COMPU_METHOD Uls_p08 "" RAT_FUNC "%3.1" "Uls" COEFFS 0 256 -0 0 0 1 /end COMPU_METHOD
/begin COMPU_METHOD Uls_p10 "" RAT_FUNC "%3.1" "Uls" COEFFS 0 1024 -0 0 0 1 /end COMPU_METHOD
/begin COMPU_METHOD Uls_p11 "" RAT_FUNC "%4.4" "Uls" COEFFS 0 2048 -0 0 0 1 /end COMPU_METHOD
/begin COMPU_METHOD Uls_p12 "" RAT_FUNC "%5.5" "Uls" COEFFS 0 4096 -0 0 0 1 /end COMPU_METHOD
/begin COMPU_METHOD Uls_p14 "" RAT_FUNC "%3.3" "Uls" COEFFS 0 16384 -0 0 0 1 /end COMPU_METHOD
/begin COMPU_METHOD Uls_p15 "" RAT_FUNC "%3.3" "Uls" COEFFS 0 32767.99999 -0 0 0 1 /end COMPU_METHOD
/begin COMPU_METHOD Uls_p16 "" RAT_FUNC "%3.1" "Uls" COEFFS 0 65536 -0 0 0 1 /end COMPU_METHOD
/begin COMPU_METHOD Uls_p19 "" RAT_FUNC "%3.1" "Uls" COEFFS 0 524288 -0 0 0 1 /end COMPU_METHOD
/begin COMPU_METHOD Uls_p20 "" RAT_FUNC "%8.8" "Uls" COEFFS 0 1048576 -0 0 0 1 /end COMPU_METHOD
/begin COMPU_METHOD uls_p26 "" RAT_FUNC "%3.1" "" COEFFS 0 67108864 -0 0 0 1 /end COMPU_METHOD
/begin COMPU_METHOD Volt_p06 "" RAT_FUNC "%3.1" "Volt" COEFFS 0 64 -0 0 0 1 /end COMPU_METHOD
/begin COMPU_METHOD Volt_p07 "" RAT_FUNC "%3.1" "Volt" COEFFS 0 128 -0 0 0 1 /end COMPU_METHOD
/begin COMPU_METHOD Volt_p08 "" RAT_FUNC "%3.1" "Volt" COEFFS 0 256 -0 0 0 1 /end COMPU_METHOD
/begin COMPU_METHOD Volt_p10 "" RAT_FUNC "%3.3" "volt" COEFFS 0 1024 -0 0 0 1 /end COMPU_METHOD
/begin CHARACTERISTIC Board_T_ADC_Count_X "" CURVE 0x40001778 ECTEK_Value_u16 0 factorOne 0 65535
 /begin AXIS_DESCR FIX_AXIS NO_INPUT_QUANTITY NO_COMPU_METHOD 46 0 255 READ_ONLY FORMAT "%.15" FIX_AXIS_PAR_DIST 0 1 46 /end AXIS_DESCR
/end CHARACTERISTIC
/begin CHARACTERISTIC Board_T_DegC_Y "" CURVE 0x400017D8 ECTEK_Curve_s16u16 0 factorOne -127 127
 /begin AXIS_DESCR STD_AXIS L3_I_AD_PFC_TEM NO_COMPU_METHOD 1 0 255 READ_ONLY DEPOSIT ABSOLUTE FORMAT "%.15" /end AXIS_DESCR
/end CHARACTERISTIC
/begin MEASUREMENT K_I_GLB_EN "" UBYTE NO_COMPU_METHOD 0 0 0 255 ECU_ADDRESS 0x4000181C FORMAT "%.15" /end MEASUREMENT
/begin MEASUREMENT K_OVER_CUR_TRIG "" UBYTE NO_COMPU_METHOD 0 0 0 255 ECU_ADDRESS 0x4000181D FORMAT "%.15" /end MEASUREMENT
/begin MEASUREMENT L3_AD0_AC_Volt_fast_Ct_u16 "" UWORD AC_Volt_CONVE 0 0 0 65535 ECU_ADDRESS 0x40001872 /end MEASUREMENT
/begin MEASUREMENT L3_AD0_AC_Volt_fast_max_Ct_u16 "" UWORD AC_Volt_CONVE 0 0 0 65535 ECU_ADDRESS 0x40001870 /end MEASUREMENT
/begin MEASUREMENT L3_CP_Duty_ms_u16p12 "" UWORD NO_COMPU_METHOD 0 0 0 65535 READ_WRITE ECU_ADDRESS 0x4000198A FORMAT "%.15" /end MEASUREMENT
/begin MEASUREMENT L3_CP_Per_ms_u16p12 "" UWORD NO_COMPU_METHOD 0 0 0 65535 ECU_ADDRESS 0x4000198C FORMAT "%.15" /end MEASUREMENT
/begin MEASUREMENT L3_Dcdc_Iout_Ct_u16 "" UWORD DcDc_Current 0 0 0 20 ECU_ADDRESS 0x40001878 /end MEASUREMENT
/begin MEASUREMENT L3_Dcdc_Vout_Ct_u16 "" UWORD DcDcVout 0 0 0 800 ECU_ADDRESS 0x4000187A /end MEASUREMENT
/begin MEASUREMENT L3_I_AD_FB_TEM "" UWORD NO_COMPU_METHOD 0 0 0 65535 ECU_ADDRESS 0x40001A78 FORMAT "%.15" /end MEASUREMENT
/begin MEASUREMENT L3_I_AD_PFC_TEM "" UBYTE factorOne 0 0 0 255 ECU_ADDRESS 0x40001A7A /end MEASUREMENT
/begin MEASUREMENT L3_I_AD_PFC_slow_Ct_u16 "" UWORD PFC_Volt_CONVE 0 0 0 65535 ECU_ADDRESS 0x4000186E FORMAT "%.15" /end MEASUREMENT
/begin MEASUREMENT L3_PriCurHigh_Ct_u16 "" UWORD pici_Current 0 0 0 65535 ECU_ADDRESS 0x40001876 FORMAT "%.15" /end MEASUREMENT
/begin MEASUREMENT L3_PriCurLow_Ct_u16 "" UWORD pici_Current 0 0 0 65535 ECU_ADDRESS 0x40001874 FORMAT "%.15" /end MEASUREMENT
/begin MEASUREMENT L3_S_BatCmmVolt_Ct_G_u16 "" UWORD NO_COMPU_METHOD 0 0 0 65535 ECU_ADDRESS 0x40001828 FORMAT "%.15" /end MEASUREMENT
/begin MEASUREMENT L3_S_BatMosVolt_Ct_G_u16 "" UWORD NO_COMPU_METHOD 0 0 0 65535 ECU_ADDRESS 0x40001826 FORMAT "%.15" /end MEASUREMENT
/begin MEASUREMENT L3_S_BatMosVolt_Volt_G_u16p10 "" UWORD Volt_p10 0 0 0 20 ECU_ADDRESS 0x40001918 /end MEASUREMENT
/begin MEASUREMENT L3_S_IgnVolt_Ct_G_u16 "" UWORD NO_COMPU_METHOD 0 0 0 65535 ECU_ADDRESS 0x4000187E FORMAT "%.15" /end MEASUREMENT
/begin MEASUREMENT L3_S_IgnitionState_G_u08 "" UBYTE NO_COMPU_METHOD 0 0 0 255 ECU_ADDRESS 0x40001884 FORMAT "%.15" /end MEASUREMENT
/begin MEASUREMENT L3_S_PcbTemp_Ct_G_u16 "" UWORD NO_COMPU_METHOD 0 0 0 65535 ECU_ADDRESS 0x4000187C FORMAT "%.15" /end MEASUREMENT
/begin MEASUREMENT L3_S_Sensor5V_Ct_G_u16 "" UWORD NO_COMPU_METHOD 0 0 0 65535 ECU_ADDRESS 0x4000182E FORMAT "%.15" /end MEASUREMENT
/begin MEASUREMENT L3_S_Sensor5V_Volt_G_u16p08 "" UWORD Volt_p08 0 0 0 6 ECU_ADDRESS 0x400018DA /end MEASUREMENT
/begin MEASUREMENT L4_S_ECUState_Now_G_Enu "" SBYTE _enum 0 0 -128 127 ECU_ADDRESS 0x4000184B FORMAT "%.15" /end MEASUREMENT
/begin MEASUREMENT L4_S_ECUState_Pre_G_Enu "" SBYTE _enum 0 0 -128 127 READ_WRITE ECU_ADDRESS 0x4000184A FORMAT "%.15" /end MEASUREMENT
/begin MEASUREMENT L5_AC_Volt_fast_max_buff "" UWORD AC_Volt_CONVE 0 0 0 65535 ECU_ADDRESS 0x40001954 /end MEASUREMENT
/begin MEASUREMENT OBCTag.ChrOpMode "" UBYTE obcState 0 0 0 255 ECU_ADDRESS 0x4000249B FORMAT "%.15" /end MEASUREMENT
/begin MEASUREMENT OBCTag.ChrTemp "" UBYTE NO_COMPU_METHOD 0 0 0 255 ECU_ADDRESS 0x4000249A FORMAT "%.15" /end MEASUREMENT
/begin MEASUREMENT OBCTag.FaultID "" UBYTE NO_COMPU_METHOD 0 0 0 255 ECU_ADDRESS 0x40002499 FORMAT "%.15" /end MEASUREMENT
/begin MEASUREMENT OBCTag.PowerLimit "" UBYTE NO_COMPU_METHOD 0 0 0 255 ECU_ADDRESS 0x40002491 FORMAT "%.15" /end MEASUREMENT
/begin MEASUREMENT OBCTag.ReqCloseRly "" UBYTE NO_COMPU_METHOD 0 0 0 255 ECU_ADDRESS 0x40002492 FORMAT "%.15" /end MEASUREMENT
/begin MEASUREMENT OBCTag.actChrCurrent "" UWORD DcDc_Current 0 0 0 65535 ECU_ADDRESS 0x4000249E FORMAT "%.15" /end MEASUREMENT
/begin MEASUREMENT OBCTag.actChrVolt "" UWORD DcDcVout 0 0 0 65535 ECU_ADDRESS 0x4000249C /end MEASUREMENT
/begin MEASUREMENT OBCTag.bErrorCOM "" UBYTE NO_COMPU_METHOD 0 0 0 255 ECU_ADDRESS 0x40002498 FORMAT "%.15" /end MEASUREMENT
/begin MEASUREMENT OBCTag.bFaultAC "" UBYTE NO_COMPU_METHOD 0 0 0 255 ECU_ADDRESS 0x40002495 FORMAT "%.15" /end MEASUREMENT
/begin MEASUREMENT OBCTag.bFaultCable "" UBYTE NO_COMPU_METHOD 0 0 0 255 ECU_ADDRESS 0x40002490 FORMAT "%.15" /end MEASUREMENT
/begin MEASUREMENT OBCTag.bFaultDC "" UBYTE NO_COMPU_METHOD 0 0 0 255 ECU_ADDRESS 0x40002494 FORMAT "%.15" /end MEASUREMENT
/begin MEASUREMENT OBCTag.bFaultHW "" UBYTE NO_COMPU_METHOD 0 0 0 255 ECU_ADDRESS 0x40002496 FORMAT "%.15" /end MEASUREMENT
/begin MEASUREMENT OBCTag.bOverTempCool "" UBYTE NO_COMPU_METHOD 0 0 0 255 ECU_ADDRESS 0x40002497 FORMAT "%.15" /end MEASUREMENT
/begin MEASUREMENT OBCTag.bWakeUp "" UBYTE NO_COMPU_METHOD 0 0 0 255 ECU_ADDRESS 0x40002493 FORMAT "%.15" /end MEASUREMENT
/begin MEASUREMENT OBCTag.chrFB_TEM "" SWORD NO_COMPU_METHOD 0 0 -32768 32767 ECU_ADDRESS 0x400024A0 FORMAT "%.15" /end MEASUREMENT
/begin MEASUREMENT OBCTag.chrPFC_TEM "" SWORD NO_COMPU_METHOD 0 0 -32768 32767 ECU_ADDRESS 0x400024A2 FORMAT "%.15" /end MEASUREMENT
/begin MEASUREMENT OBC_DWork.UnitDelay1_Copy1 "" SLONG NO_COMPU_METHOD 0 0 -32768 32767 READ_WRITE ECU_ADDRESS 0x400018F4 FORMAT "%.15" /end MEASUREMENT
/begin CHARACTERISTIC OBC_DWork.UnitDelay1_Cur_Copy1 "" VALUE 0x400018F0 __SLONG_S 0 NO_COMPU_METHOD -32768 32767 FORMAT "%.15" /end CHARACTERISTIC
/begin CHARACTERISTIC OBC_DWork.UnitDelay1_DSTATE "" VALUE 0x400018F0 __SLONG_S 0 NO_COMPU_METHOD -32768 32767 FORMAT "%.15" /end CHARACTERISTIC
/begin CHARACTERISTIC OBC_DWork.UnitDelay1_DSTATE_e "" VALUE 0x400018F4 __SLONG_S 0 NO_COMPU_METHOD -32768 32767 FORMAT "%.15" /end CHARACTERISTIC
/begin MEASUREMENT OBC_U.IoErr "" SWORD DcDc_Current 0 0 -20 20 ECU_ADDRESS 0x4000193A /end MEASUREMENT
/begin MEASUREMENT OBC_U.PfcCurErr "" SWORD NO_COMPU_METHOD 0 0 -32768 32767 ECU_ADDRESS 0x4000193C FORMAT "%.15" /end MEASUREMENT
/begin MEASUREMENT OBC_U.VoErr "" SWORD DcDcVout 0 0 -500 500 ECU_ADDRESS 0x40001938 /end MEASUREMENT
/begin MEASUREMENT OBC_Y.Ct "" UWORD NO_COMPU_METHOD 0 0 0 65535 ECU_ADDRESS 0x40001930 FORMAT "%.15" /end MEASUREMENT
/begin MEASUREMENT OBC_Y.Ct1 "" SWORD NO_COMPU_METHOD 0 0 -32768 32767 ECU_ADDRESS 0x40001934 FORMAT "%.15" /end MEASUREMENT
/begin CHARACTERISTIC PFC_T_ADC_Count_X "" CURVE 0x40001890 ECTEK_Value_u16 0 NO_COMPU_METHOD 0 65535
 /begin AXIS_DESCR FIX_AXIS NO_INPUT_QUANTITY NO_COMPU_METHOD 42 0 255 READ_ONLY FORMAT "%.15" FIX_AXIS_PAR_DIST 0 1 42 /end AXIS_DESCR
 FORMAT "%.15" /end CHARACTERISTIC
/begin CHARACTERISTIC PFC_T_DegC_Y._0_ "" CURVE 0x400018E8 STANDARD_CURVE_U16S32 0 NO_COMPU_METHOD -2147483648 2147483647
 /begin AXIS_DESCR FIX_AXIS NO_INPUT_QUANTITY NO_COMPU_METHOD 1 0 255 READ_ONLY FORMAT "%.15" FIX_AXIS_PAR_DIST 0 1 1 /end AXIS_DESCR
 FORMAT "%.15" /end CHARACTERISTIC
/begin MEASUREMENT faultCodeTag.bit.bOCP "" UBYTE NO_COMPU_METHOD 0 0 0 1 BIT_MASK 0x2 ECU_ADDRESS 0x40001944 FORMAT "%.15" /end MEASUREMENT
/begin MEASUREMENT faultCodeTag.bit.bOverTempCool "" UBYTE NO_COMPU_METHOD 0 0 0 1 BIT_MASK 0x80 ECU_ADDRESS 0x40001960 FORMAT "%.15" /end MEASUREMENT
/begin MEASUREMENT faultCodeTag.bit.bOverUinVolt "" UBYTE NO_COMPU_METHOD 0 0 0 1 BIT_MASK 0x20 ECU_ADDRESS 0x40001960 FORMAT "%.15" /end MEASUREMENT
/begin MEASUREMENT faultCodeTag.bit.bOverUoutVolt "" UBYTE NO_COMPU_METHOD 0 0 0 1 BIT_MASK 0x8 ECU_ADDRESS 0x40001944 FORMAT "%.15" /end MEASUREMENT
/begin MEASUREMENT faultCodeTag.bit.bOvercurrent1 "" UBYTE NO_COMPU_METHOD 0 0 0 1 BIT_MASK 0x1 ECU_ADDRESS 0x40001944 FORMAT "%.15" /end MEASUREMENT
/begin MEASUREMENT faultCodeTag.bit.bOvercurrent2 "" UBYTE NO_COMPU_METHOD 0 0 0 1 BIT_MASK 0x2 ECU_ADDRESS 0x40001944 FORMAT "%.15" /end MEASUREMENT
/begin MEASUREMENT faultCodeTag.bit.bUnderUinVolt "" UBYTE NO_COMPU_METHOD 0 0 0 1 BIT_MASK 0x10 ECU_ADDRESS 0x40001960 FORMAT "%.15" /end MEASUREMENT
/begin MEASUREMENT faultCodeTag.bit.bUnderUoutVolt "" UBYTE NO_COMPU_METHOD 0 0 0 1 BIT_MASK 0x4 ECU_ADDRESS 0x40001944 FORMAT "%.15" /end MEASUREMENT
/begin MEASUREMENT faultCodeTag.bit.bloadDump "" UBYTE NO_COMPU_METHOD 0 0 0 1 BIT_MASK 0x80 ECU_ADDRESS 0x40001961 FORMAT "%.15" /end MEASUREMENT
/begin CHARACTERISTIC k_CurKi_Uls_s16p15 "" VALUE 0x40001808 __SWORD_S 0 NO_COMPU_METHOD -32768 32767 FORMAT "%.15" /end CHARACTERISTIC
/begin CHARACTERISTIC k_CurKp_Uls_s16p12 "" VALUE 0x4000180A __SWORD_S 0 NO_COMPU_METHOD -32768 32767 FORMAT "%.15" /end CHARACTERISTIC
/begin CHARACTERISTIC k_DcDcLoopType_u08 "" VALUE 0x4000180C __UBYTE_S 0 NO_COMPU_METHOD 0 255 FORMAT "%.15" /end CHARACTERISTIC
/begin CHARACTERISTIC k_DcDcTaskPer_u08 "" VALUE 0x400017E7 __UBYTE_S 0 NO_COMPU_METHOD 0 255 FORMAT "%.15" /end CHARACTERISTIC
/begin CHARACTERISTIC k_Dcdc_Iref_Ct_u16 "" VALUE 0x400017DC ECTEK_Value_u16 0 DcDc_Current_Ref 0 65535 /end CHARACTERISTIC
/begin CHARACTERISTIC k_Dcdc_Vref_Ct_u16 "" VALUE 0x400017DA ECTEK_Value_u16 0 DcDcVout_Ref 0 65535 /end CHARACTERISTIC
/begin CHARACTERISTIC k_O_S_RlyCT "" VALUE 0x40001824 __UBYTE_S 0 _relayCtrl 0 1 /end CHARACTERISTIC
/begin CHARACTERISTIC k_PfcCurErrDeadZone_Ct_s16 "" VALUE 0x400017E6 __SWORD_S 0 NO_COMPU_METHOD 0 1024 FORMAT "%.15" /end CHARACTERISTIC
/begin CHARACTERISTIC k_PfcCurKp_Uls_s16p10 "" VALUE 0x400018D8 __SWORD_S 0 NO_COMPU_METHOD -1024 1024 FORMAT "%.15" /end CHARACTERISTIC
/begin CHARACTERISTIC k_PhaseAdvance_Ct_u16 "" VALUE 0x400017D8 __UWORD_S 0 NO_COMPU_METHOD 0 65535 FORMAT "%.15" /end CHARACTERISTIC
/begin CHARACTERISTIC k_PianCiComp_Ct_s16 "" VALUE 0x400018C0 __SWORD_S 0 NO_COMPU_METHOD -100 100 FORMAT "%.15" /end CHARACTERISTIC
/begin CHARACTERISTIC k_PwmSelect_u08 "" VALUE 0x400017E6 __UBYTE_S 0 NO_COMPU_METHOD 0 255 FORMAT "%.15" /end CHARACTERISTIC
/begin CHARACTERISTIC k_VoltKi_Uls_s16p15 "" VALUE 0x4000180E __SWORD_S 0 NO_COMPU_METHOD -32768 32767 FORMAT "%.15" /end CHARACTERISTIC
/begin CHARACTERISTIC k_VoltKp_Uls_s16p12 "" VALUE 0x40001810 __SWORD_S 0 NO_COMPU_METHOD -32768 32767 FORMAT "%.15" /end CHARACTERISTIC
/begin CHARACTERISTIC k_deadTime "" VALUE 0x400017E8 __UWORD_S 0 deadTimeConv 0 65535000 /end CHARACTERISTIC
/begin CHARACTERISTIC k_pianCiCnt_u08 "" VALUE 0x400017CC __UBYTE_S 0 NO_COMPU_METHOD 0 255 FORMAT "%.15" /end CHARACTERISTIC
/begin MEASUREMENT loadDumpUpMaxVal "" SWORD DcDcVout_Ref 0 0 -32768 32767 ECU_ADDRESS 0x40001942 /end MEASUREMENT
/begin MEASUREMENT loadDumpUpVal "" UWORD DcDcVout_Ref 0 0 0 65535 ECU_ADDRESS 0x4000182E /end MEASUREMENT
/begin MEASUREMENT mStateCntrTag.PFC_RUNCntr "" UWORD NO_COMPU_METHOD 0 0 0 65535 ECU_ADDRESS 0x400024B6 FORMAT "%.15" /end MEASUREMENT
/begin MEASUREMENT mVARCntrTag.ACVoltCntr "" UWORD NO_COMPU_METHOD 0 0 0 65535 ECU_ADDRESS 0x4000194C FORMAT "%.15" /end MEASUREMENT
/begin MEASUREMENT mVARCntrTag.acVolt_pfcVol_errCntr "" UWORD NO_COMPU_METHOD 0 0 0 65535 ECU_ADDRESS 0x4000194E FORMAT "%.15" /end MEASUREMENT
/begin MEASUREMENT stSysFSMCtrl.ucCurrentState "" UBYTE obcState 0 0 0 255 ECU_ADDRESS 0x4000195A FORMAT "%.15" /end MEASUREMENT
/begin MEASUREMENT stSysFSMCtrl.ucLastState "" UBYTE obcState 0 0 0 255 ECU_ADDRESS 0x40001959 FORMAT "%.15" /end MEASUREMENT
/begin MEASUREMENT startOver "" UBYTE NO_COMPU_METHOD 0 0 0 255 ECU_ADDRESS 0x400018C2 FORMAT "%.15" /end MEASUREMENT
/begin GROUP CurrentLoop "Comment" ROOT
 /begin REF_CHARACTERISTIC OBC_DWork.UnitDelay1_Cur_Copy1 OBC_DWork.UnitDelay1_DSTATE k_CurKi_Uls_s16p15 k_CurKp_Uls_s16p12 k_Dcdc_Iref_Ct_u16 /end REF_CHARACTERISTIC
/end GROUP
/begin GROUP DCDC "Comment" ROOT
 /begin REF_CHARACTERISTIC k_DcDcLoopType_u08 k_DcDcTaskPer_u08 k_PfcCurErrDeadZone_Ct_s16 k_PfcCurKp_Uls_s16p10 k_PhaseAdvance_Ct_u16 k_PianCiComp_Ct_s16 k_PwmSelect_u08 k_deadTime k_pianCiCnt_u08 /end REF_CHARACTERISTIC
 /begin REF_MEASUREMENT L3_Dcdc_Iout_Ct_u16 L3_Dcdc_Vout_Ct_u16 L3_PriCurHigh_Ct_u16 L3_PriCurLow_Ct_u16 OBC_U.IoErr OBC_U.PfcCurErr OBC_U.VoErr OBC_Y.Ct OBC_Y.Ct1 startOver /end REF_MEASUREMENT
/end GROUP
/begin GROUP diag "Comment" ROOT
 /begin REF_CHARACTERISTIC Board_T_ADC_Count_X Board_T_DegC_Y PFC_T_ADC_Count_X PFC_T_DegC_Y._0_ /end REF_CHARACTERISTIC
 /begin REF_MEASUREMENT K_I_GLB_EN K_OVER_CUR_TRIG L3_AD0_AC_Volt_fast_Ct_u16 L3_CP_Duty_ms_u16p12 L3_CP_Per_ms_u16p12 L3_I_AD_FB_TEM L3_I_AD_PFC_TEM L3_I_AD_PFC_slow_Ct_u16 OBCTag.ChrOpMode OBCTag.ChrTemp OBCTag.FaultID OBCTag.PowerLimit OBCTag.ReqCloseRly OBCTag.actChrCurrent OBCTag.actChrVolt OBCTag.bErrorCOM OBCTag.bFaultAC OBCTag.bFaultCable OBCTag.bFaultDC OBCTag.bFaultHW OBCTag.bOverTempCool OBCTag.bWakeUp OBCTag.chrFB_TEM OBCTag.chrPFC_TEM faultCodeTag.bit.bOCP faultCodeTag.bit.bOverTempCool faultCodeTag.bit.bOverUinVolt faultCodeTag.bit.bOverUoutVolt faultCodeTag.bit.bOvercurrent1 faultCodeTag.bit.bOvercurrent2 faultCodeTag.bit.bUnderUinVolt faultCodeTag.bit.bUnderUoutVolt faultCodeTag.bit.bloadDump loadDumpUpMaxVal loadDumpUpVal /end REF_MEASUREMENT
/end GROUP
/begin GROUP Relay "Comment" ROOT /begin REF_CHARACTERISTIC k_O_S_RlyCT /end REF_CHARACTERISTIC /end GROUP
/begin GROUP Signal "Comment" ROOT /begin REF_MEASUREMENT L3_S_BatCmmVolt_Ct_G_u16 L3_S_Sensor5V_Volt_G_u16p08 /end REF_MEASUREMENT /end GROUP
/begin GROUP Signal1 "Comment" ROOT
 /begin REF_MEASUREMENT L3_S_BatCmmVolt_Ct_G_u16 L3_S_BatMosVolt_Ct_G_u16 L3_S_BatMosVolt_Volt_G_u16p10 L3_S_IgnVolt_Ct_G_u16 L3_S_IgnitionState_G_u08 L3_S_PcbTemp_Ct_G_u16 L3_S_Sensor5V_Ct_G_u16 L3_S_Sensor5V_Volt_G_u16p08 /end REF_MEASUREMENT
/end GROUP
/begin GROUP stateflow "Comment" ROOT
 /begin REF_MEASUREMENT L3_AD0_AC_Volt_fast_max_Ct_u16 L5_AC_Volt_fast_max_buff mVARCntrTag.ACVoltCntr mVARCntrTag.acVolt_pfcVol_errCntr stSysFSMCtrl.ucCurrentState stSysFSMCtrl.ucLastState /end REF_MEASUREMENT
/end GROUP
/begin GROUP VoltLoop "Comment" ROOT
 /begin REF_CHARACTERISTIC OBC_DWork.UnitDelay1_DSTATE_e k_Dcdc_Vref_Ct_u16 k_VoltKi_Uls_s16p15 k_VoltKp_Uls_s16p12 /end REF_CHARACTERISTIC
 /begin REF_MEASUREMENT OBC_DWork.UnitDelay1_Copy1 /end REF_MEASUREMENT
/end GROUP
/begin RECORD_LAYOUT ECTEK_AscII16 FNC_VALUES 1 UBYTE COLUMN_DIR DIRECT FIX_NO_AXIS_PTS_X 16 ALIGNMENT_BYTE 1 ALIGNMENT_WORD 2 ALIGNMENT_LONG 4 ALIGNMENT_FLOAT32_IEEE 4 ALIGNMENT_FLOAT64_IEEE 8 /end RECORD_LAYOUT
/begin RECORD_LAYOUT ECTEK_Curve_s16u16 FNC_VALUES 3 SWORD COLUMN_DIR DIRECT AXIS_PTS_X 2 UWORD INDEX_INCR DIRECT NO_AXIS_PTS_X 1 UWORD ALIGNMENT_BYTE 1 ALIGNMENT_WORD 2 ALIGNMENT_LONG 4 ALIGNMENT_FLOAT32_IEEE 4 ALIGNMENT_FLOAT64_IEEE 8 /end RECORD_LAYOUT
/begin RECORD_LAYOUT ECTEK_Curve_s16u32 FNC_VALUES 3 SWORD ROW_DIR DIRECT AXIS_PTS_X 2 ULONG INDEX_INCR DIRECT NO_AXIS_PTS_X 1 UWORD ALIGNMENT_BYTE 1 ALIGNMENT_WORD 2 ALIGNMENT_LONG 4 ALIGNMENT_FLOAT32_IEEE 4 ALIGNMENT_FLOAT64_IEEE 8 /end RECORD_LAYOUT
/begin RECORD_LAYOUT ECTEK_Curve_u16s16 FNC_VALUES 3 SWORD COLUMN_DIR DIRECT AXIS_PTS_X 2 UWORD INDEX_INCR DIRECT NO_AXIS_PTS_X 1 UWORD ALIGNMENT_BYTE 1 ALIGNMENT_WORD 2 ALIGNMENT_LONG 4 ALIGNMENT_FLOAT32_IEEE 4 ALIGNMENT_FLOAT64_IEEE 8 /end RECORD_LAYOUT
/begin RECORD_LAYOUT ECTEK_Curve_u16u16 FNC_VALUES 3 UWORD ROW_DIR DIRECT AXIS_PTS_X 2 UWORD INDEX_INCR DIRECT NO_AXIS_PTS_X 1 UWORD ALIGNMENT_BYTE 1 ALIGNMENT_WORD 2 ALIGNMENT_LONG 4 ALIGNMENT_FLOAT32_IEEE 4 ALIGNMENT_FLOAT64_IEEE 8 /end RECORD_LAYOUT
/begin RECORD_LAYOUT ECTEK_Curve_u16u32 FNC_VALUES 3 UWORD ROW_DIR DIRECT AXIS_PTS_X 2 ULONG INDEX_INCR DIRECT NO_AXIS_PTS_X 1 UWORD ALIGNMENT_BYTE 1 ALIGNMENT_WORD 2 ALIGNMENT_LONG 4 ALIGNMENT_FLOAT32_IEEE 4 ALIGNMENT_FLOAT64_IEEE 8 /end RECORD_LAYOUT
/begin RECORD_LAYOUT ECTEK_Map_s16s16s16 FNC_VALUES 5 SWORD COLUMN_DIR DIRECT AXIS_PTS_X 3 SWORD INDEX_INCR DIRECT AXIS_PTS_Y 4 SWORD INDEX_INCR DIRECT NO_AXIS_PTS_X 1 UWORD NO_AXIS_PTS_Y 2 UWORD ALIGNMENT_BYTE 1 ALIGNMENT_WORD 2 ALIGNMENT_LONG 4 ALIGNMENT_FLOAT32_IEEE 4 ALIGNMENT_FLOAT64_IEEE 8 /end RECORD_LAYOUT
/begin RECORD_LAYOUT ECTEK_Map_s16u16u16 FNC_VALUES 5 SWORD COLUMN_DIR DIRECT AXIS_PTS_X 3 UWORD INDEX_INCR DIRECT AXIS_PTS_Y 4 UWORD INDEX_INCR DIRECT NO_AXIS_PTS_X 1 UWORD NO_AXIS_PTS_Y 2 UWORD ALIGNMENT_BYTE 1 ALIGNMENT_WORD 2 ALIGNMENT_LONG 4 ALIGNMENT_FLOAT32_IEEE 4 ALIGNMENT_FLOAT64_IEEE 8 /end RECORD_LAYOUT
/begin RECORD_LAYOUT ECTEK_Map_u16u16s16 FNC_VALUES 5 UWORD COLUMN_DIR DIRECT AXIS_PTS_X 3 UWORD INDEX_INCR DIRECT AXIS_PTS_Y 4 SWORD INDEX_INCR DIRECT NO_AXIS_PTS_X 1 UWORD NO_AXIS_PTS_Y 2 UWORD ALIGNMENT_BYTE 1 ALIGNMENT_WORD 2 ALIGNMENT_LONG 4 ALIGNMENT_FLOAT32_IEEE 4 ALIGNMENT_FLOAT64_IEEE 8 /end RECORD_LAYOUT
/begin RECORD_LAYOUT ECTEK_Map_u16u16u16 FNC_VALUES 5 UWORD COLUMN_DIR DIRECT AXIS_PTS_X 3 UWORD INDEX_INCR DIRECT AXIS_PTS_Y 4 UWORD INDEX_INCR DIRECT NO_AXIS_PTS_X 1 UWORD NO_AXIS_PTS_Y 2 UWORD ALIGNMENT_BYTE 1 ALIGNMENT_WORD 2 ALIGNMENT_LONG 4 ALIGNMENT_FLOAT32_IEEE 4 ALIGNMENT_FLOAT64_IEEE 8 /end RECORD_LAYOUT
/begin RECORD_LAYOUT ECTEK_Value_s16 FNC_VALUES 1 SWORD ROW_DIR DIRECT ALIGNMENT_WORD 2 ALIGNMENT_LONG 4 ALIGNMENT_FLOAT32_IEEE 4 ALIGNMENT_FLOAT64_IEEE 8 /end RECORD_LAYOUT
/begin RECORD_LAYOUT ECTEK_Value_s32 FNC_VALUES 1 SLONG ROW_DIR DIRECT ALIGNMENT_WORD 2 ALIGNMENT_LONG 4 ALIGNMENT_FLOAT32_IEEE 4 ALIGNMENT_FLOAT64_IEEE 8 /end RECORD_LAYOUT
/begin RECORD_LAYOUT ECTEK_Value_s8 FNC_VALUES 1 SBYTE COLUMN_DIR DIRECT ALIGNMENT_BYTE 1 ALIGNMENT_WORD 2 ALIGNMENT_LONG 4 ALIGNMENT_FLOAT32_IEEE 4 ALIGNMENT_FLOAT64_IEEE 8 /end RECORD_LAYOUT
/begin RECORD_LAYOUT ECTEK_Value_u16 FNC_VALUES 1 UWORD COLUMN_DIR DIRECT ALIGNMENT_BYTE 1 ALIGNMENT_WORD 2 ALIGNMENT_LONG 4 ALIGNMENT_FLOAT32_IEEE 4 ALIGNMENT_FLOAT64_IEEE 8 /end RECORD_LAYOUT
/begin RECORD_LAYOUT ECTEK_Value_u32 FNC_VALUES 1 ULONG ROW_DIR DIRECT ALIGNMENT_WORD 2 ALIGNMENT_LONG 4 ALIGNMENT_FLOAT32_IEEE 4 ALIGNMENT_FLOAT64_IEEE 8 /end RECORD_LAYOUT
/begin RECORD_LAYOUT ECTEK_Value_u8 FNC_VALUES 1 UBYTE ROW_DIR DIRECT ALIGNMENT_WORD 2 ALIGNMENT_LONG 4 ALIGNMENT_FLOAT32_IEEE 4 ALIGNMENT_FLOAT64_IEEE 8 /end RECORD_LAYOUT
/begin RECORD_LAYOUT ECTEK_ValueBlock12_u8 FNC_VALUES 1 UBYTE COLUMN_DIR DIRECT FIX_NO_AXIS_PTS_X 12 ALIGNMENT_BYTE 1 ALIGNMENT_WORD 1 ALIGNMENT_LONG 1 ALIGNMENT_FLOAT32_IEEE 1 ALIGNMENT_FLOAT64_IEEE 1 /end RECORD_LAYOUT
/begin RECORD_LAYOUT STANDARD_CURVE_U16S32 FNC_VALUES 3 SLONG COLUMN_DIR DIRECT AXIS_PTS_X 2 UWORD INDEX_INCR DIRECT NO_AXIS_PTS_X 1 UWORD ALIGNMENT_BYTE 1 ALIGNMENT_WORD 2 ALIGNMENT_LONG 4 ALIGNMENT_FLOAT32_IEEE 4 ALIGNMENT_FLOAT64_IEEE 8 /end RECORD_LAYOUT
/begin RECORD_LAYOUT STANDARD_GROUP_S16 ALIGNMENT_BYTE 1 ALIGNMENT_WORD 2 ALIGNMENT_LONG 4 ALIGNMENT_FLOAT32_IEEE 4 ALIGNMENT_FLOAT64_IEEE 8 /end RECORD_LAYOUT
/begin RECORD_LAYOUT ValA_Wu16 FNC_VALUES 1 UBYTE COLUMN_DIR DIRECT ALIGNMENT_BYTE 1 ALIGNMENT_WORD 2 ALIGNMENT_LONG 4 ALIGNMENT_FLOAT32_IEEE 4 ALIGNMENT_FLOAT64_IEEE 8 /end RECORD_LAYOUT
/begin RECORD_LAYOUT __UBYTE_Z FNC_VALUES 1 UBYTE ROW_DIR DIRECT /end RECORD_LAYOUT
/begin RECORD_LAYOUT __UWORD_Z FNC_VALUES 1 UWORD ROW_DIR DIRECT /end RECORD_LAYOUT
/begin RECORD_LAYOUT __ULONG_Z FNC_VALUES 1 ULONG ROW_DIR DIRECT /end RECORD_LAYOUT
/begin RECORD_LAYOUT __SBYTE_Z FNC_VALUES 1 SBYTE ROW_DIR DIRECT /end RECORD_LAYOUT
/begin RECORD_LAYOUT __SWORD_Z FNC_VALUES 1 SWORD ROW_DIR DIRECT /end RECORD_LAYOUT
/begin RECORD_LAYOUT __SLONG_Z FNC_VALUES 1 SLONG ROW_DIR DIRECT /end RECORD_LAYOUT
/begin RECORD_LAYOUT __FLOAT32_IEEE_Z FNC_VALUES 1 FLOAT32_IEEE ROW_DIR DIRECT /end RECORD_LAYOUT
/begin RECORD_LAYOUT __FLOAT64_IEEE_Z FNC_VALUES 1 FLOAT64_IEEE ROW_DIR DIRECT /end RECORD_LAYOUT
/begin RECORD_LAYOUT __UBYTE_S FNC_VALUES 1 UBYTE COLUMN_DIR DIRECT /end RECORD_LAYOUT
/begin RECORD_LAYOUT __UWORD_S FNC_VALUES 1 UWORD COLUMN_DIR DIRECT /end RECORD_LAYOUT
/begin RECORD_LAYOUT __ULONG_S FNC_VALUES 1 ULONG COLUMN_DIR DIRECT /end RECORD_LAYOUT
/begin RECORD_LAYOUT __SBYTE_S FNC_VALUES 1 SBYTE COLUMN_DIR DIRECT /end RECORD_LAYOUT
/begin RECORD_LAYOUT __SWORD_S FNC_VALUES 1 SWORD COLUMN_DIR DIRECT /end RECORD_LAYOUT
/begin RECORD_LAYOUT __SLONG_S FNC_VALUES 1 SLONG COLUMN_DIR DIRECT /end RECORD_LAYOUT
/begin RECORD_LAYOUT __FLOAT32_IEEE_S FNC_VALUES 1 FLOAT32_IEEE COLUMN_DIR DIRECT /end RECORD_LAYOUT
/begin RECORD_LAYOUT __FLOAT64_IEEE_S FNC_VALUES 1 FLOAT64_IEEE COLUMN_DIR DIRECT /end RECORD_LAYOUT
/begin RECORD_LAYOUT SSV__UBYTE_S AXIS_PTS_X 1 UBYTE INDEX_INCR DIRECT /end RECORD_LAYOUT
/begin RECORD_LAYOUT SSV__UWORD_S AXIS_PTS_X 1 UWORD INDEX_INCR DIRECT /end RECORD_LAYOUT
/begin RECORD_LAYOUT SSV__ULONG_S AXIS_PTS_X 1 ULONG INDEX_INCR DIRECT /end RECORD_LAYOUT
/begin RECORD_LAYOUT SSV__SBYTE_S AXIS_PTS_X 1 SBYTE INDEX_INCR DIRECT /end RECORD_LAYOUT
/begin RECORD_LAYOUT SSV__SWORD_S AXIS_PTS_X 1 SWORD INDEX_INCR DIRECT /end RECORD_LAYOUT
/begin RECORD_LAYOUT SSV__SLONG_S AXIS_PTS_X 1 SLONG INDEX_INCR DIRECT /end RECORD_LAYOUT
/begin RECORD_LAYOUT SSV__FLOAT32_IEEE_S AXIS_PTS_X 1 FLOAT32_IEEE INDEX_INCR DIRECT /end RECORD_LAYOUT
/begin RECORD_LAYOUT SSV__FLOAT64_IEEE_S AXIS_PTS_X 1 FLOAT64_IEEE INDEX_INCR DIRECT /end RECORD_LAYOUT
/end MODULE
/end PROJECT
